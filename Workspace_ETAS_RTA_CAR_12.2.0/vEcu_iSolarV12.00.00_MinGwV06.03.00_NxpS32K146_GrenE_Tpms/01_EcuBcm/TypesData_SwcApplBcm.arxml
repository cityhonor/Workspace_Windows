AUTOSAR XML (schema 00051)
package /DataTypes
  app type TypeData_SwcApplBcmCom_eStatusKL: category=VALUE
  data type mapping set MappingSetTypeData_SwcApplBcmCom: data-type-map{application-data-type=TypeData_SwcApplBcmCom_eStatusKL, implementation-data-type=uint8}
