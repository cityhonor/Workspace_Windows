AUTOSAR XML (schema 00051)
package /ETAS_Project/EcucModuleConfigurationValuess
  module config BswM_RefUG: definition=BswM
    BswMConfig_0 (BswMConfig)
      BswMArbitration_0 (BswMArbitration)
      BswMModeControl_0 (BswMModeControl)
    BswMGeneral_RefUG (BswMGeneral):
      BswMCanSMEnabled = true
      BswMComMEnabled = true
      BswMDcmEnabled = 0
      BswMDevErrorDetect = 0
      BswMEcuMEnabled = true
      BswMEthIfEnabled = 0
      BswMEthSMEnabled = 0
      BswMFrSMEnabled = 0
      BswMGenericRequestEnabled = true
      BswMJ1939DcmEnabled = 0
      BswMJ1939NmEnabled = 0
      BswMLinSMEnabled = 0
      BswMLinTPEnabled = 0
      BswMNmEnabled = 0
      BswMNvMEnabled = 0
      BswMRbComEnabled = true
      BswMRbDebugEnable = 0
      BswMRbIntrptQueueMaxSize = 5
      BswMRbSoAdEnabled = 0
      BswMSchMEnabled = true
      BswMSdEnabled = 0
      BswMVersionInfoApi = 1
      BswMMainFunctionPeriod = 0.01
      BswMRbMaxNumOfRules = 255
      BswMUserIncludeFiles: BswMUserIncludeFile=CanSM_ComM.h, BswMUserIncludeFile=Mcu.h, BswMUserIncludeFile=CanIf.h, BswMUserIncludeFile=Can.h, BswMUserIncludeFile=Rte_Main.h
