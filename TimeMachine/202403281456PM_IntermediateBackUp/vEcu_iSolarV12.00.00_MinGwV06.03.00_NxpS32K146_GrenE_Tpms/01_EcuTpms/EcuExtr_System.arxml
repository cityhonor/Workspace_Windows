AUTOSAR XML (schema 00051)
package /System_EcuExtract
  system EXTR_TPMS: category=ECU_EXTRACT, ecu-extract-version=1.0.0, pnc-vector-length=0, pnc-vector-offset=0, system-version=1.0.0
    system mapping SYSMPG_TPMS: sender-receiver-to-signal-mapping{data-element=CPT_TPMS_FlatView.RPort_SwcApplBcmCom_StatusKL.DataElement_eKL30R, system-signal=BCM_STAT_CL30R_L}
      sw-mappings:
        swc to ecu mapping SwcToEcuMapping_EcuTpms: component=CPT_TPMS_FlatView.CPT_SwcApplTpmsCom, ecu-instance=Ecu_TPMS
    root-software-compositions:
      root sw composition prototype CPT_TPMS_FlatView: flat-map=TPMS_FlatMap, software-composition=TPMS_FlatView
