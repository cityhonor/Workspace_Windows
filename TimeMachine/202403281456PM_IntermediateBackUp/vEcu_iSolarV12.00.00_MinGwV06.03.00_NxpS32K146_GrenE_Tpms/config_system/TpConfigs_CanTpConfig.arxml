AUTOSAR XML (schema 00051)
package /TpConfigs
  can tp config CanTpConfig: communication-cluster=Can_Network, can-tp-connection{addressing-format=EXTENDED, can-tp-channel=CanTpChannel_UDS, max-block-size=64, ta-type=PHYSICAL-CAN-FD, timeout-br=0.0, timeout-cr=1.0, tp-sdu=IPduDcm_Diag_ReqPhys_TPMS, transmitter=NodeTp_Diag_ReqPhy_TPMS}, can-tp-ecu{cycle-time-main-function=0.005, ecu-instance=Ecu_TPMS}
    can tp channel CanTpChannel_UDS: channel-id=1, channel-mode=FULL-DUPLEX-MODE
    can tp node NodeTp_Diag_ReqPhy_TPMS: connector=Connector_Network_Can_Node0_TPMS, st-min=0.005, timeout-ar=1.0
    can tp node NodeTp_Diag_ResPhys_TPMS: connector=Connector_Network_Can_Node0_TPMS, timeout-as=1.0
