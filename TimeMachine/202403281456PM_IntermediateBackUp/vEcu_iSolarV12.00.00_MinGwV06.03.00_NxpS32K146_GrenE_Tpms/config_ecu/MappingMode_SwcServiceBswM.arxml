AUTOSAR XML (schema 00051)
package /ModeDeclarationGroups
  mode declaration group GroupDeclarationMode_SwcServiceEcuM_STATE: initial-mode=DeclarationMode_SwcServiceEcuM_STATE_STARTUP_ONE
    6 x mode:
      DeclarationMode_SwcServiceEcuM_STATE_APP_POST_RUN
      DeclarationMode_SwcServiceEcuM_STATE_APP_RUN
      DeclarationMode_SwcServiceEcuM_STATE_PREP_SHUTDOWN
      DeclarationMode_SwcServiceEcuM_STATE_RUN
      DeclarationMode_SwcServiceEcuM_STATE_STARTUP_ONE
      DeclarationMode_SwcServiceEcuM_STATE_STARTUP_TWO
package /DataTypeMappingSets
  data type mapping set MappingSetTypeRequestMode_SwcServiceEcuM_STATE: mode-request-type-map{implementation-data-type=uint8, mode-group=GroupDeclarationMode_SwcServiceEcuM_STATE}
