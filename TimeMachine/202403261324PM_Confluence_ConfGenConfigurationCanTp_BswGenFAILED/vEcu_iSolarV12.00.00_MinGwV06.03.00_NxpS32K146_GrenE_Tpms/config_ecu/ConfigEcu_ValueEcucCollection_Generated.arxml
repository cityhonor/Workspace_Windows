AUTOSAR XML (schema 00051)
package /ETAS_Project/EcucModuleConfigurationValuess
  ecuc value collection EcucValueCollection: ecu-extract=EXTR_TPMS
    ecuc-values:
      Rte
      Os
      rba_BswSrv
      Com
      ComM
      EcuC
      IpduM
      Dcm
      CanIf
      Can
      CanTp
      PduR
      CanSM
      Mcu
      Compiler_RefUG
      Platform_RefUG
      Bfx_RefUG
      Det_RefUG
      EcuM_RefUG
      BswM_RefUG
      rba_ArxmlGen
