AUTOSAR XML (schema 00051)
package /ETAS_Project/EcucModuleConfigurationValuess
  module config Platform_RefUG: definition=Platform
    PlatformRbSettings_RefUG (PlatformRbSettings):
      PlatformRbNativeBoolean = unsigned char
      PlatformRbNativeFloat32 = float
      PlatformRbNativeFloat64 = double
      PlatformRbNativeSint16 = signed short
      PlatformRbNativeSint16Least = signed long
      PlatformRbNativeSint32 = signed int
      PlatformRbNativeSint32Least = signed long
      PlatformRbNativeSint64 = signed long long
      PlatformRbNativeSint8 = signed char
      PlatformRbNativeSint8Least = signed long
      PlatformRbNativeUint16 = unsigned short
      PlatformRbNativeUint16Least = unsigned long
      PlatformRbNativeUint32 = unsigned int
      PlatformRbNativeUint32Least = unsigned long
      PlatformRbNativeUint64 = unsigned long long
      PlatformRbNativeUint8 = unsigned char
      PlatformRbNativeUint8Least = unsigned long
      PlatformRbTypeEmitter = Platform_Types
      PlatformRbCpuBitOrder = LSB_FIRST
      PlatformRbCpuByteOrder = LOW_BYTE_FIRST
      PlatformRbCpuType = CPU_TYPE_32
      PlatformRbFloatActivation = ALLOW
      PlatformRbNativeActivation = SUPPRESS
