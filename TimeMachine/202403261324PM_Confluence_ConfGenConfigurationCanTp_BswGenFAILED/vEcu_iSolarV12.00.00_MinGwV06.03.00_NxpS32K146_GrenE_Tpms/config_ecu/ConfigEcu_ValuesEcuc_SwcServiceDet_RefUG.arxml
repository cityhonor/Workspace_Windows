AUTOSAR XML (schema 00051)
package /ETAS_Project/EcucModuleConfigurationValuess
  module config Det_RefUG: definition=Det
    DetGeneral_RefUG (DetGeneral): DetVersionInfoApi=0
