AUTOSAR XML (schema 00051)
package /ETAS_Project/EcucModuleConfigurationValuess
  module config Bfx_RefUG: definition=Bfx
    BfxGeneral_RefUG (BfxGeneral): BfxRbOptimizationMcuExtract=0, BfxRbOptimization=NO_OPTIMIZATION, Bfx_VersionInfoAPI=OFF
    BfxRbMemoryLocations_RefUG (BfxRbMemoryLocations):
      bfxRbMemLocClrBitMasku16u16 = INLINE
      bfxRbMemLocClrBitMasku32u32 = INLINE
      bfxRbMemLocClrBitMasku64u64 = INLINE
      bfxRbMemLocClrBitMasku8u8 = INLINE
      bfxRbMemLocClrBitu16u8 = INLINE
      bfxRbMemLocClrBitu32u8 = INLINE
      bfxRbMemLocClrBitu64u8 = INLINE
      bfxRbMemLocClrBitu8u8 = INLINE
      bfxRbMemLocCopyBitu16u8u16u8 = INLINE
      bfxRbMemLocCopyBitu32u8u32u8 = INLINE
      bfxRbMemLocCopyBitu64u8u64u8 = INLINE
      bfxRbMemLocCopyBitu8u8u8u8 = INLINE
      bfxRbMemLocGetBitsu16u8u8u16 = INLINE
      bfxRbMemLocGetBitsu32u8u8u32 = INLINE
      bfxRbMemLocGetBitsu64u8u8u64 = INLINE
      bfxRbMemLocGetBitsu8u8u8u8 = INLINE
      bfxRbMemLocGetBitu16u8u8 = INLINE
      bfxRbMemLocGetBitu32u8u8 = INLINE
      bfxRbMemLocGetBitu64u8u8 = INLINE
      bfxRbMemLocGetBitu8u8u8 = INLINE
      bfxRbMemLocPutBitsMasku16u16u16 = INLINE
      bfxRbMemLocPutBitsMasku32u32u32 = INLINE
      bfxRbMemLocPutBitsMasku64u64u64 = INLINE
      bfxRbMemLocPutBitsMasku8u8u8 = INLINE
      bfxRbMemLocPutBitsu16u8u8u16 = INLINE
      bfxRbMemLocPutBitsu32u8u8u32 = INLINE
      bfxRbMemLocPutBitsu64u8u8u64 = INLINE
      bfxRbMemLocPutBitsu8u8u8u8 = INLINE
      bfxRbMemLocPutBitu16u8u8 = INLINE
      bfxRbMemLocPutBitu32u8u8 = INLINE
      bfxRbMemLocPutBitu64u8u8 = INLINE
      bfxRbMemLocPutBitu8u8u8 = INLINE
      bfxRbMemLocRotBitLtu16u8 = INLINE
      bfxRbMemLocRotBitLtu32u8 = INLINE
      bfxRbMemLocRotBitLtu64u8 = INLINE
      bfxRbMemLocRotBitLtu8u8 = INLINE
      bfxRbMemLocRotBitRtu16u8 = INLINE
      bfxRbMemLocRotBitRtu32u8 = INLINE
      bfxRbMemLocRotBitRtu64u8 = INLINE
      bfxRbMemLocRotBitRtu8u8 = INLINE
      bfxRbMemLocSetBitMasku16u16 = INLINE
      bfxRbMemLocSetBitMasku32u32 = INLINE
      bfxRbMemLocSetBitMasku64u64 = INLINE
      bfxRbMemLocSetBitMasku8u8 = INLINE
      bfxRbMemLocSetBitsu16u8u8u8 = INLINE
      bfxRbMemLocSetBitsu32u8u8u8 = INLINE
      bfxRbMemLocSetBitsu64u8u8u8 = INLINE
      bfxRbMemLocSetBitsu8u8u8u8 = INLINE
      bfxRbMemLocSetBitu16u8 = INLINE
      bfxRbMemLocSetBitu32u8 = INLINE
      bfxRbMemLocSetBitu64u8 = INLINE
      bfxRbMemLocSetBitu8u8 = INLINE
      bfxRbMemLocShiftBitLtu16u8 = INLINE
      bfxRbMemLocShiftBitLtu32u8 = INLINE
      bfxRbMemLocShiftBitLtu64u8 = INLINE
      bfxRbMemLocShiftBitLtu8u8 = INLINE
      bfxRbMemLocShiftBitRtu16u8 = INLINE
      bfxRbMemLocShiftBitRtu32u8 = INLINE
      bfxRbMemLocShiftBitRtu64u8 = INLINE
      bfxRbMemLocShiftBitRtu8u8 = INLINE
      bfxRbMemLocToggleBitMasku16u16 = INLINE
      bfxRbMemLocToggleBitMasku32u32 = INLINE
      bfxRbMemLocToggleBitMasku64u64 = INLINE
      bfxRbMemLocToggleBitMasku8u8 = INLINE
      bfxRbMemLocToggleBitsu16 = INLINE
      bfxRbMemLocToggleBitsu32 = INLINE
      bfxRbMemLocToggleBitsu64 = INLINE
      bfxRbMemLocToggleBitsu8 = INLINE
      bfxRbMemLocTstBitLnMasku16u16u8 = INLINE
      bfxRbMemLocTstBitLnMasku32u32u8 = INLINE
      bfxRbMemLocTstBitLnMasku64u64u8 = INLINE
      bfxRbMemLocTstBitLnMasku8u8u8 = INLINE
      bfxRbMemLocTstBitMasku16u16u8 = INLINE
      bfxRbMemLocTstBitMasku32u32u8 = INLINE
      bfxRbMemLocTstBitMasku64u64u8 = INLINE
      bfxRbMemLocTstBitMasku8u8u8 = INLINE
      bfxRbMemLocTstParityEvenu16u8 = INLINE
      bfxRbMemLocTstParityEvenu32u8 = INLINE
      bfxRbMemLocTstParityEvenu64u8 = INLINE
      bfxRbMemLocTstParityEvenu8u8 = INLINE
