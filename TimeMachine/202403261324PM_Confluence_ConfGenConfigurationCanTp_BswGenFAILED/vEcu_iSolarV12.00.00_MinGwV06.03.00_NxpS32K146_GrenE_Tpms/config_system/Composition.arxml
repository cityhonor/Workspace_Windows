AUTOSAR XML (schema 00051)
package /System
  composition sw component type TopLevelComposition
    component CPT_SwcApplTpmsCom: type=TypeSWC_SwcApplTpmsCom
    component CPT_SwcApplBcmCom: type=TypeSWC_SwcApplBcmCom
    connect CPT_SwcApplBcmCom.PPort_SwcApplBcmCom_StatusKL -> CPT_SwcApplTpmsCom.RPort_SwcApplBcmCom_StatusKL
