AUTOSAR XML (schema 00051)
package /TpConfigs
  can tp config CanTpConfig: communication-cluster=Can_Network, can-tp-ecu{cycle-time-main-function=0.005, ecu-instance=TPMS}
    can tp channel CanTpChannel_UDS: channel-id=1, channel-mode=FULL-DUPLEX-MODE
    tp-connections:
      addressing-format=EXTENDED, can-tp-channel=CanTpChannel_UDS, max-block-size=64, padding-activation=false, ta-type=FUNCTIONAL-CAN-FD, timeout-br=0.0, timeout-cr=1.0, tp-sdu=Diag_FuncReq, transmitter=Diag_FuncReq
      addressing-format=STANDARD, can-tp-channel=CanTpChannel_UDS, max-block-size=64, ta-type=FUNCTIONAL-CAN-FD, timeout-br=0.0, timeout-cr=1.0, tp-sdu=Diag_FuncReq_All_CAN, transmitter=Diag_FuncReq_All_CAN
      addressing-format=STANDARD, can-tp-channel=CanTpChannel_UDS, max-block-size=64, ta-type=FUNCTIONAL-CAN-FD, timeout-br=0.0, timeout-cr=1.0, tp-sdu=Diag_FuncReq_All_ECUs, transmitter=Diag_FuncReq_All_ECUs
      addressing-format=EXTENDED, can-tp-channel=CanTpChannel_UDS, max-block-size=64, ta-type=PHYSICAL-CAN-FD, timeout-br=0.0, timeout-cr=1.0, tp-sdu=Diag_PhyReq_TPMS, transmitter=Diag_PhyReq_TPMS
      addressing-format=EXTENDED, can-tp-channel=CanTpChannel_UDS, max-block-size=64, receiver=[Diag_FuncReq, Diag_FuncReq_All_CAN, Diag_FuncReq_All_ECUs, Diag_PhyReq_TPMS], ta-type=PHYSICAL-CAN-FD, timeout-bs=1.0, timeout-cs=0.1, tp-sdu=Diag_Resp_TPMS, transmitter=Diag_Resp_TPMS
    5 x can tp node, all with connector=Conn_Can_Network_CANNODE_0_TPMS:
      Diag_FuncReq: st-min=0.005, timeout-ar=1.0
      Diag_FuncReq_All_CAN: st-min=0.005, timeout-ar=1.0
      Diag_FuncReq_All_ECUs: st-min=0.005, timeout-ar=1.0
      Diag_PhyReq_TPMS: st-min=0.005, timeout-ar=1.0
      Diag_Resp_TPMS: timeout-as=1.0
