AUTOSAR XML (schema 00051)
package /TPMS_FlatView
  flat map TPMS_FlatMap
    flat instance descriptor CPT_SwcApplTpmsCom: upstream-reference=RootSwCompositionPrototype.CPT_SwcApplTpmsCom, ecu-extract-reference=CPT_TPMS_FlatView.CPT_SwcApplTpmsCom
    flat instance descriptor DataElement_eKL30R: sw-refresh-timing={cse-code=10, cse-code-factor=0}, upstream-reference=RootSwCompositionPrototype.CPT_SwcApplTpmsCom.RPort_SwcApplBcmCom_StatusKL.DataElement_eKL30R, ecu-extract-reference=CPT_TPMS_FlatView.CPT_SwcApplTpmsCom.RPort_SwcApplBcmCom_StatusKL.DataElement_eKL30R
