AUTOSAR XML (schema 00051)
package /TPMS_FlatView/SwComponentTypes
  composition sw component type TPMS_FlatView
    require port RPort_SwcApplBcmCom_StatusKL: required-interface=PortInterface_SwcApplBcmCom_StatusKL
    component CPT_SwcApplTpmsCom: type=TypeSWC_SwcApplTpmsCom
    delegate CPT_SwcApplTpmsCom.RPort_SwcApplBcmCom_StatusKL <-> outer port RPort_SwcApplBcmCom_StatusKL
