AUTOSAR XML (schema 00051)
package /ETAS_Project/EcucModuleConfigurationValuess
  module config ComM: implementation-config-variant=VARIANT-PRE-COMPILE
    ComMConfigSet
      Can_Network_Channel_Can_Network (ComMChannel):
        ComMNoCom = true
        ComMFullCommRequestNotificationEnabled = false
        ComMMainFunctionPeriod = 0.01
        ComMBusType = COMM_BUS_TYPE_CAN
        ComMNoWakeUpInhibitionNvmStorage = false
        ComMNoWakeup = true
        ComMNetworkManagement: ComMNmVariant=NONE, ComMNmLightTimeout=10, ComMPncNmRequest=false
        ComMUserPerChannel_Can_Network_Channel_Can_Network (ComMUserPerChannel): ComMUserChannel=ComMUser_Can_Network_Channel_Can_Network
      ComMUser_Can_Network_Channel_Can_Network (ComMUser)
    ComMGeneral:
      ComMResetAfterForcingNoComm = false
      ComMModeLimitationEnabled = false
      ComMPncGatewayEnabled = false
      ComMEcuGroupClassification = 0
      ComMDevErrorDetect = false
      ComMWakeupInhibitionEnabled = false
      ComMPncSupport = false
      ComMTMinFullComModeDuration = 0.01
      ComMVersionInfoApi = false
      ComMRteEnabled = false
      ComMSynchronousWakeUp = false
  module config EcuC: implementation-config-variant=VARIANT-PRE-COMPILE
    EcucConfigSet
      EcucPduCollection: PduIdTypeEnum=uint16, PduLengthTypeEnum=uint16
        65 x Pdu:
          BCM_01_LOGICAL_CLAMP_CanIf2PduR_Can_Network_Channel_CAN: PduLength=16, SysTPduToPduTriggeringRef=PduTrig_BCM_01_LOGICAL_CLAMP
          BCM_01_LOGICAL_CLAMP_PduR2Com_Can_Network_Channel_CAN: PduLength=16, SysTPduToPduTriggeringRef=PduTrig_BCM_01_LOGICAL_CLAMP
          CGW_01_CON_VEH_CanIf2PduR_Can_Network_Channel_CAN: PduLength=16, SysTPduToPduTriggeringRef=PduTrig_CGW_01_CON_VEH
          CGW_01_CON_VEH_PduR2Com_Can_Network_Channel_CAN: PduLength=16, SysTPduToPduTriggeringRef=PduTrig_CGW_01_CON_VEH
          Diag_FuncReq_CanIf2CanTp_Can_Network_Channel_CAN: PduLength=8, SysTPduToPduTriggeringRef=PduTrig_Diag_FuncReq
          Diag_FuncReq_CanTp2PduR_Can_Network_Channel_CAN: PduLength=8, SysTPduToPduTriggeringRef=PduTrig_Diag_FuncReq
          Diag_FuncReq_PduR2Dcm_Can_Network_Channel_CAN: PduLength=8, SysTPduToPduTriggeringRef=PduTrig_Diag_FuncReq
          Diag_FuncReq_All_CAN_CanIf2CanTp_Can_Network_Channel_CAN: PduLength=8, SysTPduToPduTriggeringRef=PduTrig_Diag_FuncReq_All_CAN
          Diag_FuncReq_All_CAN_CanTp2PduR_Can_Network_Channel_CAN: PduLength=8, SysTPduToPduTriggeringRef=PduTrig_Diag_FuncReq_All_CAN
          Diag_FuncReq_All_CAN_PduR2Dcm_Can_Network_Channel_CAN: PduLength=8, SysTPduToPduTriggeringRef=PduTrig_Diag_FuncReq_All_CAN
          Diag_FuncReq_All_ECUs_CanIf2CanTp_Can_Network_Channel_CAN: PduLength=8, SysTPduToPduTriggeringRef=PduTrig_Diag_FuncReq_All_ECUs
          Diag_FuncReq_All_ECUs_CanTp2PduR_Can_Network_Channel_CAN: PduLength=8, SysTPduToPduTriggeringRef=PduTrig_Diag_FuncReq_All_ECUs
          Diag_FuncReq_All_ECUs_PduR2Dcm_Can_Network_Channel_CAN: PduLength=8, SysTPduToPduTriggeringRef=PduTrig_Diag_FuncReq_All_ECUs
          Diag_PhyReq_TPMS_CanIf2CanTp_Can_Network_Channel_CAN: PduLength=64, SysTPduToPduTriggeringRef=PduTrig_Diag_PhyReq_TPMS
          Diag_PhyReq_TPMS_CanTp2PduR_Can_Network_Channel_CAN: PduLength=64, SysTPduToPduTriggeringRef=PduTrig_Diag_PhyReq_TPMS
          Diag_PhyReq_TPMS_PduR2Dcm_Can_Network_Channel_CAN: PduLength=64, SysTPduToPduTriggeringRef=PduTrig_Diag_PhyReq_TPMS
          ESC_01_VeloSpeed_CanIf2PduR_Can_Network_Channel_CAN: PduLength=48, SysTPduToPduTriggeringRef=PduTrig_ESC_01_VeloSpeed
          ESC_01_VeloSpeed_PduR2Com_Can_Network_Channel_CAN: PduLength=48, SysTPduToPduTriggeringRef=PduTrig_ESC_01_VeloSpeed
          ESC_05_OTA_CanIf2PduR_Can_Network_Channel_CAN: PduLength=16, SysTPduToPduTriggeringRef=PduTrig_ESC_05_OTA
          ESC_05_OTA_PduR2Com_Can_Network_Channel_CAN: PduLength=16, SysTPduToPduTriggeringRef=PduTrig_ESC_05_OTA
          HU_01_OTA_CanIf2PduR_Can_Network_Channel_CAN: PduLength=16, SysTPduToPduTriggeringRef=PduTrig_HU_01_OTA
          HU_01_OTA_PduR2Com_Can_Network_Channel_CAN: PduLength=16, SysTPduToPduTriggeringRef=PduTrig_HU_01_OTA
          HU_03_SET_FUNC_CanIf2PduR_Can_Network_Channel_CAN: PduLength=16, SysTPduToPduTriggeringRef=PduTrig_HU_03_SET_FUNC
          HU_03_SET_FUNC_PduR2Com_Can_Network_Channel_CAN: PduLength=16, SysTPduToPduTriggeringRef=PduTrig_HU_03_SET_FUNC
          NM_EPS_CanIf2PduR_Can_Network_Channel_CAN: PduLength=8, SysTPduToPduTriggeringRef=PduTrig_NM_EPS
          NM_EPS_PduR2Com_Can_Network_Channel_CAN: PduLength=8, SysTPduToPduTriggeringRef=PduTrig_NM_EPS
          NM_ESC_CanIf2PduR_Can_Network_Channel_CAN: PduLength=8, SysTPduToPduTriggeringRef=PduTrig_NM_ESC
          NM_ESC_PduR2Com_Can_Network_Channel_CAN: PduLength=8, SysTPduToPduTriggeringRef=PduTrig_NM_ESC
          NM_FCM_CanIf2PduR_Can_Network_Channel_CAN: PduLength=8, SysTPduToPduTriggeringRef=PduTrig_NM_FCM
          NM_FCM_PduR2Com_Can_Network_Channel_CAN: PduLength=8, SysTPduToPduTriggeringRef=PduTrig_NM_FCM
          NM_VCU_CanIf2PduR_Can_Network_Channel_CAN: PduLength=8, SysTPduToPduTriggeringRef=PduTrig_NM_VCU
          NM_VCU_PduR2Com_Can_Network_Channel_CAN: PduLength=8, SysTPduToPduTriggeringRef=PduTrig_NM_VCU
          NM_iBooster_CanIf2PduR_Can_Network_Channel_CAN: PduLength=8, SysTPduToPduTriggeringRef=PduTrig_NM_iBooster
          NM_iBooster_PduR2Com_Can_Network_Channel_CAN: PduLength=8, SysTPduToPduTriggeringRef=PduTrig_NM_iBooster
          TBOX_01_OTA_CanIf2PduR_Can_Network_Channel_CAN: PduLength=16, SysTPduToPduTriggeringRef=PduTrig_TBOX_01_OTA
          TBOX_01_OTA_PduR2Com_Can_Network_Channel_CAN: PduLength=16, SysTPduToPduTriggeringRef=PduTrig_TBOX_01_OTA
          TBOX_02_TIME_CanIf2PduR_Can_Network_Channel_CAN: PduLength=20, SysTPduToPduTriggeringRef=PduTrig_TBOX_02_TIME
          TBOX_02_TIME_PduR2Com_Can_Network_Channel_CAN: PduLength=20, SysTPduToPduTriggeringRef=PduTrig_TBOX_02_TIME
          TCC_02_CanIf2PduR_Can_Network_Channel_CAN: PduLength=48, SysTPduToPduTriggeringRef=PduTrig_TCC_02
          TCC_02_PduR2Com_Can_Network_Channel_CAN: PduLength=48, SysTPduToPduTriggeringRef=PduTrig_TCC_02
          TPMS_Rx_CCP_CanIf2PduR_Can_Network_Channel_CAN: PduLength=8, SysTPduToPduTriggeringRef=PduTrig_TPMS_Rx_CCP
          TPMS_Rx_CCP_PduR2Com_Can_Network_Channel_CAN: PduLength=8, SysTPduToPduTriggeringRef=PduTrig_TPMS_Rx_CCP
          VCU_05_CanIf2PduR_Can_Network_Channel_CAN: PduLength=20, SysTPduToPduTriggeringRef=PduTrig_VCU_05
          VCU_05_PduR2Com_Can_Network_Channel_CAN: PduLength=20, SysTPduToPduTriggeringRef=PduTrig_VCU_05
          Diag_Resp_TPMS_Phys_Dcm2PduR_Can_Network_Channel_CAN: PduLength=64, SysTPduToPduTriggeringRef=PduTrig_Diag_Resp_TPMS
          Diag_Resp_TPMS_Phys_PduR2CanTp_Can_Network_Channel_CAN: PduLength=64, SysTPduToPduTriggeringRef=PduTrig_Diag_Resp_TPMS
          Diag_Resp_TPMS_Phys_CanTp2CanIf_Can_Network_Channel_CAN: PduLength=64, SysTPduToPduTriggeringRef=PduTrig_Diag_Resp_TPMS
          Meas_TPMS_1_Multiplexed_IPDU_IpduM2PduR_Can_Network_Channel_CAN: PduLength=8, SysTPduToPduTriggeringRef=PduTrig_Meas_TPMS_1_Multiplexed_IPDU
          Meas_TPMS_1_Multiplexed_IPDU_PduR2CanIf_Can_Network_Channel_CAN: PduLength=8, SysTPduToPduTriggeringRef=PduTrig_Meas_TPMS_1_Multiplexed_IPDU
          Meas_TPMS_1_MUX1_Com2PduR_Can_Network_Channel_CAN: PduLength=8, SysTPduToPduTriggeringRef=PduTrig_Meas_TPMS_1_MUX1
          Meas_TPMS_1_MUX1_PduR2IpduM_Can_Network_Channel_CAN: PduLength=8, SysTPduToPduTriggeringRef=PduTrig_Meas_TPMS_1_MUX1
          Meas_TPMS_1_MUX2_Com2PduR_Can_Network_Channel_CAN: PduLength=8, SysTPduToPduTriggeringRef=PduTrig_Meas_TPMS_1_MUX2
          Meas_TPMS_1_MUX2_PduR2IpduM_Can_Network_Channel_CAN: PduLength=8, SysTPduToPduTriggeringRef=PduTrig_Meas_TPMS_1_MUX2
          Meas_TPMS_1__MUX_STAT_Com2PduR_Can_Network_Channel_CAN: PduLength=8, SysTPduToPduTriggeringRef=PduTrig_Meas_TPMS_1__MUX_STAT
          Meas_TPMS_1__MUX_STAT_PduR2IpduM_Can_Network_Channel_CAN: PduLength=8, SysTPduToPduTriggeringRef=PduTrig_Meas_TPMS_1__MUX_STAT
          NM_TPMS_Com2PduR_Can_Network_Channel_CAN: PduLength=8, SysTPduToPduTriggeringRef=PduTrig_NM_TPMS
          NM_TPMS_PduR2CanIf_Can_Network_Channel_CAN: PduLength=8, SysTPduToPduTriggeringRef=PduTrig_NM_TPMS
          TPMS_01_Com2PduR_Can_Network_Channel_CAN: PduLength=32, SysTPduToPduTriggeringRef=PduTrig_TPMS_01
          TPMS_01_PduR2CanIf_Can_Network_Channel_CAN: PduLength=32, SysTPduToPduTriggeringRef=PduTrig_TPMS_01
          TPMS_Tx_CCP_Com2PduR_Can_Network_Channel_CAN: PduLength=8, SysTPduToPduTriggeringRef=PduTrig_TPMS_Tx_CCP
          TPMS_Tx_CCP_PduR2CanIf_Can_Network_Channel_CAN: PduLength=8, SysTPduToPduTriggeringRef=PduTrig_TPMS_Tx_CCP
          WarnMsg_TPMS_Com2PduR_Can_Network_Channel_CAN: PduLength=6, SysTPduToPduTriggeringRef=PduTrig_WarnMsg_TPMS
          WarnMsg_TPMS_PduR2CanIf_Can_Network_Channel_CAN: PduLength=6, SysTPduToPduTriggeringRef=PduTrig_WarnMsg_TPMS
          Diag_Resp_TPMS_Dcm2PduR_Can_Network_Channel_CAN: PduLength=64, SysTPduToPduTriggeringRef=PduTrig_Diag_Resp_TPMS
          Diag_Resp_TPMS_PduR2CanTp_Can_Network_Channel_CAN: PduLength=64, SysTPduToPduTriggeringRef=PduTrig_Diag_Resp_TPMS
    EcuCRbSettings: EcuCRbRteInUse=true, EcuCRbArRelease=AR45_Rev0
  module config PduR: implementation-config-variant=VARIANT-PRE-COMPILE
    PduRRoutingPaths: PduRConfigurationId=0
      BCM_01_LOGICAL_CLAMP_CanIf2Com_Can_Network_Channel_CAN (PduRRoutingPath):
        PduRSrcPduRRef = PduRRoutingPaths/BCM_01_LOGICAL_CLAMP_CanIf2PduR_Can_Network_Channel_CAN
        PduRDestPduRRef = PduRRoutingPaths/BCM_01_LOGICAL_CLAMP_PduR2Com_Can_Network_Channel_CAN
      BCM_01_LOGICAL_CLAMP_CanIf2PduR_Can_Network_Channel_CAN (PduRSrcPdu): PduRSrcPduRef=EcucPduCollection/BCM_01_LOGICAL_CLAMP_CanIf2PduR_Can_Network_Channel_CAN
      BCM_01_LOGICAL_CLAMP_PduR2Com_Can_Network_Channel_CAN (PduRDestPdu): PduRDestPduRef=EcucPduCollection/BCM_01_LOGICAL_CLAMP_PduR2Com_Can_Network_Channel_CAN
      CGW_01_CON_VEH_CanIf2Com_Can_Network_Channel_CAN (PduRRoutingPath):
        PduRSrcPduRRef = PduRRoutingPaths/CGW_01_CON_VEH_CanIf2PduR_Can_Network_Channel_CAN
        PduRDestPduRRef = PduRRoutingPaths/CGW_01_CON_VEH_PduR2Com_Can_Network_Channel_CAN
      CGW_01_CON_VEH_CanIf2PduR_Can_Network_Channel_CAN (PduRSrcPdu): PduRSrcPduRef=EcucPduCollection/CGW_01_CON_VEH_CanIf2PduR_Can_Network_Channel_CAN
      CGW_01_CON_VEH_PduR2Com_Can_Network_Channel_CAN (PduRDestPdu): PduRDestPduRef=EcucPduCollection/CGW_01_CON_VEH_PduR2Com_Can_Network_Channel_CAN
      Diag_FuncReq_CanTp2Dcm_Can_Network_Channel_CAN (PduRRoutingPath):
        PduRSrcPduRRef = PduRRoutingPaths/Diag_FuncReq_CanTp2PduR_Can_Network_Channel_CAN
        PduRDestPduRRef = PduRRoutingPaths/Diag_FuncReq_PduR2Dcm_Can_Network_Channel_CAN
      Diag_FuncReq_CanTp2PduR_Can_Network_Channel_CAN (PduRSrcPdu): PduRSrcPduRef=EcucPduCollection/Diag_FuncReq_CanTp2PduR_Can_Network_Channel_CAN
      Diag_FuncReq_PduR2Dcm_Can_Network_Channel_CAN (PduRDestPdu): PduRDestPduRef=EcucPduCollection/Diag_FuncReq_PduR2Dcm_Can_Network_Channel_CAN
      Diag_FuncReq_All_CAN_CanTp2Dcm_Can_Network_Channel_CAN (PduRRoutingPath):
        PduRSrcPduRRef = PduRRoutingPaths/Diag_FuncReq_All_CAN_CanTp2PduR_Can_Network_Channel_CAN
        PduRDestPduRRef = PduRRoutingPaths/Diag_FuncReq_All_CAN_PduR2Dcm_Can_Network_Channel_CAN
      Diag_FuncReq_All_CAN_CanTp2PduR_Can_Network_Channel_CAN (PduRSrcPdu): PduRSrcPduRef=EcucPduCollection/Diag_FuncReq_All_CAN_CanTp2PduR_Can_Network_Channel_CAN
      Diag_FuncReq_All_CAN_PduR2Dcm_Can_Network_Channel_CAN (PduRDestPdu): PduRDestPduRef=EcucPduCollection/Diag_FuncReq_All_CAN_PduR2Dcm_Can_Network_Channel_CAN
      Diag_FuncReq_All_ECUs_CanTp2Dcm_Can_Network_Channel_CAN (PduRRoutingPath):
        PduRSrcPduRRef = PduRRoutingPaths/Diag_FuncReq_All_ECUs_CanTp2PduR_Can_Network_Channel_CAN
        PduRDestPduRRef = PduRRoutingPaths/Diag_FuncReq_All_ECUs_PduR2Dcm_Can_Network_Channel_CAN
      Diag_FuncReq_All_ECUs_CanTp2PduR_Can_Network_Channel_CAN (PduRSrcPdu): PduRSrcPduRef=EcucPduCollection/Diag_FuncReq_All_ECUs_CanTp2PduR_Can_Network_Channel_CAN
      Diag_FuncReq_All_ECUs_PduR2Dcm_Can_Network_Channel_CAN (PduRDestPdu): PduRDestPduRef=EcucPduCollection/Diag_FuncReq_All_ECUs_PduR2Dcm_Can_Network_Channel_CAN
      Diag_PhyReq_TPMS_CanTp2Dcm_Can_Network_Channel_CAN (PduRRoutingPath):
        PduRSrcPduRRef = PduRRoutingPaths/Diag_PhyReq_TPMS_CanTp2PduR_Can_Network_Channel_CAN
        PduRDestPduRRef = PduRRoutingPaths/Diag_PhyReq_TPMS_PduR2Dcm_Can_Network_Channel_CAN
      Diag_PhyReq_TPMS_CanTp2PduR_Can_Network_Channel_CAN (PduRSrcPdu): PduRSrcPduRef=EcucPduCollection/Diag_PhyReq_TPMS_CanTp2PduR_Can_Network_Channel_CAN
      Diag_PhyReq_TPMS_PduR2Dcm_Can_Network_Channel_CAN (PduRDestPdu): PduRDestPduRef=EcucPduCollection/Diag_PhyReq_TPMS_PduR2Dcm_Can_Network_Channel_CAN
      ESC_01_VeloSpeed_CanIf2Com_Can_Network_Channel_CAN (PduRRoutingPath):
        PduRSrcPduRRef = PduRRoutingPaths/ESC_01_VeloSpeed_CanIf2PduR_Can_Network_Channel_CAN
        PduRDestPduRRef = PduRRoutingPaths/ESC_01_VeloSpeed_PduR2Com_Can_Network_Channel_CAN
      ESC_01_VeloSpeed_CanIf2PduR_Can_Network_Channel_CAN (PduRSrcPdu): PduRSrcPduRef=EcucPduCollection/ESC_01_VeloSpeed_CanIf2PduR_Can_Network_Channel_CAN
      ESC_01_VeloSpeed_PduR2Com_Can_Network_Channel_CAN (PduRDestPdu): PduRDestPduRef=EcucPduCollection/ESC_01_VeloSpeed_PduR2Com_Can_Network_Channel_CAN
      ESC_05_OTA_CanIf2Com_Can_Network_Channel_CAN (PduRRoutingPath):
        PduRSrcPduRRef = PduRRoutingPaths/ESC_05_OTA_CanIf2PduR_Can_Network_Channel_CAN
        PduRDestPduRRef = PduRRoutingPaths/ESC_05_OTA_PduR2Com_Can_Network_Channel_CAN
      ESC_05_OTA_CanIf2PduR_Can_Network_Channel_CAN (PduRSrcPdu): PduRSrcPduRef=EcucPduCollection/ESC_05_OTA_CanIf2PduR_Can_Network_Channel_CAN
      ESC_05_OTA_PduR2Com_Can_Network_Channel_CAN (PduRDestPdu): PduRDestPduRef=EcucPduCollection/ESC_05_OTA_PduR2Com_Can_Network_Channel_CAN
      HU_01_OTA_CanIf2Com_Can_Network_Channel_CAN (PduRRoutingPath):
        PduRSrcPduRRef = PduRRoutingPaths/HU_01_OTA_CanIf2PduR_Can_Network_Channel_CAN
        PduRDestPduRRef = PduRRoutingPaths/HU_01_OTA_PduR2Com_Can_Network_Channel_CAN
      HU_01_OTA_CanIf2PduR_Can_Network_Channel_CAN (PduRSrcPdu): PduRSrcPduRef=EcucPduCollection/HU_01_OTA_CanIf2PduR_Can_Network_Channel_CAN
      HU_01_OTA_PduR2Com_Can_Network_Channel_CAN (PduRDestPdu): PduRDestPduRef=EcucPduCollection/HU_01_OTA_PduR2Com_Can_Network_Channel_CAN
      HU_03_SET_FUNC_CanIf2Com_Can_Network_Channel_CAN (PduRRoutingPath):
        PduRSrcPduRRef = PduRRoutingPaths/HU_03_SET_FUNC_CanIf2PduR_Can_Network_Channel_CAN
        PduRDestPduRRef = PduRRoutingPaths/HU_03_SET_FUNC_PduR2Com_Can_Network_Channel_CAN
      HU_03_SET_FUNC_CanIf2PduR_Can_Network_Channel_CAN (PduRSrcPdu): PduRSrcPduRef=EcucPduCollection/HU_03_SET_FUNC_CanIf2PduR_Can_Network_Channel_CAN
      HU_03_SET_FUNC_PduR2Com_Can_Network_Channel_CAN (PduRDestPdu): PduRDestPduRef=EcucPduCollection/HU_03_SET_FUNC_PduR2Com_Can_Network_Channel_CAN
      NM_EPS_CanIf2Com_Can_Network_Channel_CAN (PduRRoutingPath):
        PduRSrcPduRRef = PduRRoutingPaths/NM_EPS_CanIf2PduR_Can_Network_Channel_CAN
        PduRDestPduRRef = PduRRoutingPaths/NM_EPS_PduR2Com_Can_Network_Channel_CAN
      NM_EPS_CanIf2PduR_Can_Network_Channel_CAN (PduRSrcPdu): PduRSrcPduRef=EcucPduCollection/NM_EPS_CanIf2PduR_Can_Network_Channel_CAN
      NM_EPS_PduR2Com_Can_Network_Channel_CAN (PduRDestPdu): PduRDestPduRef=EcucPduCollection/NM_EPS_PduR2Com_Can_Network_Channel_CAN
      NM_ESC_CanIf2Com_Can_Network_Channel_CAN (PduRRoutingPath):
        PduRSrcPduRRef = PduRRoutingPaths/NM_ESC_CanIf2PduR_Can_Network_Channel_CAN
        PduRDestPduRRef = PduRRoutingPaths/NM_ESC_PduR2Com_Can_Network_Channel_CAN
      NM_ESC_CanIf2PduR_Can_Network_Channel_CAN (PduRSrcPdu): PduRSrcPduRef=EcucPduCollection/NM_ESC_CanIf2PduR_Can_Network_Channel_CAN
      NM_ESC_PduR2Com_Can_Network_Channel_CAN (PduRDestPdu): PduRDestPduRef=EcucPduCollection/NM_ESC_PduR2Com_Can_Network_Channel_CAN
      NM_FCM_CanIf2Com_Can_Network_Channel_CAN (PduRRoutingPath):
        PduRSrcPduRRef = PduRRoutingPaths/NM_FCM_CanIf2PduR_Can_Network_Channel_CAN
        PduRDestPduRRef = PduRRoutingPaths/NM_FCM_PduR2Com_Can_Network_Channel_CAN
      NM_FCM_CanIf2PduR_Can_Network_Channel_CAN (PduRSrcPdu): PduRSrcPduRef=EcucPduCollection/NM_FCM_CanIf2PduR_Can_Network_Channel_CAN
      NM_FCM_PduR2Com_Can_Network_Channel_CAN (PduRDestPdu): PduRDestPduRef=EcucPduCollection/NM_FCM_PduR2Com_Can_Network_Channel_CAN
      NM_VCU_CanIf2Com_Can_Network_Channel_CAN (PduRRoutingPath):
        PduRSrcPduRRef = PduRRoutingPaths/NM_VCU_CanIf2PduR_Can_Network_Channel_CAN
        PduRDestPduRRef = PduRRoutingPaths/NM_VCU_PduR2Com_Can_Network_Channel_CAN
      NM_VCU_CanIf2PduR_Can_Network_Channel_CAN (PduRSrcPdu): PduRSrcPduRef=EcucPduCollection/NM_VCU_CanIf2PduR_Can_Network_Channel_CAN
      NM_VCU_PduR2Com_Can_Network_Channel_CAN (PduRDestPdu): PduRDestPduRef=EcucPduCollection/NM_VCU_PduR2Com_Can_Network_Channel_CAN
      NM_iBooster_CanIf2Com_Can_Network_Channel_CAN (PduRRoutingPath):
        PduRSrcPduRRef = PduRRoutingPaths/NM_iBooster_CanIf2PduR_Can_Network_Channel_CAN
        PduRDestPduRRef = PduRRoutingPaths/NM_iBooster_PduR2Com_Can_Network_Channel_CAN
      NM_iBooster_CanIf2PduR_Can_Network_Channel_CAN (PduRSrcPdu): PduRSrcPduRef=EcucPduCollection/NM_iBooster_CanIf2PduR_Can_Network_Channel_CAN
      NM_iBooster_PduR2Com_Can_Network_Channel_CAN (PduRDestPdu): PduRDestPduRef=EcucPduCollection/NM_iBooster_PduR2Com_Can_Network_Channel_CAN
      TBOX_01_OTA_CanIf2Com_Can_Network_Channel_CAN (PduRRoutingPath):
        PduRSrcPduRRef = PduRRoutingPaths/TBOX_01_OTA_CanIf2PduR_Can_Network_Channel_CAN
        PduRDestPduRRef = PduRRoutingPaths/TBOX_01_OTA_PduR2Com_Can_Network_Channel_CAN
      TBOX_01_OTA_CanIf2PduR_Can_Network_Channel_CAN (PduRSrcPdu): PduRSrcPduRef=EcucPduCollection/TBOX_01_OTA_CanIf2PduR_Can_Network_Channel_CAN
      TBOX_01_OTA_PduR2Com_Can_Network_Channel_CAN (PduRDestPdu): PduRDestPduRef=EcucPduCollection/TBOX_01_OTA_PduR2Com_Can_Network_Channel_CAN
      TBOX_02_TIME_CanIf2Com_Can_Network_Channel_CAN (PduRRoutingPath):
        PduRSrcPduRRef = PduRRoutingPaths/TBOX_02_TIME_CanIf2PduR_Can_Network_Channel_CAN
        PduRDestPduRRef = PduRRoutingPaths/TBOX_02_TIME_PduR2Com_Can_Network_Channel_CAN
      TBOX_02_TIME_CanIf2PduR_Can_Network_Channel_CAN (PduRSrcPdu): PduRSrcPduRef=EcucPduCollection/TBOX_02_TIME_CanIf2PduR_Can_Network_Channel_CAN
      TBOX_02_TIME_PduR2Com_Can_Network_Channel_CAN (PduRDestPdu): PduRDestPduRef=EcucPduCollection/TBOX_02_TIME_PduR2Com_Can_Network_Channel_CAN
      TCC_02_CanIf2Com_Can_Network_Channel_CAN (PduRRoutingPath):
        PduRSrcPduRRef = PduRRoutingPaths/TCC_02_CanIf2PduR_Can_Network_Channel_CAN
        PduRDestPduRRef = PduRRoutingPaths/TCC_02_PduR2Com_Can_Network_Channel_CAN
      TCC_02_CanIf2PduR_Can_Network_Channel_CAN (PduRSrcPdu): PduRSrcPduRef=EcucPduCollection/TCC_02_CanIf2PduR_Can_Network_Channel_CAN
      TCC_02_PduR2Com_Can_Network_Channel_CAN (PduRDestPdu): PduRDestPduRef=EcucPduCollection/TCC_02_PduR2Com_Can_Network_Channel_CAN
      TPMS_Rx_CCP_CanIf2Com_Can_Network_Channel_CAN (PduRRoutingPath):
        PduRSrcPduRRef = PduRRoutingPaths/TPMS_Rx_CCP_CanIf2PduR_Can_Network_Channel_CAN
        PduRDestPduRRef = PduRRoutingPaths/TPMS_Rx_CCP_PduR2Com_Can_Network_Channel_CAN
      TPMS_Rx_CCP_CanIf2PduR_Can_Network_Channel_CAN (PduRSrcPdu): PduRSrcPduRef=EcucPduCollection/TPMS_Rx_CCP_CanIf2PduR_Can_Network_Channel_CAN
      TPMS_Rx_CCP_PduR2Com_Can_Network_Channel_CAN (PduRDestPdu): PduRDestPduRef=EcucPduCollection/TPMS_Rx_CCP_PduR2Com_Can_Network_Channel_CAN
      VCU_05_CanIf2Com_Can_Network_Channel_CAN (PduRRoutingPath):
        PduRSrcPduRRef = PduRRoutingPaths/VCU_05_CanIf2PduR_Can_Network_Channel_CAN
        PduRDestPduRRef = PduRRoutingPaths/VCU_05_PduR2Com_Can_Network_Channel_CAN
      VCU_05_CanIf2PduR_Can_Network_Channel_CAN (PduRSrcPdu): PduRSrcPduRef=EcucPduCollection/VCU_05_CanIf2PduR_Can_Network_Channel_CAN
      VCU_05_PduR2Com_Can_Network_Channel_CAN (PduRDestPdu): PduRDestPduRef=EcucPduCollection/VCU_05_PduR2Com_Can_Network_Channel_CAN
      Diag_Resp_TPMS_Dcm2CanTp_Can_Network_Channel_CAN (PduRRoutingPath):
        PduRDestPduRRef = PduRRoutingPaths/Diag_Resp_TPMS_Phys_PduR2CanTp_Can_Network_Channel_CAN
        PduRSrcPduRRef = PduRRoutingPaths/Diag_Resp_TPMS_Dcm2PduR_Can_Network_Channel_CAN
      Diag_Resp_TPMS_Phys_Dcm2PduR_Can_Network_Channel_CAN (PduRSrcPdu): PduRSrcPduRef=EcucPduCollection/Diag_Resp_TPMS_Phys_Dcm2PduR_Can_Network_Channel_CAN
      Diag_Resp_TPMS_Phys_PduR2CanTp_Can_Network_Channel_CAN (PduRDestPdu): PduRDestPduRef=EcucPduCollection/Diag_Resp_TPMS_Phys_PduR2CanTp_Can_Network_Channel_CAN
      Meas_TPMS_1_Multiplexed_IPDU_IpduM2CanIf_Can_Network_Channel_CAN (PduRRoutingPath):
        PduRSrcPduRRef = PduRRoutingPaths/Meas_TPMS_1_Multiplexed_IPDU_IpduM2PduR_Can_Network_Channel_CAN
        PduRDestPduRRef = PduRRoutingPaths/Meas_TPMS_1_Multiplexed_IPDU_PduR2CanIf_Can_Network_Channel_CAN
      Meas_TPMS_1_Multiplexed_IPDU_IpduM2PduR_Can_Network_Channel_CAN (PduRSrcPdu): PduRSrcPduRef=EcucPduCollection/Meas_TPMS_1_Multiplexed_IPDU_IpduM2PduR_Can_Network_Channel_CAN
      Meas_TPMS_1_Multiplexed_IPDU_PduR2CanIf_Can_Network_Channel_CAN (PduRDestPdu): PduRDestPduRef=EcucPduCollection/Meas_TPMS_1_Multiplexed_IPDU_PduR2CanIf_Can_Network_Channel_CAN
      Meas_TPMS_1_MUX1_Com2IpduM_Can_Network_Channel_CAN (PduRRoutingPath):
        PduRSrcPduRRef = PduRRoutingPaths/Meas_TPMS_1_MUX1_Com2PduR_Can_Network_Channel_CAN
        PduRDestPduRRef = PduRRoutingPaths/Meas_TPMS_1_MUX1_PduR2IpduM_Can_Network_Channel_CAN
      Meas_TPMS_1_MUX1_Com2PduR_Can_Network_Channel_CAN (PduRSrcPdu): PduRSrcPduRef=EcucPduCollection/Meas_TPMS_1_MUX1_Com2PduR_Can_Network_Channel_CAN
      Meas_TPMS_1_MUX1_PduR2IpduM_Can_Network_Channel_CAN (PduRDestPdu): PduRDestPduRef=EcucPduCollection/Meas_TPMS_1_MUX1_PduR2IpduM_Can_Network_Channel_CAN
      Meas_TPMS_1_MUX2_Com2IpduM_Can_Network_Channel_CAN (PduRRoutingPath):
        PduRSrcPduRRef = PduRRoutingPaths/Meas_TPMS_1_MUX2_Com2PduR_Can_Network_Channel_CAN
        PduRDestPduRRef = PduRRoutingPaths/Meas_TPMS_1_MUX2_PduR2IpduM_Can_Network_Channel_CAN
      Meas_TPMS_1_MUX2_Com2PduR_Can_Network_Channel_CAN (PduRSrcPdu): PduRSrcPduRef=EcucPduCollection/Meas_TPMS_1_MUX2_Com2PduR_Can_Network_Channel_CAN
      Meas_TPMS_1_MUX2_PduR2IpduM_Can_Network_Channel_CAN (PduRDestPdu): PduRDestPduRef=EcucPduCollection/Meas_TPMS_1_MUX2_PduR2IpduM_Can_Network_Channel_CAN
      Meas_TPMS_1__MUX_STAT_Com2IpduM_Can_Network_Channel_CAN (PduRRoutingPath):
        PduRSrcPduRRef = PduRRoutingPaths/Meas_TPMS_1__MUX_STAT_Com2PduR_Can_Network_Channel_CAN
        PduRDestPduRRef = PduRRoutingPaths/Meas_TPMS_1__MUX_STAT_PduR2IpduM_Can_Network_Channel_CAN
      Meas_TPMS_1__MUX_STAT_Com2PduR_Can_Network_Channel_CAN (PduRSrcPdu): PduRSrcPduRef=EcucPduCollection/Meas_TPMS_1__MUX_STAT_Com2PduR_Can_Network_Channel_CAN
      Meas_TPMS_1__MUX_STAT_PduR2IpduM_Can_Network_Channel_CAN (PduRDestPdu): PduRDestPduRef=EcucPduCollection/Meas_TPMS_1__MUX_STAT_PduR2IpduM_Can_Network_Channel_CAN
      NM_TPMS_Com2CanIf_Can_Network_Channel_CAN (PduRRoutingPath):
        PduRSrcPduRRef = PduRRoutingPaths/NM_TPMS_Com2PduR_Can_Network_Channel_CAN
        PduRDestPduRRef = PduRRoutingPaths/NM_TPMS_PduR2CanIf_Can_Network_Channel_CAN
      NM_TPMS_Com2PduR_Can_Network_Channel_CAN (PduRSrcPdu): PduRSrcPduRef=EcucPduCollection/NM_TPMS_Com2PduR_Can_Network_Channel_CAN
      NM_TPMS_PduR2CanIf_Can_Network_Channel_CAN (PduRDestPdu): PduRDestPduRef=EcucPduCollection/NM_TPMS_PduR2CanIf_Can_Network_Channel_CAN
      TPMS_01_Com2CanIf_Can_Network_Channel_CAN (PduRRoutingPath):
        PduRSrcPduRRef = PduRRoutingPaths/TPMS_01_Com2PduR_Can_Network_Channel_CAN
        PduRDestPduRRef = PduRRoutingPaths/TPMS_01_PduR2CanIf_Can_Network_Channel_CAN
      TPMS_01_Com2PduR_Can_Network_Channel_CAN (PduRSrcPdu): PduRSrcPduRef=EcucPduCollection/TPMS_01_Com2PduR_Can_Network_Channel_CAN
      TPMS_01_PduR2CanIf_Can_Network_Channel_CAN (PduRDestPdu): PduRDestPduRef=EcucPduCollection/TPMS_01_PduR2CanIf_Can_Network_Channel_CAN
      TPMS_Tx_CCP_Com2CanIf_Can_Network_Channel_CAN (PduRRoutingPath):
        PduRSrcPduRRef = PduRRoutingPaths/TPMS_Tx_CCP_Com2PduR_Can_Network_Channel_CAN
        PduRDestPduRRef = PduRRoutingPaths/TPMS_Tx_CCP_PduR2CanIf_Can_Network_Channel_CAN
      TPMS_Tx_CCP_Com2PduR_Can_Network_Channel_CAN (PduRSrcPdu): PduRSrcPduRef=EcucPduCollection/TPMS_Tx_CCP_Com2PduR_Can_Network_Channel_CAN
      TPMS_Tx_CCP_PduR2CanIf_Can_Network_Channel_CAN (PduRDestPdu): PduRDestPduRef=EcucPduCollection/TPMS_Tx_CCP_PduR2CanIf_Can_Network_Channel_CAN
      WarnMsg_TPMS_Com2CanIf_Can_Network_Channel_CAN (PduRRoutingPath):
        PduRSrcPduRRef = PduRRoutingPaths/WarnMsg_TPMS_Com2PduR_Can_Network_Channel_CAN
        PduRDestPduRRef = PduRRoutingPaths/WarnMsg_TPMS_PduR2CanIf_Can_Network_Channel_CAN
      WarnMsg_TPMS_Com2PduR_Can_Network_Channel_CAN (PduRSrcPdu): PduRSrcPduRef=EcucPduCollection/WarnMsg_TPMS_Com2PduR_Can_Network_Channel_CAN
      WarnMsg_TPMS_PduR2CanIf_Can_Network_Channel_CAN (PduRDestPdu): PduRDestPduRef=EcucPduCollection/WarnMsg_TPMS_PduR2CanIf_Can_Network_Channel_CAN
      Diag_Resp_TPMS_Dcm2PduR_Can_Network_Channel_CAN (PduRSrcPdu): PduRSrcPduRef=EcucPduCollection/Diag_Resp_TPMS_Dcm2PduR_Can_Network_Channel_CAN
      Diag_Resp_TPMS_PduR2CanTp_Can_Network_Channel_CAN (PduRDestPdu): PduRDestPduRef=EcucPduCollection/Diag_Resp_TPMS_PduR2CanTp_Can_Network_Channel_CAN
    5 x PduRBswModules, all with PduRCancelReceive=false:
      CanIf: PduRUpperModule=false, PduRTriggertransmit=false, PduRCommunicationInterface=true, PduRTransportProtocol=false, PduRCancelTransmit=false, PduRLowerModule=true, PduRTxConfirmation=true, PduRBswModuleRef=CanIf
      Com: PduRUpperModule=true, PduRTriggertransmit=true, PduRCommunicationInterface=true, PduRTransportProtocol=true, PduRCancelTransmit=false, PduRLowerModule=false, PduRTxConfirmation=false, PduRBswModuleRef=Com
      CanTp: PduRUpperModule=false, PduRTriggertransmit=false, PduRCommunicationInterface=false, PduRTransportProtocol=true, PduRCancelTransmit=true, PduRLowerModule=true, PduRTxConfirmation=true, PduRBswModuleRef=CanTp
        PduRRbInvalidHandlers: PduRRbIHCancelTransmit=false, PduRRbIHCancelReceive=false
      Dcm: PduRUpperModule=true, PduRTriggertransmit=false, PduRCommunicationInterface=false, PduRTransportProtocol=true, PduRCancelTransmit=true, PduRLowerModule=false, PduRTxConfirmation=true, PduRBswModuleRef=Dcm
      IpduM: PduRUpperModule=true, PduRTriggertransmit=true, PduRCommunicationInterface=true, PduRTransportProtocol=false, PduRCancelTransmit=false, PduRLowerModule=true, PduRTxConfirmation=true, PduRBswModuleRef=IpduM
    PduRGeneral:
      PduRRbTPGatewayOperation = false
      PduRRbMulticastFromTpSupport = false
      PduRVersionInfoApi = false
      PduRRbQueueingSupport = false
      PduRZeroCostOperation = false
      PduRDevErrorDetect = false
      PduRRbMulticastToTpSupport = false
      PduRRbIFGatewayOperation = false
      PduRRbMulticastToIfSupport = false
  module config Com: implementation-config-variant=VARIANT-PRE-COMPILE
    ComConfig
      IP_BCM_01_LOGICAL_CLAMP_Can_Network_Channel_CAN_Rx (ComIPdu):
        ComIPduDirection = RECEIVE
        ComIPduSignalProcessing = IMMEDIATE
        ComIPduType = NORMAL
        ComIPduSignalRef = S_SSecOC_MAC_BCM_01_Can_Network_Channel_CAN_Rx
        ComIPduSignalRef = S_SSecOC_Fresh_BCM_01_Can_Network_Channel_CAN_Rx
        ComIPduSignalRef = S_STAT_StartStopButton_Can_Network_Channel_CAN_Rx
        ComIPduSignalRef = S_BCM_Cl30R_Off_Announcement_Can_Network_Channel_CAN_Rx
        ComIPduSignalRef = S_BCM_Cl30s_Off_Announcement_Can_Network_Channel_CAN_Rx
        ComIPduSignalRef = S_BCM_STAT_TransportMode_Can_Network_Channel_CAN_Rx
        ComIPduSignalRef = S_BCM_KL15_Off_Announcement_Can_Network_Channel_CAN_Rx
        ComIPduSignalRef = S_BCM_ST_KL_Can_Network_Channel_CAN_Rx
        ComIPduSignalRef = S_BCM_STAT_Terminal_Can_Network_Channel_CAN_Rx
        ComIPduSignalRef = S_BCM_STAT_CL30R_L_Can_Network_Channel_CAN_Rx
        ComIPduSignalRef = S_BCM_STAT_CL30s_L_Can_Network_Channel_CAN_Rx
        ComIPduSignalRef = S_CRC_BCM_01_Can_Network_Channel_CAN_Rx
        ComIPduSignalRef = S_ALIVE_BCM_01_Can_Network_Channel_CAN_Rx
        ComIPduSignalRef = S_BCM_STAT_CL15_L_Can_Network_Channel_CAN_Rx
        ComIPduGroupRef = ComIPduGroup_Rx
        ComPduIdRef = EcucPduCollection/BCM_01_LOGICAL_CLAMP_PduR2Com_Can_Network_Channel_CAN
      14 x ComSignal, all with ComSignalEndianness=BIG_ENDIAN, ComTransferProperty=TRIGGERED:
        S_SSecOC_MAC_BCM_01_Can_Network_Channel_CAN_Rx: ComSignalType=UINT64, ComBitSize=64, ComBitPosition=39, ComSignalInitValue=0, ComSystemTemplateSystemSignalRef=SSecOC_MAC_BCM_01
        S_SSecOC_Fresh_BCM_01_Can_Network_Channel_CAN_Rx: ComSignalType=UINT8, ComBitSize=8, ComBitPosition=31, ComSignalInitValue=0, ComSystemTemplateSystemSignalRef=SSecOC_Fresh_BCM_01
        S_STAT_StartStopButton_Can_Network_Channel_CAN_Rx: ComSignalType=UINT8, ComBitSize=2, ComBitPosition=115, ComSignalInitValue=0, ComSystemTemplateSystemSignalRef=STAT_StartStopButton
        S_BCM_Cl30R_Off_Announcement_Can_Network_Channel_CAN_Rx: ComSignalType=UINT8, ComBitSize=2, ComBitPosition=125, ComSignalInitValue=0, ComSystemTemplateSystemSignalRef=BCM_Cl30R_Off_Announcement
        S_BCM_Cl30s_Off_Announcement_Can_Network_Channel_CAN_Rx: ComSignalType=UINT8, ComBitSize=2, ComBitPosition=127, ComSignalInitValue=0, ComSystemTemplateSystemSignalRef=BCM_Cl30s_Off_Announcement
        S_BCM_STAT_TransportMode_Can_Network_Channel_CAN_Rx: ComSignalType=UINT8, ComBitSize=2, ComBitPosition=117, ComSignalInitValue=0, ComSystemTemplateSystemSignalRef=BCM_STAT_TransportMode
        S_BCM_KL15_Off_Announcement_Can_Network_Channel_CAN_Rx: ComSignalType=UINT8, ComBitSize=2, ComBitPosition=119, ComSignalInitValue=0, ComSystemTemplateSystemSignalRef=BCM_KL15_Off_Announcement
        S_BCM_ST_KL_Can_Network_Channel_CAN_Rx: ComSignalType=UINT8, ComBitSize=4, ComBitPosition=108, ComSignalInitValue=0, ComSystemTemplateSystemSignalRef=BCM_ST_KL
        S_BCM_STAT_Terminal_Can_Network_Channel_CAN_Rx: ComSignalType=UINT8, ComBitSize=3, ComBitPosition=111, ComSignalInitValue=0, ComSystemTemplateSystemSignalRef=BCM_STAT_Terminal
        S_BCM_STAT_CL30R_L_Can_Network_Channel_CAN_Rx: ComNotification=Rte_COMCbk_S_BCM_STAT_CL30R_L_Can_Network_Channel_CAN_Rx, ComSignalType=UINT8, ComBitSize=2, ComBitPosition=99, ComSignalInitValue=3, ComTimeoutNotification=Rte_COMCbkTOut_S_BCM_STAT_CL30R_L_Can_Network_Channel_CAN_Rx, ComSystemTemplateSystemSignalRef=BCM_STAT_CL30R_L
        S_BCM_STAT_CL30s_L_Can_Network_Channel_CAN_Rx: ComSignalType=UINT8, ComBitSize=2, ComBitPosition=101, ComSignalInitValue=3, ComSystemTemplateSystemSignalRef=BCM_STAT_CL30s_L
        S_CRC_BCM_01_Can_Network_Channel_CAN_Rx: ComSignalType=UINT16, ComBitSize=16, ComBitPosition=7, ComSignalInitValue=0, ComSystemTemplateSystemSignalRef=CRC_BCM_01
        S_ALIVE_BCM_01_Can_Network_Channel_CAN_Rx: ComSignalType=UINT8, ComBitSize=8, ComBitPosition=23, ComSignalInitValue=0, ComSystemTemplateSystemSignalRef=ALIVE_BCM_01
        S_BCM_STAT_CL15_L_Can_Network_Channel_CAN_Rx: ComSignalType=UINT8, ComBitSize=2, ComBitPosition=103, ComSignalInitValue=3, ComSystemTemplateSystemSignalRef=BCM_STAT_CL15_L
      IP_CGW_01_CON_VEH_Can_Network_Channel_CAN_Rx (ComIPdu):
        ComIPduDirection = RECEIVE
        ComIPduSignalProcessing = IMMEDIATE
        ComIPduType = NORMAL
        ComIPduSignalRef = S_SSecOC_MAC_CGW_01_Can_Network_Channel_CAN_Rx
        ComIPduSignalRef = S_ALIVE_CGW_01_Can_Network_Channel_CAN_Rx
        ComIPduSignalRef = S_CRC_CGW_01_Can_Network_Channel_CAN_Rx
        ComIPduSignalRef = S_VEH_State_Can_Network_Channel_CAN_Rx
        ComIPduSignalRef = S_SSecOC_Fresh_CGW_01_Can_Network_Channel_CAN_Rx
        ComIPduSignalRef = S_CGW_OBDConnectStatus_Can_Network_Channel_CAN_Rx
        ComIPduGroupRef = ComIPduGroup_Rx
        ComPduIdRef = EcucPduCollection/CGW_01_CON_VEH_PduR2Com_Can_Network_Channel_CAN
      6 x ComSignal, all with ComSignalEndianness=BIG_ENDIAN, ComTransferProperty=TRIGGERED, ComSignalInitValue=0:
        S_SSecOC_MAC_CGW_01_Can_Network_Channel_CAN_Rx: ComSignalType=UINT64, ComBitSize=64, ComBitPosition=39, ComSystemTemplateSystemSignalRef=SSecOC_MAC_CGW_01
        S_ALIVE_CGW_01_Can_Network_Channel_CAN_Rx: ComSignalType=UINT8, ComBitSize=8, ComBitPosition=23, ComSystemTemplateSystemSignalRef=ALIVE_CGW_01
        S_CRC_CGW_01_Can_Network_Channel_CAN_Rx: ComSignalType=UINT16, ComBitSize=16, ComBitPosition=7, ComSystemTemplateSystemSignalRef=CRC_CGW_01
        S_VEH_State_Can_Network_Channel_CAN_Rx: ComSignalType=UINT8, ComBitSize=4, ComBitPosition=103, ComSystemTemplateSystemSignalRef=VEH_State
        S_SSecOC_Fresh_CGW_01_Can_Network_Channel_CAN_Rx: ComSignalType=UINT8, ComBitSize=8, ComBitPosition=31, ComSystemTemplateSystemSignalRef=SSecOC_Fresh_CGW_01
        S_CGW_OBDConnectStatus_Can_Network_Channel_CAN_Rx: ComSignalType=UINT8, ComBitSize=2, ComBitPosition=99, ComSystemTemplateSystemSignalRef=CGW_OBDConnectStatus
      IP_ESC_01_VeloSpeed_Can_Network_Channel_CAN_Rx (ComIPdu):
        ComIPduDirection = RECEIVE
        ComIPduSignalProcessing = IMMEDIATE
        ComIPduType = NORMAL
        ComIPduSignalRef = S_ESC_VehSpdLat_Q_Can_Network_Channel_CAN_Rx
        ComIPduSignalRef = S_ESC_VehSpdLat_Can_Network_Channel_CAN_Rx
        ComIPduSignalRef = S_SSecOC_MAC_ESC_01_Can_Network_Channel_CAN_Rx
        ComIPduSignalRef = S_SSecOC_Fresh_ESC_01_Can_Network_Channel_CAN_Rx
        ComIPduSignalRef = S_ESC_WhlTck_RR_Q_Can_Network_Channel_CAN_Rx
        ComIPduSignalRef = S_ESC_WhlTck_RL_Q_Can_Network_Channel_CAN_Rx
        ComIPduSignalRef = S_ESC_WhlTck_FR_Q_Can_Network_Channel_CAN_Rx
        ComIPduSignalRef = S_ESC_WhlTck_RR_Can_Network_Channel_CAN_Rx
        ComIPduSignalRef = S_ESC_WhlTck_RL_Can_Network_Channel_CAN_Rx
        ComIPduSignalRef = S_ESC_WhlTck_FR_Can_Network_Channel_CAN_Rx
        ComIPduSignalRef = S_ESC_WhlTck_FL_Q_Can_Network_Channel_CAN_Rx
        ComIPduSignalRef = S_ESC_WhlTck_FL_Can_Network_Channel_CAN_Rx
        ComIPduSignalRef = S_ESC_WhlSpd_RR_Q_Can_Network_Channel_CAN_Rx
        ComIPduSignalRef = S_ESC_WhlSpd_RR_Can_Network_Channel_CAN_Rx
        ComIPduSignalRef = S_ESC_WhlSpd_RL_Q_Can_Network_Channel_CAN_Rx
        ComIPduSignalRef = S_ESC_WhlSpd_RL_Can_Network_Channel_CAN_Rx
        ComIPduSignalRef = S_ESC_WhlSpd_FR_Q_Can_Network_Channel_CAN_Rx
        ComIPduSignalRef = S_ESC_WhlSpd_FR_Can_Network_Channel_CAN_Rx
        ComIPduSignalRef = S_ESC_WhlSpd_FL_Q_Can_Network_Channel_CAN_Rx
        ComIPduSignalRef = S_ESC_WhlSpd_FL_Can_Network_Channel_CAN_Rx
        ComIPduSignalRef = S_ESC_VehDrvCond_Q_Can_Network_Channel_CAN_Rx
        ComIPduSignalRef = S_ESC_DrivDist_Q_Can_Network_Channel_CAN_Rx
        ComIPduSignalRef = S_ALIVE_ESC_01_Can_Network_Channel_CAN_Rx
        ComIPduSignalRef = S_CRC_ESC_01_Can_Network_Channel_CAN_Rx
        ComIPduSignalRef = S_ESC_DrivDist_Can_Network_Channel_CAN_Rx
        ComIPduSignalRef = S_ESC_VehDrvCond_Can_Network_Channel_CAN_Rx
        ComIPduSignalRef = S_ESC_VehSpd_Q_Can_Network_Channel_CAN_Rx
        ComIPduSignalRef = S_ESC_VehSpd_Can_Network_Channel_CAN_Rx
        ComIPduGroupRef = ComIPduGroup_Rx
        ComPduIdRef = EcucPduCollection/ESC_01_VeloSpeed_PduR2Com_Can_Network_Channel_CAN
      28 x ComSignal, all with ComSignalEndianness=BIG_ENDIAN, ComTransferProperty=TRIGGERED, ComSignalInitValue=0:
        S_ESC_VehSpdLat_Q_Can_Network_Channel_CAN_Rx: ComSignalType=UINT8, ComBitSize=4, ComBitPosition=311, ComSystemTemplateSystemSignalRef=ESC_VehSpdLat_Q
        S_ESC_VehSpdLat_Can_Network_Channel_CAN_Rx: ComSignalType=UINT16, ComBitSize=16, ComBitPosition=295, ComSystemTemplateSystemSignalRef=ESC_VehSpdLat
        S_SSecOC_MAC_ESC_01_Can_Network_Channel_CAN_Rx: ComSignalType=UINT64, ComBitSize=64, ComBitPosition=39, ComSystemTemplateSystemSignalRef=SSecOC_MAC_ESC_01
        S_SSecOC_Fresh_ESC_01_Can_Network_Channel_CAN_Rx: ComSignalType=UINT8, ComBitSize=8, ComBitPosition=31, ComSystemTemplateSystemSignalRef=SSecOC_Fresh_ESC_01
        S_ESC_WhlTck_RR_Q_Can_Network_Channel_CAN_Rx: ComSignalType=UINT8, ComBitSize=2, ComBitPosition=283, ComSystemTemplateSystemSignalRef=ESC_WhlTck_RR_Q
        S_ESC_WhlTck_RL_Q_Can_Network_Channel_CAN_Rx: ComSignalType=UINT8, ComBitSize=2, ComBitPosition=287, ComSystemTemplateSystemSignalRef=ESC_WhlTck_RL_Q
        S_ESC_WhlTck_FR_Q_Can_Network_Channel_CAN_Rx: ComSignalType=UINT8, ComBitSize=2, ComBitPosition=275, ComSystemTemplateSystemSignalRef=ESC_WhlTck_FR_Q
        S_ESC_WhlTck_RR_Can_Network_Channel_CAN_Rx: ComSignalType=UINT8, ComBitSize=8, ComBitPosition=271, ComSystemTemplateSystemSignalRef=ESC_WhlTck_RR
        S_ESC_WhlTck_RL_Can_Network_Channel_CAN_Rx: ComSignalType=UINT8, ComBitSize=8, ComBitPosition=263, ComSystemTemplateSystemSignalRef=ESC_WhlTck_RL
        S_ESC_WhlTck_FR_Can_Network_Channel_CAN_Rx: ComSignalType=UINT8, ComBitSize=8, ComBitPosition=255, ComSystemTemplateSystemSignalRef=ESC_WhlTck_FR
        S_ESC_WhlTck_FL_Q_Can_Network_Channel_CAN_Rx: ComSignalType=UINT8, ComBitSize=2, ComBitPosition=279, ComSystemTemplateSystemSignalRef=ESC_WhlTck_FL_Q
        S_ESC_WhlTck_FL_Can_Network_Channel_CAN_Rx: ComSignalType=UINT8, ComBitSize=8, ComBitPosition=247, ComSystemTemplateSystemSignalRef=ESC_WhlTck_FL
        S_ESC_WhlSpd_RR_Q_Can_Network_Channel_CAN_Rx: ComSignalType=UINT8, ComBitSize=2, ComBitPosition=223, ComSystemTemplateSystemSignalRef=ESC_WhlSpd_RR_Q
        S_ESC_WhlSpd_RR_Can_Network_Channel_CAN_Rx: ComSignalType=SINT16, ComBitSize=16, ComBitPosition=207, ComSystemTemplateSystemSignalRef=ESC_WhlSpd_RR
        S_ESC_WhlSpd_RL_Q_Can_Network_Channel_CAN_Rx: ComSignalType=UINT8, ComBitSize=2, ComBitPosition=199, ComSystemTemplateSystemSignalRef=ESC_WhlSpd_RL_Q
        S_ESC_WhlSpd_RL_Can_Network_Channel_CAN_Rx: ComSignalType=SINT16, ComBitSize=16, ComBitPosition=183, ComSystemTemplateSystemSignalRef=ESC_WhlSpd_RL
        S_ESC_WhlSpd_FR_Q_Can_Network_Channel_CAN_Rx: ComSignalType=UINT8, ComBitSize=2, ComBitPosition=175, ComSystemTemplateSystemSignalRef=ESC_WhlSpd_FR_Q
        S_ESC_WhlSpd_FR_Can_Network_Channel_CAN_Rx: ComSignalType=SINT16, ComBitSize=16, ComBitPosition=159, ComSystemTemplateSystemSignalRef=ESC_WhlSpd_FR
        S_ESC_WhlSpd_FL_Q_Can_Network_Channel_CAN_Rx: ComSignalType=UINT8, ComBitSize=2, ComBitPosition=151, ComSystemTemplateSystemSignalRef=ESC_WhlSpd_FL_Q
        S_ESC_WhlSpd_FL_Can_Network_Channel_CAN_Rx: ComSignalType=SINT16, ComBitSize=16, ComBitPosition=135, ComSystemTemplateSystemSignalRef=ESC_WhlSpd_FL
        S_ESC_VehDrvCond_Q_Can_Network_Channel_CAN_Rx: ComSignalType=UINT8, ComBitSize=2, ComBitPosition=127, ComSystemTemplateSystemSignalRef=ESC_VehDrvCond_Q
        S_ESC_DrivDist_Q_Can_Network_Channel_CAN_Rx: ComSignalType=UINT8, ComBitSize=2, ComBitPosition=219, ComSystemTemplateSystemSignalRef=ESC_DrivDist_Q
        S_ALIVE_ESC_01_Can_Network_Channel_CAN_Rx: ComSignalType=UINT8, ComBitSize=8, ComBitPosition=23, ComSystemTemplateSystemSignalRef=ALIVE_ESC_01
        S_CRC_ESC_01_Can_Network_Channel_CAN_Rx: ComSignalType=UINT16, ComBitSize=16, ComBitPosition=7, ComSystemTemplateSystemSignalRef=CRC_ESC_01
        S_ESC_DrivDist_Can_Network_Channel_CAN_Rx: ComSignalType=UINT16, ComBitSize=16, ComBitPosition=231, ComSystemTemplateSystemSignalRef=ESC_DrivDist
        S_ESC_VehDrvCond_Can_Network_Channel_CAN_Rx: ComSignalType=UINT8, ComBitSize=2, ComBitPosition=115, ComSystemTemplateSystemSignalRef=ESC_VehDrvCond
        S_ESC_VehSpd_Q_Can_Network_Channel_CAN_Rx: ComSignalType=UINT8, ComBitSize=2, ComBitPosition=119, ComSystemTemplateSystemSignalRef=ESC_VehSpd_Q
        S_ESC_VehSpd_Can_Network_Channel_CAN_Rx: ComSignalType=UINT16, ComBitSize=16, ComBitPosition=103, ComSystemTemplateSystemSignalRef=ESC_VehSpd
      IP_ESC_05_OTA_Can_Network_Channel_CAN_Rx (ComIPdu):
        ComIPduDirection = RECEIVE
        ComIPduSignalProcessing = IMMEDIATE
        ComIPduType = NORMAL
        ComIPduSignalRef = S_ALIVE_ESC_05_Can_Network_Channel_CAN_Rx
        ComIPduSignalRef = S_CRC_ESC_05_Can_Network_Channel_CAN_Rx
        ComIPduSignalRef = S_ESC_OTA_inhib_FB_Can_Network_Channel_CAN_Rx
        ComIPduGroupRef = ComIPduGroup_Rx
        ComPduIdRef = EcucPduCollection/ESC_05_OTA_PduR2Com_Can_Network_Channel_CAN
      3 x ComSignal, all with ComSignalEndianness=BIG_ENDIAN, ComTransferProperty=TRIGGERED, ComSignalInitValue=0:
        S_ALIVE_ESC_05_Can_Network_Channel_CAN_Rx: ComSignalType=UINT8, ComBitSize=8, ComBitPosition=23, ComSystemTemplateSystemSignalRef=ALIVE_ESC_05
        S_CRC_ESC_05_Can_Network_Channel_CAN_Rx: ComSignalType=UINT16, ComBitSize=16, ComBitPosition=7, ComSystemTemplateSystemSignalRef=CRC_ESC_05
        S_ESC_OTA_inhib_FB_Can_Network_Channel_CAN_Rx: ComSignalType=UINT8, ComBitSize=2, ComBitPosition=103, ComSystemTemplateSystemSignalRef=ESC_OTA_inhib_FB
      IP_HU_01_OTA_Can_Network_Channel_CAN_Rx (ComIPdu):
        ComIPduDirection = RECEIVE
        ComIPduSignalProcessing = IMMEDIATE
        ComIPduType = NORMAL
        ComIPduSignalRef = S_ALIVE_HU_01_Can_Network_Channel_CAN_Rx
        ComIPduSignalRef = S_CRC_HU_01_Can_Network_Channel_CAN_Rx
        ComIPduSignalRef = S_HU_OTA_UpdateConfirm_Can_Network_Channel_CAN_Rx
        ComIPduGroupRef = ComIPduGroup_Rx
        ComPduIdRef = EcucPduCollection/HU_01_OTA_PduR2Com_Can_Network_Channel_CAN
      3 x ComSignal, all with ComSignalEndianness=BIG_ENDIAN, ComTransferProperty=TRIGGERED, ComSignalInitValue=0:
        S_ALIVE_HU_01_Can_Network_Channel_CAN_Rx: ComSignalType=UINT8, ComBitSize=8, ComBitPosition=23, ComSystemTemplateSystemSignalRef=ALIVE_HU_01
        S_CRC_HU_01_Can_Network_Channel_CAN_Rx: ComSignalType=UINT16, ComBitSize=16, ComBitPosition=7, ComSystemTemplateSystemSignalRef=CRC_HU_01
        S_HU_OTA_UpdateConfirm_Can_Network_Channel_CAN_Rx: ComSignalType=UINT8, ComBitSize=3, ComBitPosition=103, ComSystemTemplateSystemSignalRef=HU_OTA_UpdateConfirm
      IP_HU_03_SET_FUNC_Can_Network_Channel_CAN_Rx (ComIPdu):
        ComIPduDirection = RECEIVE
        ComIPduSignalProcessing = IMMEDIATE
        ComIPduType = NORMAL
        ComIPduSignalRef = S_SET_TowMode_Can_Network_Channel_CAN_Rx
        ComIPduSignalRef = S_ALIVE_HU_03_Can_Network_Channel_CAN_Rx
        ComIPduSignalRef = S_CRC_HU_03_Can_Network_Channel_CAN_Rx
        ComIPduSignalRef = S_SteeringHeatingRequest_Can_Network_Channel_CAN_Rx
        ComIPduSignalRef = S_SET_InteriorMotionSensing_Can_Network_Channel_CAN_Rx
        ComIPduSignalRef = S_SET_RCP_Button_Can_Network_Channel_CAN_Rx
        ComIPduSignalRef = S_DimmingVehicleBrightness_Can_Network_Channel_CAN_Rx
        ComIPduSignalRef = S_SET_DayTimeRunningLight_Can_Network_Channel_CAN_Rx
        ComIPduSignalRef = S_SET_LeavingHomeSetting_Can_Network_Channel_CAN_Rx
        ComIPduSignalRef = S_SET_ComingHomeSetting_Can_Network_Channel_CAN_Rx
        ComIPduSignalRef = S_SET_ToDefaultFactorySetting_Can_Network_Channel_CAN_Rx
        ComIPduSignalRef = S_SET_RemoteLockFeedback_Can_Network_Channel_CAN_Rx
        ComIPduGroupRef = ComIPduGroup_Rx
        ComPduIdRef = EcucPduCollection/HU_03_SET_FUNC_PduR2Com_Can_Network_Channel_CAN
      12 x ComSignal, all with ComSignalEndianness=BIG_ENDIAN, ComTransferProperty=TRIGGERED, ComSignalInitValue=0:
        S_SET_TowMode_Can_Network_Channel_CAN_Rx: ComSignalType=UINT8, ComBitSize=2, ComBitPosition=127, ComSystemTemplateSystemSignalRef=SET_TowMode
        S_ALIVE_HU_03_Can_Network_Channel_CAN_Rx: ComSignalType=UINT8, ComBitSize=8, ComBitPosition=23, ComSystemTemplateSystemSignalRef=ALIVE_HU_03
        S_CRC_HU_03_Can_Network_Channel_CAN_Rx: ComSignalType=UINT16, ComBitSize=16, ComBitPosition=7, ComSystemTemplateSystemSignalRef=CRC_HU_03
        S_SteeringHeatingRequest_Can_Network_Channel_CAN_Rx: ComSignalType=UINT8, ComBitSize=2, ComBitPosition=117, ComSystemTemplateSystemSignalRef=SteeringHeatingRequest
        S_SET_InteriorMotionSensing_Can_Network_Channel_CAN_Rx: ComSignalType=UINT8, ComBitSize=2, ComBitPosition=119, ComSystemTemplateSystemSignalRef=SET_InteriorMotionSensing
        S_SET_RCP_Button_Can_Network_Channel_CAN_Rx: ComSignalType=UINT8, ComBitSize=2, ComBitPosition=113, ComSystemTemplateSystemSignalRef=SET_RCP_Button
        S_DimmingVehicleBrightness_Can_Network_Channel_CAN_Rx: ComSignalType=UINT8, ComBitSize=8, ComBitPosition=111, ComSystemTemplateSystemSignalRef=DimmingVehicleBrightness
        S_SET_DayTimeRunningLight_Can_Network_Channel_CAN_Rx: ComSignalType=UINT8, ComBitSize=2, ComBitPosition=103, ComSystemTemplateSystemSignalRef=SET_DayTimeRunningLight
        S_SET_LeavingHomeSetting_Can_Network_Channel_CAN_Rx: ComSignalType=UINT8, ComBitSize=3, ComBitPosition=98, ComSystemTemplateSystemSignalRef=SET_LeavingHomeSetting
        S_SET_ComingHomeSetting_Can_Network_Channel_CAN_Rx: ComSignalType=UINT8, ComBitSize=3, ComBitPosition=101, ComSystemTemplateSystemSignalRef=SET_ComingHomeSetting
        S_SET_ToDefaultFactorySetting_Can_Network_Channel_CAN_Rx: ComSignalType=UINT8, ComBitSize=2, ComBitPosition=115, ComSystemTemplateSystemSignalRef=SET_ToDefaultFactorySetting
        S_SET_RemoteLockFeedback_Can_Network_Channel_CAN_Rx: ComSignalType=UINT8, ComBitSize=2, ComBitPosition=125, ComSystemTemplateSystemSignalRef=SET_RemoteLockFeedback
      IP_NM_EPS_Can_Network_Channel_CAN_Rx (ComIPdu):
        ComIPduDirection = RECEIVE
        ComIPduSignalProcessing = IMMEDIATE
        ComIPduType = NORMAL
        ComIPduSignalRef = S_usrData1_EPS_Bit7_ECUSPEC_AWAKE_Can_Network_Channel_CAN_Rx
        ComIPduSignalRef = S_usrData1_EPS_Bit6_DIAGN_AWAKE_Can_Network_Channel_CAN_Rx
        ComIPduSignalRef = S_usrData1_EPS_Bit5_IGNITION_AWAKE_Can_Network_Channel_CAN_Rx
        ComIPduSignalRef = S_usrData1_EPS_Bit4_NETWORK_AWAKE_Can_Network_Channel_CAN_Rx
        ComIPduSignalRef = S_usrData1_EPS_Bit3_ECUSPEC_WAKEUP_Can_Network_Channel_CAN_Rx
        ComIPduSignalRef = S_usrData1_EPS_Bit2_NETWORK_WAKEUP_Can_Network_Channel_CAN_Rx
        ComIPduSignalRef = S_usrData1_EPS_Bit1_RESET_WAKEUP_Can_Network_Channel_CAN_Rx
        ComIPduSignalRef = S_CtrlBitVector_EPS_Bit7_Res_Can_Network_Channel_CAN_Rx
        ComIPduSignalRef = S_CtrlBitVector_EPS_Bit6_PNI_Can_Network_Channel_CAN_Rx
        ComIPduSignalRef = S_CtrlBitVector_EPS_Bit5_Res_Can_Network_Channel_CAN_Rx
        ComIPduSignalRef = S_CtrlBitVector_EPS_Bit4_ActWake_Can_Network_Channel_CAN_Rx
        ComIPduSignalRef = S_CtrlBitVector_EPS_Bit3_NMCoord_Can_Network_Channel_CAN_Rx
        ComIPduSignalRef = S_CtrlBitVector_EPS_Bit2_Res_Can_Network_Channel_CAN_Rx
        ComIPduSignalRef = S_CtrlBitVector_EPS_Bit1_Res_Can_Network_Channel_CAN_Rx
        ComIPduSignalRef = S_usrData1_EPS_Bit0_IGN_WAKEUP_Can_Network_Channel_CAN_Rx
        ComIPduSignalRef = S_usrData0_EPS_Can_Network_Channel_CAN_Rx
        ComIPduSignalRef = S_srcNodeID_EPS_Can_Network_Channel_CAN_Rx
        ComIPduSignalRef = S_CtrlBitVector_EPS_Bit0_RMR_Can_Network_Channel_CAN_Rx
        ComIPduSignalRef = S_usrData2_EPS_Can_Network_Channel_CAN_Rx
        ComIPduSignalRef = S_usrData4_EPS_PN_Info1_Can_Network_Channel_CAN_Rx
        ComIPduSignalRef = S_usrData5_EPS_PN_Info2_Can_Network_Channel_CAN_Rx
        ComIPduSignalRef = S_usrData3_EPS_Can_Network_Channel_CAN_Rx
        ComIPduGroupRef = ComIPduGroup_Rx
        ComPduIdRef = EcucPduCollection/NM_EPS_PduR2Com_Can_Network_Channel_CAN
      22 x ComSignal, all with ComSignalType=UINT8, ComSignalEndianness=BIG_ENDIAN, ComTransferProperty=TRIGGERED, ComSignalInitValue=0:
        S_usrData1_EPS_Bit7_ECUSPEC_AWAKE_Can_Network_Channel_CAN_Rx: ComBitSize=1, ComBitPosition=31, ComSystemTemplateSystemSignalRef=usrData1_EPS_Bit7_ECUSPEC_AWAKE
        S_usrData1_EPS_Bit6_DIAGN_AWAKE_Can_Network_Channel_CAN_Rx: ComBitSize=1, ComBitPosition=30, ComSystemTemplateSystemSignalRef=usrData1_EPS_Bit6_DIAGN_AWAKE
        S_usrData1_EPS_Bit5_IGNITION_AWAKE_Can_Network_Channel_CAN_Rx: ComBitSize=1, ComBitPosition=29, ComSystemTemplateSystemSignalRef=usrData1_EPS_Bit5_IGNITION_AWAKE
        S_usrData1_EPS_Bit4_NETWORK_AWAKE_Can_Network_Channel_CAN_Rx: ComBitSize=1, ComBitPosition=28, ComSystemTemplateSystemSignalRef=usrData1_EPS_Bit4_NETWORK_AWAKE
        S_usrData1_EPS_Bit3_ECUSPEC_WAKEUP_Can_Network_Channel_CAN_Rx: ComBitSize=1, ComBitPosition=27, ComSystemTemplateSystemSignalRef=usrData1_EPS_Bit3_ECUSPEC_WAKEUP
        S_usrData1_EPS_Bit2_NETWORK_WAKEUP_Can_Network_Channel_CAN_Rx: ComBitSize=1, ComBitPosition=26, ComSystemTemplateSystemSignalRef=usrData1_EPS_Bit2_NETWORK_WAKEUP
        S_usrData1_EPS_Bit1_RESET_WAKEUP_Can_Network_Channel_CAN_Rx: ComBitSize=1, ComBitPosition=25, ComSystemTemplateSystemSignalRef=usrData1_EPS_Bit1_RESET_WAKEUP
        S_CtrlBitVector_EPS_Bit7_Res_Can_Network_Channel_CAN_Rx: ComBitSize=1, ComBitPosition=15, ComSystemTemplateSystemSignalRef=CtrlBitVector_EPS_Bit7_Res
        S_CtrlBitVector_EPS_Bit6_PNI_Can_Network_Channel_CAN_Rx: ComBitSize=1, ComBitPosition=14, ComSystemTemplateSystemSignalRef=CtrlBitVector_EPS_Bit6_PNI
        S_CtrlBitVector_EPS_Bit5_Res_Can_Network_Channel_CAN_Rx: ComBitSize=1, ComBitPosition=13, ComSystemTemplateSystemSignalRef=CtrlBitVector_EPS_Bit5_Res
        S_CtrlBitVector_EPS_Bit4_ActWake_Can_Network_Channel_CAN_Rx: ComBitSize=1, ComBitPosition=12, ComSystemTemplateSystemSignalRef=CtrlBitVector_EPS_Bit4_ActWake
        S_CtrlBitVector_EPS_Bit3_NMCoord_Can_Network_Channel_CAN_Rx: ComBitSize=1, ComBitPosition=11, ComSystemTemplateSystemSignalRef=CtrlBitVector_EPS_Bit3_NMCoord
        S_CtrlBitVector_EPS_Bit2_Res_Can_Network_Channel_CAN_Rx: ComBitSize=1, ComBitPosition=10, ComSystemTemplateSystemSignalRef=CtrlBitVector_EPS_Bit2_Res
        S_CtrlBitVector_EPS_Bit1_Res_Can_Network_Channel_CAN_Rx: ComBitSize=1, ComBitPosition=9, ComSystemTemplateSystemSignalRef=CtrlBitVector_EPS_Bit1_Res
        S_usrData1_EPS_Bit0_IGN_WAKEUP_Can_Network_Channel_CAN_Rx: ComBitSize=1, ComBitPosition=24, ComSystemTemplateSystemSignalRef=usrData1_EPS_Bit0_IGN_WAKEUP
        S_usrData0_EPS_Can_Network_Channel_CAN_Rx: ComBitSize=8, ComBitPosition=23, ComSystemTemplateSystemSignalRef=usrData0_EPS
        S_srcNodeID_EPS_Can_Network_Channel_CAN_Rx: ComBitSize=8, ComBitPosition=7, ComSystemTemplateSystemSignalRef=srcNodeID_EPS
        S_CtrlBitVector_EPS_Bit0_RMR_Can_Network_Channel_CAN_Rx: ComBitSize=1, ComBitPosition=8, ComSystemTemplateSystemSignalRef=CtrlBitVector_EPS_Bit0_RMR
        S_usrData2_EPS_Can_Network_Channel_CAN_Rx: ComBitSize=8, ComBitPosition=39, ComSystemTemplateSystemSignalRef=usrData2_EPS
        S_usrData4_EPS_PN_Info1_Can_Network_Channel_CAN_Rx: ComBitSize=8, ComBitPosition=55, ComSystemTemplateSystemSignalRef=usrData4_EPS_PN_Info1
        S_usrData5_EPS_PN_Info2_Can_Network_Channel_CAN_Rx: ComBitSize=8, ComBitPosition=63, ComSystemTemplateSystemSignalRef=usrData5_EPS_PN_Info2
        S_usrData3_EPS_Can_Network_Channel_CAN_Rx: ComBitSize=8, ComBitPosition=47, ComSystemTemplateSystemSignalRef=usrData3_EPS
      IP_NM_ESC_Can_Network_Channel_CAN_Rx (ComIPdu):
        ComIPduDirection = RECEIVE
        ComIPduSignalProcessing = IMMEDIATE
        ComIPduType = NORMAL
        ComIPduSignalRef = S_usrData1_ESC_Bit7_ECUSPEC_AWAKE_Can_Network_Channel_CAN_Rx
        ComIPduSignalRef = S_usrData1_ESC_Bit6_DIAGN_AWAKE_Can_Network_Channel_CAN_Rx
        ComIPduSignalRef = S_usrData1_ESC_Bit5_IGNITION_AWAKE_Can_Network_Channel_CAN_Rx
        ComIPduSignalRef = S_usrData1_ESC_Bit4_NETWORK_AWAKE_Can_Network_Channel_CAN_Rx
        ComIPduSignalRef = S_usrData1_ESC_Bit3_ECUSPEC_WAKEUP_Can_Network_Channel_CAN_Rx
        ComIPduSignalRef = S_usrData1_ESC_Bit2_NETWORK_WAKEUP_Can_Network_Channel_CAN_Rx
        ComIPduSignalRef = S_usrData1_ESC_Bit1_RESET_WAKEUP_Can_Network_Channel_CAN_Rx
        ComIPduSignalRef = S_CtrlBitVector_ESC_Bit7_Res_Can_Network_Channel_CAN_Rx
        ComIPduSignalRef = S_CtrlBitVector_ESC_Bit6_PNI_Can_Network_Channel_CAN_Rx
        ComIPduSignalRef = S_CtrlBitVector_ESC_Bit5_Res_Can_Network_Channel_CAN_Rx
        ComIPduSignalRef = S_CtrlBitVector_ESC_Bit4_ActWake_Can_Network_Channel_CAN_Rx
        ComIPduSignalRef = S_CtrlBitVector_ESC_Bit3_NMCoord_Can_Network_Channel_CAN_Rx
        ComIPduSignalRef = S_CtrlBitVector_ESC_Bit2_Res_Can_Network_Channel_CAN_Rx
        ComIPduSignalRef = S_CtrlBitVector_ESC_Bit1_Res_Can_Network_Channel_CAN_Rx
        ComIPduSignalRef = S_usrData1_ESC_Bit0_IGN_WAKEUP_Can_Network_Channel_CAN_Rx
        ComIPduSignalRef = S_usrData0_ESC_Can_Network_Channel_CAN_Rx
        ComIPduSignalRef = S_srcNodeID_ESC_Can_Network_Channel_CAN_Rx
        ComIPduSignalRef = S_CtrlBitVector_ESC_Bit0_RMR_Can_Network_Channel_CAN_Rx
        ComIPduSignalRef = S_usrData2_ESC_Can_Network_Channel_CAN_Rx
        ComIPduSignalRef = S_usrData4_ESC_PN_Info1_Can_Network_Channel_CAN_Rx
        ComIPduSignalRef = S_usrData5_ESC_PN_Info2_Can_Network_Channel_CAN_Rx
        ComIPduSignalRef = S_usrData3_ESC_Can_Network_Channel_CAN_Rx
        ComIPduGroupRef = ComIPduGroup_Rx
        ComPduIdRef = EcucPduCollection/NM_ESC_PduR2Com_Can_Network_Channel_CAN
      22 x ComSignal, all with ComSignalType=UINT8, ComSignalEndianness=BIG_ENDIAN, ComTransferProperty=TRIGGERED, ComSignalInitValue=0:
        S_usrData1_ESC_Bit7_ECUSPEC_AWAKE_Can_Network_Channel_CAN_Rx: ComBitSize=1, ComBitPosition=31, ComSystemTemplateSystemSignalRef=usrData1_ESC_Bit7_ECUSPEC_AWAKE
        S_usrData1_ESC_Bit6_DIAGN_AWAKE_Can_Network_Channel_CAN_Rx: ComBitSize=1, ComBitPosition=30, ComSystemTemplateSystemSignalRef=usrData1_ESC_Bit6_DIAGN_AWAKE
        S_usrData1_ESC_Bit5_IGNITION_AWAKE_Can_Network_Channel_CAN_Rx: ComBitSize=1, ComBitPosition=29, ComSystemTemplateSystemSignalRef=usrData1_ESC_Bit5_IGNITION_AWAKE
        S_usrData1_ESC_Bit4_NETWORK_AWAKE_Can_Network_Channel_CAN_Rx: ComBitSize=1, ComBitPosition=28, ComSystemTemplateSystemSignalRef=usrData1_ESC_Bit4_NETWORK_AWAKE
        S_usrData1_ESC_Bit3_ECUSPEC_WAKEUP_Can_Network_Channel_CAN_Rx: ComBitSize=1, ComBitPosition=27, ComSystemTemplateSystemSignalRef=usrData1_ESC_Bit3_ECUSPEC_WAKEUP
        S_usrData1_ESC_Bit2_NETWORK_WAKEUP_Can_Network_Channel_CAN_Rx: ComBitSize=1, ComBitPosition=26, ComSystemTemplateSystemSignalRef=usrData1_ESC_Bit2_NETWORK_WAKEUP
        S_usrData1_ESC_Bit1_RESET_WAKEUP_Can_Network_Channel_CAN_Rx: ComBitSize=1, ComBitPosition=25, ComSystemTemplateSystemSignalRef=usrData1_ESC_Bit1_RESET_WAKEUP
        S_CtrlBitVector_ESC_Bit7_Res_Can_Network_Channel_CAN_Rx: ComBitSize=1, ComBitPosition=15, ComSystemTemplateSystemSignalRef=CtrlBitVector_ESC_Bit7_Res
        S_CtrlBitVector_ESC_Bit6_PNI_Can_Network_Channel_CAN_Rx: ComBitSize=1, ComBitPosition=14, ComSystemTemplateSystemSignalRef=CtrlBitVector_ESC_Bit6_PNI
        S_CtrlBitVector_ESC_Bit5_Res_Can_Network_Channel_CAN_Rx: ComBitSize=1, ComBitPosition=13, ComSystemTemplateSystemSignalRef=CtrlBitVector_ESC_Bit5_Res
        S_CtrlBitVector_ESC_Bit4_ActWake_Can_Network_Channel_CAN_Rx: ComBitSize=1, ComBitPosition=12, ComSystemTemplateSystemSignalRef=CtrlBitVector_ESC_Bit4_ActWake
        S_CtrlBitVector_ESC_Bit3_NMCoord_Can_Network_Channel_CAN_Rx: ComBitSize=1, ComBitPosition=11, ComSystemTemplateSystemSignalRef=CtrlBitVector_ESC_Bit3_NMCoord
        S_CtrlBitVector_ESC_Bit2_Res_Can_Network_Channel_CAN_Rx: ComBitSize=1, ComBitPosition=10, ComSystemTemplateSystemSignalRef=CtrlBitVector_ESC_Bit2_Res
        S_CtrlBitVector_ESC_Bit1_Res_Can_Network_Channel_CAN_Rx: ComBitSize=1, ComBitPosition=9, ComSystemTemplateSystemSignalRef=CtrlBitVector_ESC_Bit1_Res
        S_usrData1_ESC_Bit0_IGN_WAKEUP_Can_Network_Channel_CAN_Rx: ComBitSize=1, ComBitPosition=24, ComSystemTemplateSystemSignalRef=usrData1_ESC_Bit0_IGN_WAKEUP
        S_usrData0_ESC_Can_Network_Channel_CAN_Rx: ComBitSize=8, ComBitPosition=23, ComSystemTemplateSystemSignalRef=usrData0_ESC
        S_srcNodeID_ESC_Can_Network_Channel_CAN_Rx: ComBitSize=8, ComBitPosition=7, ComSystemTemplateSystemSignalRef=srcNodeID_ESC
        S_CtrlBitVector_ESC_Bit0_RMR_Can_Network_Channel_CAN_Rx: ComBitSize=1, ComBitPosition=8, ComSystemTemplateSystemSignalRef=CtrlBitVector_ESC_Bit0_RMR
        S_usrData2_ESC_Can_Network_Channel_CAN_Rx: ComBitSize=8, ComBitPosition=39, ComSystemTemplateSystemSignalRef=usrData2_ESC
        S_usrData4_ESC_PN_Info1_Can_Network_Channel_CAN_Rx: ComBitSize=8, ComBitPosition=55, ComSystemTemplateSystemSignalRef=usrData4_ESC_PN_Info1
        S_usrData5_ESC_PN_Info2_Can_Network_Channel_CAN_Rx: ComBitSize=8, ComBitPosition=63, ComSystemTemplateSystemSignalRef=usrData5_ESC_PN_Info2
        S_usrData3_ESC_Can_Network_Channel_CAN_Rx: ComBitSize=8, ComBitPosition=47, ComSystemTemplateSystemSignalRef=usrData3_ESC
      IP_NM_FCM_Can_Network_Channel_CAN_Rx (ComIPdu):
        ComIPduDirection = RECEIVE
        ComIPduSignalProcessing = IMMEDIATE
        ComIPduType = NORMAL
        ComIPduSignalRef = S_usrData1_FCM_Bit7_ECUSPEC_AWAKE_Can_Network_Channel_CAN_Rx
        ComIPduSignalRef = S_usrData1_FCM_Bit6_DIAGN_AWAKE_Can_Network_Channel_CAN_Rx
        ComIPduSignalRef = S_usrData1_FCM_Bit5_IGNITION_AWAKE_Can_Network_Channel_CAN_Rx
        ComIPduSignalRef = S_usrData1_FCM_Bit4_NETWORK_AWAKE_Can_Network_Channel_CAN_Rx
        ComIPduSignalRef = S_usrData1_FCM_Bit3_ECUSPEC_WAKEUP_Can_Network_Channel_CAN_Rx
        ComIPduSignalRef = S_usrData1_FCM_Bit2_NETWORK_WAKEUP_Can_Network_Channel_CAN_Rx
        ComIPduSignalRef = S_usrData1_FCM_Bit1_RESET_WAKEUP_Can_Network_Channel_CAN_Rx
        ComIPduSignalRef = S_CtrlBitVector_FCM_Bit7_Res_Can_Network_Channel_CAN_Rx
        ComIPduSignalRef = S_CtrlBitVector_FCM_Bit6_PNI_Can_Network_Channel_CAN_Rx
        ComIPduSignalRef = S_CtrlBitVector_FCM_Bit5_Res_Can_Network_Channel_CAN_Rx
        ComIPduSignalRef = S_CtrlBitVector_FCM_Bit4_ActWake_Can_Network_Channel_CAN_Rx
        ComIPduSignalRef = S_CtrlBitVector_FCM_Bit3_NMCoord_Can_Network_Channel_CAN_Rx
        ComIPduSignalRef = S_CtrlBitVector_FCM_Bit2_Res_Can_Network_Channel_CAN_Rx
        ComIPduSignalRef = S_CtrlBitVector_FCM_Bit1_Res_Can_Network_Channel_CAN_Rx
        ComIPduSignalRef = S_usrData1_FCM_Bit0_IGN_WAKEUP_Can_Network_Channel_CAN_Rx
        ComIPduSignalRef = S_usrData0_FCM_Can_Network_Channel_CAN_Rx
        ComIPduSignalRef = S_srcNodeID_FCM_Can_Network_Channel_CAN_Rx
        ComIPduSignalRef = S_CtrlBitVector_FCM_Bit0_RMR_Can_Network_Channel_CAN_Rx
        ComIPduSignalRef = S_usrData2_FCM_Can_Network_Channel_CAN_Rx
        ComIPduSignalRef = S_usrData4_FCM_PN_Info1_Can_Network_Channel_CAN_Rx
        ComIPduSignalRef = S_usrData5_FCM_PN_Info2_Can_Network_Channel_CAN_Rx
        ComIPduSignalRef = S_usrData3_FCM_Can_Network_Channel_CAN_Rx
        ComIPduGroupRef = ComIPduGroup_Rx
        ComPduIdRef = EcucPduCollection/NM_FCM_PduR2Com_Can_Network_Channel_CAN
      22 x ComSignal, all with ComSignalType=UINT8, ComSignalEndianness=BIG_ENDIAN, ComTransferProperty=TRIGGERED, ComSignalInitValue=0:
        S_usrData1_FCM_Bit7_ECUSPEC_AWAKE_Can_Network_Channel_CAN_Rx: ComBitSize=1, ComBitPosition=31, ComSystemTemplateSystemSignalRef=usrData1_FCM_Bit7_ECUSPEC_AWAKE
        S_usrData1_FCM_Bit6_DIAGN_AWAKE_Can_Network_Channel_CAN_Rx: ComBitSize=1, ComBitPosition=30, ComSystemTemplateSystemSignalRef=usrData1_FCM_Bit6_DIAGN_AWAKE
        S_usrData1_FCM_Bit5_IGNITION_AWAKE_Can_Network_Channel_CAN_Rx: ComBitSize=1, ComBitPosition=29, ComSystemTemplateSystemSignalRef=usrData1_FCM_Bit5_IGNITION_AWAKE
        S_usrData1_FCM_Bit4_NETWORK_AWAKE_Can_Network_Channel_CAN_Rx: ComBitSize=1, ComBitPosition=28, ComSystemTemplateSystemSignalRef=usrData1_FCM_Bit4_NETWORK_AWAKE
        S_usrData1_FCM_Bit3_ECUSPEC_WAKEUP_Can_Network_Channel_CAN_Rx: ComBitSize=1, ComBitPosition=27, ComSystemTemplateSystemSignalRef=usrData1_FCM_Bit3_ECUSPEC_WAKEUP
        S_usrData1_FCM_Bit2_NETWORK_WAKEUP_Can_Network_Channel_CAN_Rx: ComBitSize=1, ComBitPosition=26, ComSystemTemplateSystemSignalRef=usrData1_FCM_Bit2_NETWORK_WAKEUP
        S_usrData1_FCM_Bit1_RESET_WAKEUP_Can_Network_Channel_CAN_Rx: ComBitSize=1, ComBitPosition=25, ComSystemTemplateSystemSignalRef=usrData1_FCM_Bit1_RESET_WAKEUP
        S_CtrlBitVector_FCM_Bit7_Res_Can_Network_Channel_CAN_Rx: ComBitSize=1, ComBitPosition=15, ComSystemTemplateSystemSignalRef=CtrlBitVector_FCM_Bit7_Res
        S_CtrlBitVector_FCM_Bit6_PNI_Can_Network_Channel_CAN_Rx: ComBitSize=1, ComBitPosition=14, ComSystemTemplateSystemSignalRef=CtrlBitVector_FCM_Bit6_PNI
        S_CtrlBitVector_FCM_Bit5_Res_Can_Network_Channel_CAN_Rx: ComBitSize=1, ComBitPosition=13, ComSystemTemplateSystemSignalRef=CtrlBitVector_FCM_Bit5_Res
        S_CtrlBitVector_FCM_Bit4_ActWake_Can_Network_Channel_CAN_Rx: ComBitSize=1, ComBitPosition=12, ComSystemTemplateSystemSignalRef=CtrlBitVector_FCM_Bit4_ActWake
        S_CtrlBitVector_FCM_Bit3_NMCoord_Can_Network_Channel_CAN_Rx: ComBitSize=1, ComBitPosition=11, ComSystemTemplateSystemSignalRef=CtrlBitVector_FCM_Bit3_NMCoord
        S_CtrlBitVector_FCM_Bit2_Res_Can_Network_Channel_CAN_Rx: ComBitSize=1, ComBitPosition=10, ComSystemTemplateSystemSignalRef=CtrlBitVector_FCM_Bit2_Res
        S_CtrlBitVector_FCM_Bit1_Res_Can_Network_Channel_CAN_Rx: ComBitSize=1, ComBitPosition=9, ComSystemTemplateSystemSignalRef=CtrlBitVector_FCM_Bit1_Res
        S_usrData1_FCM_Bit0_IGN_WAKEUP_Can_Network_Channel_CAN_Rx: ComBitSize=1, ComBitPosition=24, ComSystemTemplateSystemSignalRef=usrData1_FCM_Bit0_IGN_WAKEUP
        S_usrData0_FCM_Can_Network_Channel_CAN_Rx: ComBitSize=8, ComBitPosition=23, ComSystemTemplateSystemSignalRef=usrData0_FCM
        S_srcNodeID_FCM_Can_Network_Channel_CAN_Rx: ComBitSize=8, ComBitPosition=7, ComSystemTemplateSystemSignalRef=srcNodeID_FCM
        S_CtrlBitVector_FCM_Bit0_RMR_Can_Network_Channel_CAN_Rx: ComBitSize=1, ComBitPosition=8, ComSystemTemplateSystemSignalRef=CtrlBitVector_FCM_Bit0_RMR
        S_usrData2_FCM_Can_Network_Channel_CAN_Rx: ComBitSize=8, ComBitPosition=39, ComSystemTemplateSystemSignalRef=usrData2_FCM
        S_usrData4_FCM_PN_Info1_Can_Network_Channel_CAN_Rx: ComBitSize=8, ComBitPosition=55, ComSystemTemplateSystemSignalRef=usrData4_FCM_PN_Info1
        S_usrData5_FCM_PN_Info2_Can_Network_Channel_CAN_Rx: ComBitSize=8, ComBitPosition=63, ComSystemTemplateSystemSignalRef=usrData5_FCM_PN_Info2
        S_usrData3_FCM_Can_Network_Channel_CAN_Rx: ComBitSize=8, ComBitPosition=47, ComSystemTemplateSystemSignalRef=usrData3_FCM
      IP_NM_VCU_Can_Network_Channel_CAN_Rx (ComIPdu):
        ComIPduDirection = RECEIVE
        ComIPduSignalProcessing = IMMEDIATE
        ComIPduType = NORMAL
        ComIPduSignalRef = S_usrData1_VCU_Bit7_ECUSPEC_AWAKE_Can_Network_Channel_CAN_Rx
        ComIPduSignalRef = S_usrData1_VCU_Bit6_DIAGN_AWAKE_Can_Network_Channel_CAN_Rx
        ComIPduSignalRef = S_usrData1_VCU_Bit5_IGNITION_AWAKE_Can_Network_Channel_CAN_Rx
        ComIPduSignalRef = S_usrData1_VCU_Bit4_NETWORK_AWAKE_Can_Network_Channel_CAN_Rx
        ComIPduSignalRef = S_usrData1_VCU_Bit3_ECUSPEC_WAKEUP_Can_Network_Channel_CAN_Rx
        ComIPduSignalRef = S_usrData1_VCU_Bit2_NETWORK_WAKEUP_Can_Network_Channel_CAN_Rx
        ComIPduSignalRef = S_usrData1_VCU_Bit1_RESET_WAKEUP_Can_Network_Channel_CAN_Rx
        ComIPduSignalRef = S_CtrlBitVector_VCU_Bit7_Res_Can_Network_Channel_CAN_Rx
        ComIPduSignalRef = S_CtrlBitVector_VCU_Bit6_PNI_Can_Network_Channel_CAN_Rx
        ComIPduSignalRef = S_CtrlBitVector_VCU_Bit5_Res_Can_Network_Channel_CAN_Rx
        ComIPduSignalRef = S_CtrlBitVector_VCU_Bit4_ActWake_Can_Network_Channel_CAN_Rx
        ComIPduSignalRef = S_CtrlBitVector_VCU_Bit3_NMCoord_Can_Network_Channel_CAN_Rx
        ComIPduSignalRef = S_CtrlBitVector_VCU_Bit2_Res_Can_Network_Channel_CAN_Rx
        ComIPduSignalRef = S_CtrlBitVector_VCU_Bit1_Res_Can_Network_Channel_CAN_Rx
        ComIPduSignalRef = S_usrData1_VCU_Bit0_IGN_WAKEUP_Can_Network_Channel_CAN_Rx
        ComIPduSignalRef = S_usrData0_VCU_Can_Network_Channel_CAN_Rx
        ComIPduSignalRef = S_srcNodeID_VCU_Can_Network_Channel_CAN_Rx
        ComIPduSignalRef = S_CtrlBitVector_VCU_Bit0_RMR_Can_Network_Channel_CAN_Rx
        ComIPduSignalRef = S_usrData2_VCU_Can_Network_Channel_CAN_Rx
        ComIPduSignalRef = S_usrData4_VCU_PN_Info1_Can_Network_Channel_CAN_Rx
        ComIPduSignalRef = S_usrData5_VCU_PN_Info2_Can_Network_Channel_CAN_Rx
        ComIPduSignalRef = S_usrData3_VCU_Can_Network_Channel_CAN_Rx
        ComIPduGroupRef = ComIPduGroup_Rx
        ComPduIdRef = EcucPduCollection/NM_VCU_PduR2Com_Can_Network_Channel_CAN
      22 x ComSignal, all with ComSignalType=UINT8, ComSignalEndianness=BIG_ENDIAN, ComTransferProperty=TRIGGERED, ComSignalInitValue=0:
        S_usrData1_VCU_Bit7_ECUSPEC_AWAKE_Can_Network_Channel_CAN_Rx: ComBitSize=1, ComBitPosition=31, ComSystemTemplateSystemSignalRef=usrData1_VCU_Bit7_ECUSPEC_AWAKE
        S_usrData1_VCU_Bit6_DIAGN_AWAKE_Can_Network_Channel_CAN_Rx: ComBitSize=1, ComBitPosition=30, ComSystemTemplateSystemSignalRef=usrData1_VCU_Bit6_DIAGN_AWAKE
        S_usrData1_VCU_Bit5_IGNITION_AWAKE_Can_Network_Channel_CAN_Rx: ComBitSize=1, ComBitPosition=29, ComSystemTemplateSystemSignalRef=usrData1_VCU_Bit5_IGNITION_AWAKE
        S_usrData1_VCU_Bit4_NETWORK_AWAKE_Can_Network_Channel_CAN_Rx: ComBitSize=1, ComBitPosition=28, ComSystemTemplateSystemSignalRef=usrData1_VCU_Bit4_NETWORK_AWAKE
        S_usrData1_VCU_Bit3_ECUSPEC_WAKEUP_Can_Network_Channel_CAN_Rx: ComBitSize=1, ComBitPosition=27, ComSystemTemplateSystemSignalRef=usrData1_VCU_Bit3_ECUSPEC_WAKEUP
        S_usrData1_VCU_Bit2_NETWORK_WAKEUP_Can_Network_Channel_CAN_Rx: ComBitSize=1, ComBitPosition=26, ComSystemTemplateSystemSignalRef=usrData1_VCU_Bit2_NETWORK_WAKEUP
        S_usrData1_VCU_Bit1_RESET_WAKEUP_Can_Network_Channel_CAN_Rx: ComBitSize=1, ComBitPosition=25, ComSystemTemplateSystemSignalRef=usrData1_VCU_Bit1_RESET_WAKEUP
        S_CtrlBitVector_VCU_Bit7_Res_Can_Network_Channel_CAN_Rx: ComBitSize=1, ComBitPosition=15, ComSystemTemplateSystemSignalRef=CtrlBitVector_VCU_Bit7_Res
        S_CtrlBitVector_VCU_Bit6_PNI_Can_Network_Channel_CAN_Rx: ComBitSize=1, ComBitPosition=14, ComSystemTemplateSystemSignalRef=CtrlBitVector_VCU_Bit6_PNI
        S_CtrlBitVector_VCU_Bit5_Res_Can_Network_Channel_CAN_Rx: ComBitSize=1, ComBitPosition=13, ComSystemTemplateSystemSignalRef=CtrlBitVector_VCU_Bit5_Res
        S_CtrlBitVector_VCU_Bit4_ActWake_Can_Network_Channel_CAN_Rx: ComBitSize=1, ComBitPosition=12, ComSystemTemplateSystemSignalRef=CtrlBitVector_VCU_Bit4_ActWake
        S_CtrlBitVector_VCU_Bit3_NMCoord_Can_Network_Channel_CAN_Rx: ComBitSize=1, ComBitPosition=11, ComSystemTemplateSystemSignalRef=CtrlBitVector_VCU_Bit3_NMCoord
        S_CtrlBitVector_VCU_Bit2_Res_Can_Network_Channel_CAN_Rx: ComBitSize=1, ComBitPosition=10, ComSystemTemplateSystemSignalRef=CtrlBitVector_VCU_Bit2_Res
        S_CtrlBitVector_VCU_Bit1_Res_Can_Network_Channel_CAN_Rx: ComBitSize=1, ComBitPosition=9, ComSystemTemplateSystemSignalRef=CtrlBitVector_VCU_Bit1_Res
        S_usrData1_VCU_Bit0_IGN_WAKEUP_Can_Network_Channel_CAN_Rx: ComBitSize=1, ComBitPosition=24, ComSystemTemplateSystemSignalRef=usrData1_VCU_Bit0_IGN_WAKEUP
        S_usrData0_VCU_Can_Network_Channel_CAN_Rx: ComBitSize=8, ComBitPosition=23, ComSystemTemplateSystemSignalRef=usrData0_VCU
        S_srcNodeID_VCU_Can_Network_Channel_CAN_Rx: ComBitSize=8, ComBitPosition=7, ComSystemTemplateSystemSignalRef=srcNodeID_VCU
        S_CtrlBitVector_VCU_Bit0_RMR_Can_Network_Channel_CAN_Rx: ComBitSize=1, ComBitPosition=8, ComSystemTemplateSystemSignalRef=CtrlBitVector_VCU_Bit0_RMR
        S_usrData2_VCU_Can_Network_Channel_CAN_Rx: ComBitSize=8, ComBitPosition=39, ComSystemTemplateSystemSignalRef=usrData2_VCU
        S_usrData4_VCU_PN_Info1_Can_Network_Channel_CAN_Rx: ComBitSize=8, ComBitPosition=55, ComSystemTemplateSystemSignalRef=usrData4_VCU_PN_Info1
        S_usrData5_VCU_PN_Info2_Can_Network_Channel_CAN_Rx: ComBitSize=8, ComBitPosition=63, ComSystemTemplateSystemSignalRef=usrData5_VCU_PN_Info2
        S_usrData3_VCU_Can_Network_Channel_CAN_Rx: ComBitSize=8, ComBitPosition=47, ComSystemTemplateSystemSignalRef=usrData3_VCU
      IP_NM_iBooster_Can_Network_Channel_CAN_Rx (ComIPdu):
        ComIPduDirection = RECEIVE
        ComIPduSignalProcessing = IMMEDIATE
        ComIPduType = NORMAL
        ComIPduSignalRef = S_usrData1_iBo_Bit7_ECUSPEC_AWAKE_Can_Network_Channel_CAN_Rx
        ComIPduSignalRef = S_usrData1_iBo_Bit6_DIAGN_AWAKE_Can_Network_Channel_CAN_Rx
        ComIPduSignalRef = S_usrData1_iBo_Bit5_IGNITION_AWAKE_Can_Network_Channel_CAN_Rx
        ComIPduSignalRef = S_usrData1_iBo_Bit4_NETWORK_AWAKE_Can_Network_Channel_CAN_Rx
        ComIPduSignalRef = S_usrData1_iBo_Bit3_ECUSPEC_WAKEUP_Can_Network_Channel_CAN_Rx
        ComIPduSignalRef = S_usrData1_iBo_Bit2_NETWORK_WAKEUP_Can_Network_Channel_CAN_Rx
        ComIPduSignalRef = S_usrData1_iBo_Bit1_RESET_WAKEUP_Can_Network_Channel_CAN_Rx
        ComIPduSignalRef = S_CtrlBitVector_iBo_Bit7_Res_Can_Network_Channel_CAN_Rx
        ComIPduSignalRef = S_CtrlBitVector_iBo_Bit6_PNI_Can_Network_Channel_CAN_Rx
        ComIPduSignalRef = S_CtrlBitVector_iBo_Bit5_Res_Can_Network_Channel_CAN_Rx
        ComIPduSignalRef = S_CtrlBitVector_iBo_Bit4_ActWake_Can_Network_Channel_CAN_Rx
        ComIPduSignalRef = S_CtrlBitVector_iBo_Bit3_NMCoord_Can_Network_Channel_CAN_Rx
        ComIPduSignalRef = S_CtrlBitVector_iBo_Bit2_Res_Can_Network_Channel_CAN_Rx
        ComIPduSignalRef = S_CtrlBitVector_iBo_Bit1_Res_Can_Network_Channel_CAN_Rx
        ComIPduSignalRef = S_usrData1_iBo_Bit0_IGN_WAKEUP_Can_Network_Channel_CAN_Rx
        ComIPduSignalRef = S_usrData0_iBo_Can_Network_Channel_CAN_Rx
        ComIPduSignalRef = S_srcNodeID_iBo_Can_Network_Channel_CAN_Rx
        ComIPduSignalRef = S_CtrlBitVector_iBo_Bit0_RMR_Can_Network_Channel_CAN_Rx
        ComIPduSignalRef = S_usrData2_iBo_Can_Network_Channel_CAN_Rx
        ComIPduSignalRef = S_usrData4_iBo_PN_Info1_Can_Network_Channel_CAN_Rx
        ComIPduSignalRef = S_usrData5_iBo_PN_Info2_Can_Network_Channel_CAN_Rx
        ComIPduSignalRef = S_usrData3_iBo_Can_Network_Channel_CAN_Rx
        ComIPduGroupRef = ComIPduGroup_Rx
        ComPduIdRef = EcucPduCollection/NM_iBooster_PduR2Com_Can_Network_Channel_CAN
      22 x ComSignal, all with ComSignalType=UINT8, ComSignalEndianness=BIG_ENDIAN, ComTransferProperty=TRIGGERED, ComSignalInitValue=0:
        S_usrData1_iBo_Bit7_ECUSPEC_AWAKE_Can_Network_Channel_CAN_Rx: ComBitSize=1, ComBitPosition=31, ComSystemTemplateSystemSignalRef=usrData1_iBo_Bit7_ECUSPEC_AWAKE
        S_usrData1_iBo_Bit6_DIAGN_AWAKE_Can_Network_Channel_CAN_Rx: ComBitSize=1, ComBitPosition=30, ComSystemTemplateSystemSignalRef=usrData1_iBo_Bit6_DIAGN_AWAKE
        S_usrData1_iBo_Bit5_IGNITION_AWAKE_Can_Network_Channel_CAN_Rx: ComBitSize=1, ComBitPosition=29, ComSystemTemplateSystemSignalRef=usrData1_iBo_Bit5_IGNITION_AWAKE
        S_usrData1_iBo_Bit4_NETWORK_AWAKE_Can_Network_Channel_CAN_Rx: ComBitSize=1, ComBitPosition=28, ComSystemTemplateSystemSignalRef=usrData1_iBo_Bit4_NETWORK_AWAKE
        S_usrData1_iBo_Bit3_ECUSPEC_WAKEUP_Can_Network_Channel_CAN_Rx: ComBitSize=1, ComBitPosition=27, ComSystemTemplateSystemSignalRef=usrData1_iBo_Bit3_ECUSPEC_WAKEUP
        S_usrData1_iBo_Bit2_NETWORK_WAKEUP_Can_Network_Channel_CAN_Rx: ComBitSize=1, ComBitPosition=26, ComSystemTemplateSystemSignalRef=usrData1_iBo_Bit2_NETWORK_WAKEUP
        S_usrData1_iBo_Bit1_RESET_WAKEUP_Can_Network_Channel_CAN_Rx: ComBitSize=1, ComBitPosition=25, ComSystemTemplateSystemSignalRef=usrData1_iBo_Bit1_RESET_WAKEUP
        S_CtrlBitVector_iBo_Bit7_Res_Can_Network_Channel_CAN_Rx: ComBitSize=1, ComBitPosition=15, ComSystemTemplateSystemSignalRef=CtrlBitVector_iBo_Bit7_Res
        S_CtrlBitVector_iBo_Bit6_PNI_Can_Network_Channel_CAN_Rx: ComBitSize=1, ComBitPosition=14, ComSystemTemplateSystemSignalRef=CtrlBitVector_iBo_Bit6_PNI
        S_CtrlBitVector_iBo_Bit5_Res_Can_Network_Channel_CAN_Rx: ComBitSize=1, ComBitPosition=13, ComSystemTemplateSystemSignalRef=CtrlBitVector_iBo_Bit5_Res
        S_CtrlBitVector_iBo_Bit4_ActWake_Can_Network_Channel_CAN_Rx: ComBitSize=1, ComBitPosition=12, ComSystemTemplateSystemSignalRef=CtrlBitVector_iBo_Bit4_ActWake
        S_CtrlBitVector_iBo_Bit3_NMCoord_Can_Network_Channel_CAN_Rx: ComBitSize=1, ComBitPosition=11, ComSystemTemplateSystemSignalRef=CtrlBitVector_iBo_Bit3_NMCoord
        S_CtrlBitVector_iBo_Bit2_Res_Can_Network_Channel_CAN_Rx: ComBitSize=1, ComBitPosition=10, ComSystemTemplateSystemSignalRef=CtrlBitVector_iBo_Bit2_Res
        S_CtrlBitVector_iBo_Bit1_Res_Can_Network_Channel_CAN_Rx: ComBitSize=1, ComBitPosition=9, ComSystemTemplateSystemSignalRef=CtrlBitVector_iBo_Bit1_Res
        S_usrData1_iBo_Bit0_IGN_WAKEUP_Can_Network_Channel_CAN_Rx: ComBitSize=1, ComBitPosition=24, ComSystemTemplateSystemSignalRef=usrData1_iBo_Bit0_IGN_WAKEUP
        S_usrData0_iBo_Can_Network_Channel_CAN_Rx: ComBitSize=8, ComBitPosition=23, ComSystemTemplateSystemSignalRef=usrData0_iBo
        S_srcNodeID_iBo_Can_Network_Channel_CAN_Rx: ComBitSize=8, ComBitPosition=7, ComSystemTemplateSystemSignalRef=srcNodeID_iBo
        S_CtrlBitVector_iBo_Bit0_RMR_Can_Network_Channel_CAN_Rx: ComBitSize=1, ComBitPosition=8, ComSystemTemplateSystemSignalRef=CtrlBitVector_iBo_Bit0_RMR
        S_usrData2_iBo_Can_Network_Channel_CAN_Rx: ComBitSize=8, ComBitPosition=39, ComSystemTemplateSystemSignalRef=usrData2_iBo
        S_usrData4_iBo_PN_Info1_Can_Network_Channel_CAN_Rx: ComBitSize=8, ComBitPosition=55, ComSystemTemplateSystemSignalRef=usrData4_iBo_PN_Info1
        S_usrData5_iBo_PN_Info2_Can_Network_Channel_CAN_Rx: ComBitSize=8, ComBitPosition=63, ComSystemTemplateSystemSignalRef=usrData5_iBo_PN_Info2
        S_usrData3_iBo_Can_Network_Channel_CAN_Rx: ComBitSize=8, ComBitPosition=47, ComSystemTemplateSystemSignalRef=usrData3_iBo
      IP_TBOX_01_OTA_Can_Network_Channel_CAN_Rx (ComIPdu):
        ComIPduDirection = RECEIVE
        ComIPduSignalProcessing = IMMEDIATE
        ComIPduType = NORMAL
        ComIPduSignalRef = S_TBOX_OTA_WakeupStatus_Can_Network_Channel_CAN_Rx
        ComIPduSignalRef = S_ALIVE_TBOX_01_Can_Network_Channel_CAN_Rx
        ComIPduSignalRef = S_CRC_TBOX_01_Can_Network_Channel_CAN_Rx
        ComIPduSignalRef = S_TBOX_OTA_Status_Can_Network_Channel_CAN_Rx
        ComIPduGroupRef = ComIPduGroup_Rx
        ComPduIdRef = EcucPduCollection/TBOX_01_OTA_PduR2Com_Can_Network_Channel_CAN
      4 x ComSignal, all with ComSignalEndianness=BIG_ENDIAN, ComTransferProperty=TRIGGERED, ComSignalInitValue=0:
        S_TBOX_OTA_WakeupStatus_Can_Network_Channel_CAN_Rx: ComSignalType=UINT8, ComBitSize=2, ComBitPosition=99, ComSystemTemplateSystemSignalRef=TBOX_OTA_WakeupStatus
        S_ALIVE_TBOX_01_Can_Network_Channel_CAN_Rx: ComSignalType=UINT8, ComBitSize=8, ComBitPosition=23, ComSystemTemplateSystemSignalRef=ALIVE_TBOX_01
        S_CRC_TBOX_01_Can_Network_Channel_CAN_Rx: ComSignalType=UINT16, ComBitSize=16, ComBitPosition=7, ComSystemTemplateSystemSignalRef=CRC_TBOX_01
        S_TBOX_OTA_Status_Can_Network_Channel_CAN_Rx: ComSignalType=UINT8, ComBitSize=4, ComBitPosition=103, ComSystemTemplateSystemSignalRef=TBOX_OTA_Status
      IP_TBOX_02_TIME_Can_Network_Channel_CAN_Rx (ComIPdu):
        ComIPduDirection = RECEIVE
        ComIPduSignalProcessing = IMMEDIATE
        ComIPduType = NORMAL
        ComIPduSignalRef = S_ALIVE_TBOX_02_Can_Network_Channel_CAN_Rx
        ComIPduSignalRef = S_CRC_TBOX_02_Can_Network_Channel_CAN_Rx
        ComIPduSignalRef = S_TBOX_CrtTi_Hr_Can_Network_Channel_CAN_Rx
        ComIPduSignalRef = S_TBOX_CrtTi_Mins_Can_Network_Channel_CAN_Rx
        ComIPduSignalRef = S_TBOX_CrtTi_Sec_Can_Network_Channel_CAN_Rx
        ComIPduSignalRef = S_TBOX_CrtTi_Day_Can_Network_Channel_CAN_Rx
        ComIPduSignalRef = S_TBOX_CrtTi_Mth_Can_Network_Channel_CAN_Rx
        ComIPduSignalRef = S_TBOX_CrtTi_Yr_Can_Network_Channel_CAN_Rx
        ComIPduSignalRef = S_TBOX_ZoneT_Can_Network_Channel_CAN_Rx
        ComIPduGroupRef = ComIPduGroup_Rx
        ComPduIdRef = EcucPduCollection/TBOX_02_TIME_PduR2Com_Can_Network_Channel_CAN
      9 x ComSignal, all with ComSignalEndianness=BIG_ENDIAN, ComTransferProperty=TRIGGERED:
        S_ALIVE_TBOX_02_Can_Network_Channel_CAN_Rx: ComSignalType=UINT8, ComBitSize=8, ComBitPosition=23, ComSignalInitValue=0, ComSystemTemplateSystemSignalRef=ALIVE_TBOX_02
        S_CRC_TBOX_02_Can_Network_Channel_CAN_Rx: ComSignalType=UINT16, ComBitSize=16, ComBitPosition=7, ComSignalInitValue=0, ComSystemTemplateSystemSignalRef=CRC_TBOX_02
        S_TBOX_CrtTi_Hr_Can_Network_Channel_CAN_Rx: ComSignalType=UINT8, ComBitSize=5, ComBitPosition=119, ComSignalInitValue=0, ComSystemTemplateSystemSignalRef=TBOX_CrtTi_Hr
        S_TBOX_CrtTi_Mins_Can_Network_Channel_CAN_Rx: ComSignalType=UINT8, ComBitSize=6, ComBitPosition=111, ComSignalInitValue=0, ComSystemTemplateSystemSignalRef=TBOX_CrtTi_Mins
        S_TBOX_CrtTi_Sec_Can_Network_Channel_CAN_Rx: ComSignalType=UINT8, ComBitSize=6, ComBitPosition=103, ComSignalInitValue=0, ComSystemTemplateSystemSignalRef=TBOX_CrtTi_Sec
        S_TBOX_CrtTi_Day_Can_Network_Channel_CAN_Rx: ComSignalType=UINT8, ComBitSize=5, ComBitPosition=127, ComSignalInitValue=0, ComSystemTemplateSystemSignalRef=TBOX_CrtTi_Day
        S_TBOX_CrtTi_Mth_Can_Network_Channel_CAN_Rx: ComSignalType=UINT8, ComBitSize=4, ComBitPosition=135, ComSignalInitValue=0, ComSystemTemplateSystemSignalRef=TBOX_CrtTi_Mth
        S_TBOX_CrtTi_Yr_Can_Network_Channel_CAN_Rx: ComSignalType=UINT8, ComBitSize=8, ComBitPosition=143, ComSignalInitValue=0, ComSystemTemplateSystemSignalRef=TBOX_CrtTi_Yr
        S_TBOX_ZoneT_Can_Network_Channel_CAN_Rx: ComSignalType=UINT8, ComBitSize=7, ComBitPosition=151, ComSignalInitValue=48, ComSystemTemplateSystemSignalRef=TBOX_ZoneT
      IP_TCC_02_Can_Network_Channel_CAN_Rx (ComIPdu):
        ComIPduDirection = RECEIVE
        ComIPduSignalProcessing = IMMEDIATE
        ComIPduType = NORMAL
        ComIPduSignalRef = S_TCC_ByPassFlap_error_Can_Network_Channel_CAN_Rx
        ComIPduSignalRef = S_TCC_RecircFlap_error_Can_Network_Channel_CAN_Rx
        ComIPduSignalRef = S_TCC_ModeFlap_error_Can_Network_Channel_CAN_Rx
        ComIPduSignalRef = S_TCC_Blower_Error_Can_Network_Channel_CAN_Rx
        ComIPduSignalRef = S_TCC_HVAC_AirDistributionMode_Can_Network_Channel_CAN_Rx
        ComIPduSignalRef = S_TCC_HV_Compressor_Availability_Can_Network_Channel_CAN_Rx
        ComIPduSignalRef = S_TCC_HV_Compressor_error_Can_Network_Channel_CAN_Rx
        ComIPduSignalRef = S_TCC_HV_Compressor_power_Can_Network_Channel_CAN_Rx
        ComIPduSignalRef = S_TCC_HV_PTC_HVAC_Availability_Can_Network_Channel_CAN_Rx
        ComIPduSignalRef = S_TCC_HV_PTC_HVAC_error_Can_Network_Channel_CAN_Rx
        ComIPduSignalRef = S_TCC_HV_PTC_HVAC_power_Can_Network_Channel_CAN_Rx
        ComIPduSignalRef = S_TCC_AGM_error_Can_Network_Channel_CAN_Rx
        ComIPduSignalRef = S_TCC_EFAN_error_Can_Network_Channel_CAN_Rx
        ComIPduSignalRef = S_TCC_HV_PTC_Battery_Availability_Can_Network_Channel_CAN_Rx
        ComIPduSignalRef = S_TCC_HV_PTC_Battery_error_Can_Network_Channel_CAN_Rx
        ComIPduSignalRef = S_TCC_HV_PTC_Battery_power_Can_Network_Channel_CAN_Rx
        ComIPduSignalRef = S_TCC_WAPU_EDU_Error_Can_Network_Channel_CAN_Rx
        ComIPduSignalRef = S_TCC_RSV_EDU_Error_Can_Network_Channel_CAN_Rx
        ComIPduSignalRef = S_TCC_CoolantTempEDURear_IN_error_Can_Network_Channel_CAN_Rx
        ComIPduSignalRef = S_TCC_CoolantTempEDUFront_IN_error_Can_Network_Channel_CAN_Rx
        ComIPduSignalRef = S_TCC_EDU_Cooling_error_Can_Network_Channel_CAN_Rx
        ComIPduSignalRef = S_TCC_CoolantTempIPU_IN_Can_Network_Channel_CAN_Rx
        ComIPduSignalRef = S_TCC_STAT_Defrost_Can_Network_Channel_CAN_Rx
        ComIPduSignalRef = S_TCC_STAT_Sync_Can_Network_Channel_CAN_Rx
        ComIPduSignalRef = S_TCC_STAT_Recirc_Can_Network_Channel_CAN_Rx
        ComIPduSignalRef = S_TCC_STAT_AC_Can_Network_Channel_CAN_Rx
        ComIPduSignalRef = S_TCC_STAT_AUTO_Can_Network_Channel_CAN_Rx
        ComIPduSignalRef = S_TCC_BlowerLevelManual_Can_Network_Channel_CAN_Rx
        ComIPduSignalRef = S_TCC_RightZoneSetTemp_Can_Network_Channel_CAN_Rx
        ComIPduSignalRef = S_TCC_LeftZoneSetTemp_Can_Network_Channel_CAN_Rx
        ComIPduSignalRef = S_TCC_CoolantTempIPU_IN_error_Can_Network_Channel_CAN_Rx
        ComIPduSignalRef = S_TCC_CabinTemp_Q_Can_Network_Channel_CAN_Rx
        ComIPduSignalRef = S_TCC_CabinTemp_Can_Network_Channel_CAN_Rx
        ComIPduSignalRef = S_TCC_AmbientTemp_Can_Network_Channel_CAN_Rx
        ComIPduSignalRef = S_TCC_AmbientTempRaw_Can_Network_Channel_CAN_Rx
        ComIPduSignalRef = S_CRC_TCC_02_Can_Network_Channel_CAN_Rx
        ComIPduSignalRef = S_ALIVE_TCC_02_Can_Network_Channel_CAN_Rx
        ComIPduSignalRef = S_TCC_BlowerLevel_Can_Network_Channel_CAN_Rx
        ComIPduSignalRef = S_TCC_RSV_EDU_Position_Can_Network_Channel_CAN_Rx
        ComIPduSignalRef = S_TCC_CoolantFlow_EDURear_Can_Network_Channel_CAN_Rx
        ComIPduSignalRef = S_TCC_CoolantFlow_EDUFront_Can_Network_Channel_CAN_Rx
        ComIPduSignalRef = S_TCC_WAPU_EDU_Can_Network_Channel_CAN_Rx
        ComIPduSignalRef = S_TCC_CoolantTempEDURear_IN_Can_Network_Channel_CAN_Rx
        ComIPduSignalRef = S_TCC_CoolantTempEDUFront_IN_Can_Network_Channel_CAN_Rx
        ComIPduSignalRef = S_TCC_AmbientTemp_Q_Can_Network_Channel_CAN_Rx
        ComIPduSignalRef = S_TCC_STAT_MaxAC_Can_Network_Channel_CAN_Rx
        ComIPduGroupRef = ComIPduGroup_Rx
        ComPduIdRef = EcucPduCollection/TCC_02_PduR2Com_Can_Network_Channel_CAN
      46 x ComSignal, all with ComSignalEndianness=BIG_ENDIAN, ComTransferProperty=TRIGGERED:
        S_TCC_ByPassFlap_error_Can_Network_Channel_CAN_Rx: ComSignalType=UINT8, ComBitSize=2, ComBitPosition=298, ComSignalInitValue=0, ComSystemTemplateSystemSignalRef=TCC_ByPassFlap_error
        S_TCC_RecircFlap_error_Can_Network_Channel_CAN_Rx: ComSignalType=UINT8, ComBitSize=2, ComBitPosition=309, ComSignalInitValue=0, ComSystemTemplateSystemSignalRef=TCC_RecircFlap_error
        S_TCC_ModeFlap_error_Can_Network_Channel_CAN_Rx: ComSignalType=UINT8, ComBitSize=2, ComBitPosition=311, ComSignalInitValue=0, ComSystemTemplateSystemSignalRef=TCC_ModeFlap_error
        S_TCC_Blower_Error_Can_Network_Channel_CAN_Rx: ComSignalType=UINT8, ComBitSize=2, ComBitPosition=211, ComSignalInitValue=0, ComSystemTemplateSystemSignalRef=TCC_Blower_Error
        S_TCC_HVAC_AirDistributionMode_Can_Network_Channel_CAN_Rx: ComSignalType=UINT8, ComBitSize=3, ComBitPosition=301, ComSignalInitValue=0, ComSystemTemplateSystemSignalRef=TCC_HVAC_AirDistributionMode
        S_TCC_HV_Compressor_Availability_Can_Network_Channel_CAN_Rx: ComSignalType=UINT8, ComBitSize=8, ComBitPosition=295, ComSignalInitValue=0, ComSystemTemplateSystemSignalRef=TCC_HV_Compressor_Availability
        S_TCC_HV_Compressor_error_Can_Network_Channel_CAN_Rx: ComSignalType=UINT8, ComBitSize=2, ComBitPosition=237, ComSignalInitValue=0, ComSystemTemplateSystemSignalRef=TCC_HV_Compressor_error
        S_TCC_HV_Compressor_power_Can_Network_Channel_CAN_Rx: ComSignalType=UINT8, ComBitSize=8, ComBitPosition=271, ComSignalInitValue=0, ComSystemTemplateSystemSignalRef=TCC_HV_Compressor_power
        S_TCC_HV_PTC_HVAC_Availability_Can_Network_Channel_CAN_Rx: ComSignalType=UINT8, ComBitSize=8, ComBitPosition=279, ComSignalInitValue=0, ComSystemTemplateSystemSignalRef=TCC_HV_PTC_HVAC_Availability
        S_TCC_HV_PTC_HVAC_error_Can_Network_Channel_CAN_Rx: ComSignalType=UINT8, ComBitSize=2, ComBitPosition=239, ComSignalInitValue=0, ComSystemTemplateSystemSignalRef=TCC_HV_PTC_HVAC_error
        S_TCC_HV_PTC_HVAC_power_Can_Network_Channel_CAN_Rx: ComSignalType=UINT16, ComBitSize=9, ComBitPosition=255, ComSignalInitValue=0, ComSystemTemplateSystemSignalRef=TCC_HV_PTC_HVAC_power
        S_TCC_AGM_error_Can_Network_Channel_CAN_Rx: ComSignalType=UINT8, ComBitSize=2, ComBitPosition=225, ComSignalInitValue=0, ComSystemTemplateSystemSignalRef=TCC_AGM_error
        S_TCC_EFAN_error_Can_Network_Channel_CAN_Rx: ComSignalType=UINT8, ComBitSize=2, ComBitPosition=227, ComSignalInitValue=0, ComSystemTemplateSystemSignalRef=TCC_EFAN_error
        S_TCC_HV_PTC_Battery_Availability_Can_Network_Channel_CAN_Rx: ComSignalType=UINT8, ComBitSize=8, ComBitPosition=287, ComSignalInitValue=0, ComSystemTemplateSystemSignalRef=TCC_HV_PTC_Battery_Availability
        S_TCC_HV_PTC_Battery_error_Can_Network_Channel_CAN_Rx: ComSignalType=UINT8, ComBitSize=2, ComBitPosition=229, ComSignalInitValue=0, ComSystemTemplateSystemSignalRef=TCC_HV_PTC_Battery_error
        S_TCC_HV_PTC_Battery_power_Can_Network_Channel_CAN_Rx: ComSignalType=UINT8, ComBitSize=7, ComBitPosition=262, ComSignalInitValue=0, ComSystemTemplateSystemSignalRef=TCC_HV_PTC_Battery_power
        S_TCC_WAPU_EDU_Error_Can_Network_Channel_CAN_Rx: ComSignalType=UINT8, ComBitSize=2, ComBitPosition=231, ComSignalInitValue=0, ComSystemTemplateSystemSignalRef=TCC_WAPU_EDU_Error
        S_TCC_RSV_EDU_Error_Can_Network_Channel_CAN_Rx: ComSignalType=UINT8, ComBitSize=2, ComBitPosition=217, ComSignalInitValue=0, ComSystemTemplateSystemSignalRef=TCC_RSV_EDU_Error
        S_TCC_CoolantTempEDURear_IN_error_Can_Network_Channel_CAN_Rx: ComSignalType=UINT8, ComBitSize=2, ComBitPosition=219, ComSignalInitValue=0, ComSystemTemplateSystemSignalRef=TCC_CoolantTempEDURear_IN_error
        S_TCC_CoolantTempEDUFront_IN_error_Can_Network_Channel_CAN_Rx: ComSignalType=UINT8, ComBitSize=2, ComBitPosition=221, ComSignalInitValue=0, ComSystemTemplateSystemSignalRef=TCC_CoolantTempEDUFront_IN_error
        S_TCC_EDU_Cooling_error_Can_Network_Channel_CAN_Rx: ComSignalType=UINT8, ComBitSize=2, ComBitPosition=223, ComSignalInitValue=0, ComSystemTemplateSystemSignalRef=TCC_EDU_Cooling_error
        S_TCC_CoolantTempIPU_IN_Can_Network_Channel_CAN_Rx: ComSignalType=UINT8, ComBitSize=8, ComBitPosition=247, ComSignalInitValue=40, ComSystemTemplateSystemSignalRef=TCC_CoolantTempIPU_IN
        S_TCC_STAT_Defrost_Can_Network_Channel_CAN_Rx: ComSignalType=UINT8, ComBitSize=2, ComBitPosition=213, ComSignalInitValue=0, ComSystemTemplateSystemSignalRef=TCC_STAT_Defrost
        S_TCC_STAT_Sync_Can_Network_Channel_CAN_Rx: ComSignalType=UINT8, ComBitSize=2, ComBitPosition=215, ComSignalInitValue=0, ComSystemTemplateSystemSignalRef=TCC_STAT_Sync
        S_TCC_STAT_Recirc_Can_Network_Channel_CAN_Rx: ComSignalType=UINT8, ComBitSize=2, ComBitPosition=201, ComSignalInitValue=0, ComSystemTemplateSystemSignalRef=TCC_STAT_Recirc
        S_TCC_STAT_AC_Can_Network_Channel_CAN_Rx: ComSignalType=UINT8, ComBitSize=2, ComBitPosition=205, ComSignalInitValue=0, ComSystemTemplateSystemSignalRef=TCC_STAT_AC
        S_TCC_STAT_AUTO_Can_Network_Channel_CAN_Rx: ComSignalType=UINT8, ComBitSize=2, ComBitPosition=207, ComSignalInitValue=0, ComSystemTemplateSystemSignalRef=TCC_STAT_AUTO
        S_TCC_BlowerLevelManual_Can_Network_Channel_CAN_Rx: ComSignalType=UINT8, ComBitSize=3, ComBitPosition=199, ComSignalInitValue=0, ComSystemTemplateSystemSignalRef=TCC_BlowerLevelManual
        S_TCC_RightZoneSetTemp_Can_Network_Channel_CAN_Rx: ComSignalType=UINT8, ComBitSize=5, ComBitPosition=191, ComSignalInitValue=0, ComSystemTemplateSystemSignalRef=TCC_RightZoneSetTemp
        S_TCC_LeftZoneSetTemp_Can_Network_Channel_CAN_Rx: ComSignalType=UINT8, ComBitSize=5, ComBitPosition=183, ComSignalInitValue=0, ComSystemTemplateSystemSignalRef=TCC_LeftZoneSetTemp
        S_TCC_CoolantTempIPU_IN_error_Can_Network_Channel_CAN_Rx: ComSignalType=UINT8, ComBitSize=2, ComBitPosition=331, ComSignalInitValue=0, ComSystemTemplateSystemSignalRef=TCC_CoolantTempIPU_IN_error
        S_TCC_CabinTemp_Q_Can_Network_Channel_CAN_Rx: ComSignalType=UINT8, ComBitSize=2, ComBitPosition=333, ComSignalInitValue=0, ComSystemTemplateSystemSignalRef=TCC_CabinTemp_Q
        S_TCC_CabinTemp_Can_Network_Channel_CAN_Rx: ComSignalType=UINT8, ComBitSize=8, ComBitPosition=175, ComSignalInitValue=80, ComSystemTemplateSystemSignalRef=TCC_CabinTemp
        S_TCC_AmbientTemp_Can_Network_Channel_CAN_Rx: ComSignalType=UINT8, ComBitSize=8, ComBitPosition=167, ComSignalInitValue=80, ComSystemTemplateSystemSignalRef=TCC_AmbientTemp
        S_TCC_AmbientTempRaw_Can_Network_Channel_CAN_Rx: ComSignalType=UINT8, ComBitSize=8, ComBitPosition=159, ComSignalInitValue=40, ComSystemTemplateSystemSignalRef=TCC_AmbientTempRaw
        S_CRC_TCC_02_Can_Network_Channel_CAN_Rx: ComSignalType=UINT16, ComBitSize=16, ComBitPosition=7, ComSignalInitValue=0, ComSystemTemplateSystemSignalRef=CRC_TCC_02
        S_ALIVE_TCC_02_Can_Network_Channel_CAN_Rx: ComSignalType=UINT8, ComBitSize=8, ComBitPosition=23, ComSignalInitValue=0, ComSystemTemplateSystemSignalRef=ALIVE_TCC_02
        S_TCC_BlowerLevel_Can_Network_Channel_CAN_Rx: ComSignalType=UINT8, ComBitSize=7, ComBitPosition=135, ComSignalInitValue=0, ComSystemTemplateSystemSignalRef=TCC_BlowerLevel
        S_TCC_RSV_EDU_Position_Can_Network_Channel_CAN_Rx: ComSignalType=UINT8, ComBitSize=7, ComBitPosition=151, ComSignalInitValue=0, ComSystemTemplateSystemSignalRef=TCC_RSV_EDU_Position
        S_TCC_CoolantFlow_EDURear_Can_Network_Channel_CAN_Rx: ComSignalType=UINT8, ComBitSize=8, ComBitPosition=127, ComSignalInitValue=0, ComSystemTemplateSystemSignalRef=TCC_CoolantFlow_EDURear
        S_TCC_CoolantFlow_EDUFront_Can_Network_Channel_CAN_Rx: ComSignalType=UINT8, ComBitSize=8, ComBitPosition=119, ComSignalInitValue=0, ComSystemTemplateSystemSignalRef=TCC_CoolantFlow_EDUFront
        S_TCC_WAPU_EDU_Can_Network_Channel_CAN_Rx: ComSignalType=UINT8, ComBitSize=7, ComBitPosition=143, ComSignalInitValue=0, ComSystemTemplateSystemSignalRef=TCC_WAPU_EDU
        S_TCC_CoolantTempEDURear_IN_Can_Network_Channel_CAN_Rx: ComSignalType=UINT8, ComBitSize=8, ComBitPosition=111, ComSignalInitValue=40, ComSystemTemplateSystemSignalRef=TCC_CoolantTempEDURear_IN
        S_TCC_CoolantTempEDUFront_IN_Can_Network_Channel_CAN_Rx: ComSignalType=UINT8, ComBitSize=8, ComBitPosition=103, ComSignalInitValue=40, ComSystemTemplateSystemSignalRef=TCC_CoolantTempEDUFront_IN
        S_TCC_AmbientTemp_Q_Can_Network_Channel_CAN_Rx: ComSignalType=UINT8, ComBitSize=2, ComBitPosition=335, ComSignalInitValue=0, ComSystemTemplateSystemSignalRef=TCC_AmbientTemp_Q
        S_TCC_STAT_MaxAC_Can_Network_Channel_CAN_Rx: ComSignalType=UINT8, ComBitSize=2, ComBitPosition=203, ComSignalInitValue=0, ComSystemTemplateSystemSignalRef=TCC_STAT_MaxAC
      IP_TPMS_Rx_CCP_Can_Network_Channel_CAN_Rx (ComIPdu):
        ComIPduDirection = RECEIVE
        ComIPduSignalProcessing = IMMEDIATE
        ComIPduType = NORMAL
        ComIPduSignalRef = S_TPMS_Rx_CCP_Byte8_Can_Network_Channel_CAN_Rx
        ComIPduSignalRef = S_TPMS_Rx_CCP_Byte7_Can_Network_Channel_CAN_Rx
        ComIPduSignalRef = S_TPMS_Rx_CCP_Byte6_Can_Network_Channel_CAN_Rx
        ComIPduSignalRef = S_TPMS_Rx_CCP_Byte5_Can_Network_Channel_CAN_Rx
        ComIPduSignalRef = S_TPMS_Rx_CCP_Byte4_Can_Network_Channel_CAN_Rx
        ComIPduSignalRef = S_TPMS_Rx_CCP_Byte3_Can_Network_Channel_CAN_Rx
        ComIPduSignalRef = S_TPMS_Rx_CCP_Byte2_Can_Network_Channel_CAN_Rx
        ComIPduSignalRef = S_TPMS_Rx_CCP_TPCI_Can_Network_Channel_CAN_Rx
        ComIPduGroupRef = ComIPduGroup_Rx
        ComPduIdRef = EcucPduCollection/TPMS_Rx_CCP_PduR2Com_Can_Network_Channel_CAN
      8 x ComSignal, all with ComSignalType=UINT8, ComSignalEndianness=BIG_ENDIAN, ComBitSize=8, ComTransferProperty=TRIGGERED, ComSignalInitValue=0:
        S_TPMS_Rx_CCP_Byte8_Can_Network_Channel_CAN_Rx: ComBitPosition=63, ComSystemTemplateSystemSignalRef=TPMS_Rx_CCP_Byte8
        S_TPMS_Rx_CCP_Byte7_Can_Network_Channel_CAN_Rx: ComBitPosition=55, ComSystemTemplateSystemSignalRef=TPMS_Rx_CCP_Byte7
        S_TPMS_Rx_CCP_Byte6_Can_Network_Channel_CAN_Rx: ComBitPosition=47, ComSystemTemplateSystemSignalRef=TPMS_Rx_CCP_Byte6
        S_TPMS_Rx_CCP_Byte5_Can_Network_Channel_CAN_Rx: ComBitPosition=39, ComSystemTemplateSystemSignalRef=TPMS_Rx_CCP_Byte5
        S_TPMS_Rx_CCP_Byte4_Can_Network_Channel_CAN_Rx: ComBitPosition=31, ComSystemTemplateSystemSignalRef=TPMS_Rx_CCP_Byte4
        S_TPMS_Rx_CCP_Byte3_Can_Network_Channel_CAN_Rx: ComBitPosition=23, ComSystemTemplateSystemSignalRef=TPMS_Rx_CCP_Byte3
        S_TPMS_Rx_CCP_Byte2_Can_Network_Channel_CAN_Rx: ComBitPosition=15, ComSystemTemplateSystemSignalRef=TPMS_Rx_CCP_Byte2
        S_TPMS_Rx_CCP_TPCI_Can_Network_Channel_CAN_Rx: ComBitPosition=7, ComSystemTemplateSystemSignalRef=TPMS_Rx_CCP_TPCI
      IP_VCU_05_Can_Network_Channel_CAN_Rx (ComIPdu):
        ComIPduDirection = RECEIVE
        ComIPduSignalProcessing = IMMEDIATE
        ComIPduType = NORMAL
        ComIPduSignalRef = S_VCU_AccelPedalSts_Can_Network_Channel_CAN_Rx
        ComIPduSignalRef = S_SSecOC_MAC_VCU_05_Can_Network_Channel_CAN_Rx
        ComIPduSignalRef = S_SSecOC_Fresh_VCU_05_Can_Network_Channel_CAN_Rx
        ComIPduSignalRef = S_VCU_CC_SpdLim_Sts_Can_Network_Channel_CAN_Rx
        ComIPduSignalRef = S_ALIVE_VCU_05_Can_Network_Channel_CAN_Rx
        ComIPduSignalRef = S_CRC_VCU_05_Can_Network_Channel_CAN_Rx
        ComIPduSignalRef = S_VCU_ActSt_Can_Network_Channel_CAN_Rx
        ComIPduSignalRef = S_VCU_GearSig_Can_Network_Channel_CAN_Rx
        ComIPduSignalRef = S_VCU_GearSig_Q_Can_Network_Channel_CAN_Rx
        ComIPduGroupRef = ComIPduGroup_Rx
        ComPduIdRef = EcucPduCollection/VCU_05_PduR2Com_Can_Network_Channel_CAN
      9 x ComSignal, all with ComSignalEndianness=BIG_ENDIAN, ComTransferProperty=TRIGGERED, ComSignalInitValue=0:
        S_VCU_AccelPedalSts_Can_Network_Channel_CAN_Rx: ComSignalType=UINT8, ComBitSize=2, ComBitPosition=97, ComSystemTemplateSystemSignalRef=VCU_AccelPedalSts
        S_SSecOC_MAC_VCU_05_Can_Network_Channel_CAN_Rx: ComSignalType=UINT64, ComBitSize=64, ComBitPosition=39, ComSystemTemplateSystemSignalRef=SSecOC_MAC_VCU_05
        S_SSecOC_Fresh_VCU_05_Can_Network_Channel_CAN_Rx: ComSignalType=UINT8, ComBitSize=8, ComBitPosition=31, ComSystemTemplateSystemSignalRef=SSecOC_Fresh_VCU_05
        S_VCU_CC_SpdLim_Sts_Can_Network_Channel_CAN_Rx: ComSignalType=UINT8, ComBitSize=3, ComBitPosition=107, ComSystemTemplateSystemSignalRef=VCU_CC_SpdLim_Sts
        S_ALIVE_VCU_05_Can_Network_Channel_CAN_Rx: ComSignalType=UINT8, ComBitSize=8, ComBitPosition=23, ComSystemTemplateSystemSignalRef=ALIVE_VCU_05
        S_CRC_VCU_05_Can_Network_Channel_CAN_Rx: ComSignalType=UINT16, ComBitSize=16, ComBitPosition=7, ComSystemTemplateSystemSignalRef=CRC_VCU_05
        S_VCU_ActSt_Can_Network_Channel_CAN_Rx: ComSignalType=UINT8, ComBitSize=4, ComBitPosition=111, ComSystemTemplateSystemSignalRef=VCU_ActSt
        S_VCU_GearSig_Can_Network_Channel_CAN_Rx: ComSignalType=UINT8, ComBitSize=4, ComBitPosition=103, ComSystemTemplateSystemSignalRef=VCU_GearSig
        S_VCU_GearSig_Q_Can_Network_Channel_CAN_Rx: ComSignalType=UINT8, ComBitSize=2, ComBitPosition=99, ComSystemTemplateSystemSignalRef=VCU_GearSig_Q
      IP_Meas_TPMS_1_MUX1_Can_Network_Channel_CAN_Tx (ComIPdu):
        ComIPduDirection = SEND
        ComIPduSignalProcessing = IMMEDIATE
        ComIPduType = NORMAL
        ComIPduSignalRef = S_Meas_TPM_1H_Can_Network_Channel_CAN_Tx
        ComIPduSignalRef = S_Meas_TPM_1G_Can_Network_Channel_CAN_Tx
        ComIPduSignalRef = S_Meas_TPM_1D_Can_Network_Channel_CAN_Tx
        ComIPduSignalRef = S_Meas_TPM_1C_Can_Network_Channel_CAN_Tx
        ComIPduSignalRef = S_Meas_TPM_1B_Can_Network_Channel_CAN_Tx
        ComIPduSignalRef = S_Meas_TPM_1A_Can_Network_Channel_CAN_Tx
        ComIPduSignalRef = S_TPMS_MEAS_ID_1_Can_Network_Channel_CAN_Tx
        ComIPduGroupRef = ComIPduGroup_Tx
        ComPduIdRef = EcucPduCollection/Meas_TPMS_1_MUX1_Com2PduR_Can_Network_Channel_CAN
        ComTxIPdu: ComTxIPduUnusedAreasDefault=255
          ComTxModeTrue
            ComTxMode: ComTxModeNumberOfRepetitions=0, ComTxModeMode=DIRECT, ComTxModeTimeOffset=0.0, ComTxModeRepetitionPeriod=0, ComTxModeTimePeriod=0.1
          ComTxModeFalse
            ComTxMode: ComTxModeNumberOfRepetitions=0, ComTxModeMode=DIRECT, ComTxModeTimeOffset=0.0, ComTxModeRepetitionPeriod=0, ComTxModeTimePeriod=0.1
      7 x ComSignal, all with ComSignalType=UINT8, ComSignalEndianness=BIG_ENDIAN, ComBitSize=8, ComTransferProperty=TRIGGERED:
        S_Meas_TPM_1H_Can_Network_Channel_CAN_Tx: ComBitPosition=63, ComSignalInitValue=0, ComSystemTemplateSystemSignalRef=Meas_TPM_1H
          ComFilter: ComFilterAlgorithm=ALWAYS, ComFilterMin=0, ComFilterMax=255, ComFilterOffset=0
        S_Meas_TPM_1G_Can_Network_Channel_CAN_Tx: ComBitPosition=55, ComSignalInitValue=0, ComSystemTemplateSystemSignalRef=Meas_TPM_1G
          ComFilter: ComFilterAlgorithm=ALWAYS, ComFilterMin=0, ComFilterMax=255, ComFilterOffset=0
        S_Meas_TPM_1D_Can_Network_Channel_CAN_Tx: ComBitPosition=31, ComSignalInitValue=0, ComSystemTemplateSystemSignalRef=Meas_TPM_1D
          ComFilter: ComFilterAlgorithm=ALWAYS, ComFilterMin=0, ComFilterMax=255, ComFilterOffset=0
        S_Meas_TPM_1C_Can_Network_Channel_CAN_Tx: ComBitPosition=23, ComSignalInitValue=0, ComSystemTemplateSystemSignalRef=Meas_TPM_1C
          ComFilter: ComFilterAlgorithm=ALWAYS, ComFilterMin=0, ComFilterMax=255, ComFilterOffset=0
        S_Meas_TPM_1B_Can_Network_Channel_CAN_Tx: ComBitPosition=15, ComSignalInitValue=0, ComSystemTemplateSystemSignalRef=Meas_TPM_1B
          ComFilter: ComFilterAlgorithm=ALWAYS, ComFilterMin=0, ComFilterMax=255, ComFilterOffset=0
        S_Meas_TPM_1A_Can_Network_Channel_CAN_Tx: ComBitPosition=39, ComSignalInitValue=0, ComSystemTemplateSystemSignalRef=Meas_TPM_1A
          ComFilter: ComFilterAlgorithm=ALWAYS, ComFilterMin=0, ComFilterMax=255, ComFilterOffset=0
        S_TPMS_MEAS_ID_1_Can_Network_Channel_CAN_Tx: ComBitPosition=7, ComSignalInitValue=1, ComSystemTemplateSystemSignalRef=TPMS_MEAS_ID_1
      IP_Meas_TPMS_1_MUX2_Can_Network_Channel_CAN_Tx (ComIPdu):
        ComIPduDirection = SEND
        ComIPduSignalProcessing = IMMEDIATE
        ComIPduType = NORMAL
        ComIPduSignalRef = S_Meas_TPM_1E_Can_Network_Channel_CAN_Tx
        ComIPduSignalRef = S_TPMS_MEAS_ID_2_Can_Network_Channel_CAN_Tx
        ComIPduGroupRef = ComIPduGroup_Tx
        ComPduIdRef = EcucPduCollection/Meas_TPMS_1_MUX2_Com2PduR_Can_Network_Channel_CAN
        ComTxIPdu: ComTxIPduUnusedAreasDefault=255
          ComTxModeTrue
            ComTxMode: ComTxModeNumberOfRepetitions=0, ComTxModeMode=DIRECT, ComTxModeTimeOffset=0.0, ComTxModeRepetitionPeriod=0, ComTxModeTimePeriod=0.1
          ComTxModeFalse
            ComTxMode: ComTxModeNumberOfRepetitions=0, ComTxModeMode=DIRECT, ComTxModeTimeOffset=0.0, ComTxModeRepetitionPeriod=0, ComTxModeTimePeriod=0.1
      S_Meas_TPM_1E_Can_Network_Channel_CAN_Tx (ComSignal):
        ComSignalType = UINT8
        ComSignalEndianness = BIG_ENDIAN
        ComBitSize = 8
        ComTransferProperty = TRIGGERED
        ComBitPosition = 39
        ComSignalInitValue = 0
        ComSystemTemplateSystemSignalRef = Meas_TPM_1E
        ComFilter: ComFilterAlgorithm=ALWAYS, ComFilterMin=0, ComFilterMax=255, ComFilterOffset=0
      S_TPMS_MEAS_ID_2_Can_Network_Channel_CAN_Tx (ComSignal):
        ComSignalType = UINT8
        ComSignalEndianness = BIG_ENDIAN
        ComBitSize = 8
        ComTransferProperty = TRIGGERED
        ComBitPosition = 7
        ComSignalInitValue = 2
        ComSystemTemplateSystemSignalRef = TPMS_MEAS_ID_2
      IP_Meas_TPMS_1__MUX_STAT_Can_Network_Channel_CAN_Tx (ComIPdu):
        ComIPduDirection = SEND
        ComIPduSignalProcessing = IMMEDIATE
        ComIPduType = NORMAL
        ComIPduSignalRef = S_Meas_TPM_1F_Can_Network_Channel_CAN_Tx
        ComIPduGroupRef = ComIPduGroup_Tx
        ComPduIdRef = EcucPduCollection/Meas_TPMS_1__MUX_STAT_Com2PduR_Can_Network_Channel_CAN
        ComTxIPdu: ComTxIPduUnusedAreasDefault=255
          ComTxModeTrue
            ComTxMode: ComTxModeNumberOfRepetitions=0, ComTxModeMode=DIRECT, ComTxModeTimeOffset=0.0, ComTxModeRepetitionPeriod=0, ComTxModeTimePeriod=0.1
          ComTxModeFalse
            ComTxMode: ComTxModeNumberOfRepetitions=0, ComTxModeMode=DIRECT, ComTxModeTimeOffset=0.0, ComTxModeRepetitionPeriod=0, ComTxModeTimePeriod=0.1
      S_Meas_TPM_1F_Can_Network_Channel_CAN_Tx (ComSignal):
        ComSignalType = UINT8
        ComSignalEndianness = BIG_ENDIAN
        ComBitSize = 8
        ComTransferProperty = TRIGGERED
        ComBitPosition = 47
        ComSignalInitValue = 0
        ComSystemTemplateSystemSignalRef = Meas_TPM_1F
        ComFilter: ComFilterAlgorithm=ALWAYS, ComFilterMin=0, ComFilterMax=255, ComFilterOffset=0
      IP_NM_TPMS_Can_Network_Channel_CAN_Tx (ComIPdu):
        ComIPduDirection = SEND
        ComIPduSignalProcessing = IMMEDIATE
        ComIPduType = NORMAL
        ComIPduSignalRef = S_usrData1_TPM_Bit7_ECUSPEC_AWAKE_Can_Network_Channel_CAN_Tx
        ComIPduSignalRef = S_usrData1_TPM_Bit6_DIAGN_AWAKE_Can_Network_Channel_CAN_Tx
        ComIPduSignalRef = S_usrData1_TPM_Bit5_IGNITION_AWAKE_Can_Network_Channel_CAN_Tx
        ComIPduSignalRef = S_usrData1_TPM_Bit4_NETWORK_AWAKE_Can_Network_Channel_CAN_Tx
        ComIPduSignalRef = S_usrData1_TPM_Bit3_ECUSPEC_WAKEUP_Can_Network_Channel_CAN_Tx
        ComIPduSignalRef = S_usrData1_TPM_Bit2_NETWORK_WAKEUP_Can_Network_Channel_CAN_Tx
        ComIPduSignalRef = S_usrData1_TPM_Bit1_RESET_WAKEUP_Can_Network_Channel_CAN_Tx
        ComIPduSignalRef = S_CtrlBitVector_TPM_Bit7_Res_Can_Network_Channel_CAN_Tx
        ComIPduSignalRef = S_CtrlBitVector_TPM_Bit6_PNI_Can_Network_Channel_CAN_Tx
        ComIPduSignalRef = S_CtrlBitVector_TPM_Bit5_Res_Can_Network_Channel_CAN_Tx
        ComIPduSignalRef = S_CtrlBitVector_TPM_Bit4_ActWake_Can_Network_Channel_CAN_Tx
        ComIPduSignalRef = S_CtrlBitVector_TPM_Bit3_NMCoord_Can_Network_Channel_CAN_Tx
        ComIPduSignalRef = S_CtrlBitVector_TPM_Bit2_Res_Can_Network_Channel_CAN_Tx
        ComIPduSignalRef = S_CtrlBitVector_TPM_Bit1_Res_Can_Network_Channel_CAN_Tx
        ComIPduSignalRef = S_usrData1_TPM_Bit0_IGN_WAKEUP_Can_Network_Channel_CAN_Tx
        ComIPduSignalRef = S_usrData0_TPM_Can_Network_Channel_CAN_Tx
        ComIPduSignalRef = S_srcNodeID_TPM_Can_Network_Channel_CAN_Tx
        ComIPduSignalRef = S_CtrlBitVector_TPM_Bit0_RMR_Can_Network_Channel_CAN_Tx
        ComIPduSignalRef = S_usrData2_TPM_Can_Network_Channel_CAN_Tx
        ComIPduSignalRef = S_usrData4_TPM_PN_Info1_Can_Network_Channel_CAN_Tx
        ComIPduSignalRef = S_usrData5_TPM_PN_Info2_Can_Network_Channel_CAN_Tx
        ComIPduSignalRef = S_usrData3_TPM_Can_Network_Channel_CAN_Tx
        ComIPduGroupRef = ComIPduGroup_Tx
        ComPduIdRef = EcucPduCollection/NM_TPMS_Com2PduR_Can_Network_Channel_CAN
        ComTxIPdu: ComTxIPduUnusedAreasDefault=255
          ComTxModeTrue
            ComTxMode: ComTxModeNumberOfRepetitions=0, ComTxModeMode=DIRECT, ComTxModeTimeOffset=0.0, ComTxModeRepetitionPeriod=0, ComTxModeTimePeriod=0.1
          ComTxModeFalse
            ComTxMode: ComTxModeNumberOfRepetitions=0, ComTxModeMode=DIRECT, ComTxModeTimeOffset=0.0, ComTxModeRepetitionPeriod=0, ComTxModeTimePeriod=0.1
      22 x ComSignal, all with ComSignalType=UINT8, ComSignalEndianness=BIG_ENDIAN, ComTransferProperty=TRIGGERED, ComSignalInitValue=0:
        S_usrData1_TPM_Bit7_ECUSPEC_AWAKE_Can_Network_Channel_CAN_Tx: ComBitSize=1, ComBitPosition=31, ComSystemTemplateSystemSignalRef=usrData1_TPM_Bit7_ECUSPEC_AWAKE
          ComFilter: ComFilterAlgorithm=ALWAYS, ComFilterMin=0, ComFilterMax=1, ComFilterOffset=0
        S_usrData1_TPM_Bit6_DIAGN_AWAKE_Can_Network_Channel_CAN_Tx: ComBitSize=1, ComBitPosition=30, ComSystemTemplateSystemSignalRef=usrData1_TPM_Bit6_DIAGN_AWAKE
          ComFilter: ComFilterAlgorithm=ALWAYS, ComFilterMin=0, ComFilterMax=1, ComFilterOffset=0
        S_usrData1_TPM_Bit5_IGNITION_AWAKE_Can_Network_Channel_CAN_Tx: ComBitSize=1, ComBitPosition=29, ComSystemTemplateSystemSignalRef=usrData1_TPM_Bit5_IGNITION_AWAKE
          ComFilter: ComFilterAlgorithm=ALWAYS, ComFilterMin=0, ComFilterMax=1, ComFilterOffset=0
        S_usrData1_TPM_Bit4_NETWORK_AWAKE_Can_Network_Channel_CAN_Tx: ComBitSize=1, ComBitPosition=28, ComSystemTemplateSystemSignalRef=usrData1_TPM_Bit4_NETWORK_AWAKE
          ComFilter: ComFilterAlgorithm=ALWAYS, ComFilterMin=0, ComFilterMax=1, ComFilterOffset=0
        S_usrData1_TPM_Bit3_ECUSPEC_WAKEUP_Can_Network_Channel_CAN_Tx: ComBitSize=1, ComBitPosition=27, ComSystemTemplateSystemSignalRef=usrData1_TPM_Bit3_ECUSPEC_WAKEUP
          ComFilter: ComFilterAlgorithm=ALWAYS, ComFilterMin=0, ComFilterMax=1, ComFilterOffset=0
        S_usrData1_TPM_Bit2_NETWORK_WAKEUP_Can_Network_Channel_CAN_Tx: ComBitSize=1, ComBitPosition=26, ComSystemTemplateSystemSignalRef=usrData1_TPM_Bit2_NETWORK_WAKEUP
          ComFilter: ComFilterAlgorithm=ALWAYS, ComFilterMin=0, ComFilterMax=1, ComFilterOffset=0
        S_usrData1_TPM_Bit1_RESET_WAKEUP_Can_Network_Channel_CAN_Tx: ComBitSize=1, ComBitPosition=25, ComSystemTemplateSystemSignalRef=usrData1_TPM_Bit1_RESET_WAKEUP
          ComFilter: ComFilterAlgorithm=ALWAYS, ComFilterMin=0, ComFilterMax=1, ComFilterOffset=0
        S_CtrlBitVector_TPM_Bit7_Res_Can_Network_Channel_CAN_Tx: ComBitSize=1, ComBitPosition=15, ComSystemTemplateSystemSignalRef=CtrlBitVector_TPM_Bit7_Res
          ComFilter: ComFilterAlgorithm=ALWAYS, ComFilterMin=0, ComFilterMax=1, ComFilterOffset=0
        S_CtrlBitVector_TPM_Bit6_PNI_Can_Network_Channel_CAN_Tx: ComBitSize=1, ComBitPosition=14, ComSystemTemplateSystemSignalRef=CtrlBitVector_TPM_Bit6_PNI
          ComFilter: ComFilterAlgorithm=ALWAYS, ComFilterMin=0, ComFilterMax=1, ComFilterOffset=0
        S_CtrlBitVector_TPM_Bit5_Res_Can_Network_Channel_CAN_Tx: ComBitSize=1, ComBitPosition=13, ComSystemTemplateSystemSignalRef=CtrlBitVector_TPM_Bit5_Res
          ComFilter: ComFilterAlgorithm=ALWAYS, ComFilterMin=0, ComFilterMax=1, ComFilterOffset=0
        S_CtrlBitVector_TPM_Bit4_ActWake_Can_Network_Channel_CAN_Tx: ComBitSize=1, ComBitPosition=12, ComSystemTemplateSystemSignalRef=CtrlBitVector_TPM_Bit4_ActWake
          ComFilter: ComFilterAlgorithm=ALWAYS, ComFilterMin=0, ComFilterMax=1, ComFilterOffset=0
        S_CtrlBitVector_TPM_Bit3_NMCoord_Can_Network_Channel_CAN_Tx: ComBitSize=1, ComBitPosition=11, ComSystemTemplateSystemSignalRef=CtrlBitVector_TPM_Bit3_NMCoord
          ComFilter: ComFilterAlgorithm=ALWAYS, ComFilterMin=0, ComFilterMax=1, ComFilterOffset=0
        S_CtrlBitVector_TPM_Bit2_Res_Can_Network_Channel_CAN_Tx: ComBitSize=1, ComBitPosition=10, ComSystemTemplateSystemSignalRef=CtrlBitVector_TPM_Bit2_Res
          ComFilter: ComFilterAlgorithm=ALWAYS, ComFilterMin=0, ComFilterMax=1, ComFilterOffset=0
        S_CtrlBitVector_TPM_Bit1_Res_Can_Network_Channel_CAN_Tx: ComBitSize=1, ComBitPosition=9, ComSystemTemplateSystemSignalRef=CtrlBitVector_TPM_Bit1_Res
          ComFilter: ComFilterAlgorithm=ALWAYS, ComFilterMin=0, ComFilterMax=1, ComFilterOffset=0
        S_usrData1_TPM_Bit0_IGN_WAKEUP_Can_Network_Channel_CAN_Tx: ComBitSize=1, ComBitPosition=24, ComSystemTemplateSystemSignalRef=usrData1_TPM_Bit0_IGN_WAKEUP
          ComFilter: ComFilterAlgorithm=ALWAYS, ComFilterMin=0, ComFilterMax=1, ComFilterOffset=0
        S_usrData0_TPM_Can_Network_Channel_CAN_Tx: ComBitSize=8, ComBitPosition=23, ComSystemTemplateSystemSignalRef=usrData0_TPM
          ComFilter: ComFilterAlgorithm=ALWAYS, ComFilterMin=0, ComFilterMax=255, ComFilterOffset=0
        S_srcNodeID_TPM_Can_Network_Channel_CAN_Tx: ComBitSize=8, ComBitPosition=7, ComSystemTemplateSystemSignalRef=srcNodeID_TPM
          ComFilter: ComFilterAlgorithm=ALWAYS, ComFilterMin=0, ComFilterMax=127, ComFilterOffset=0
        S_CtrlBitVector_TPM_Bit0_RMR_Can_Network_Channel_CAN_Tx: ComBitSize=1, ComBitPosition=8, ComSystemTemplateSystemSignalRef=CtrlBitVector_TPM_Bit0_RMR
          ComFilter: ComFilterAlgorithm=ALWAYS, ComFilterMin=0, ComFilterMax=1, ComFilterOffset=0
        S_usrData2_TPM_Can_Network_Channel_CAN_Tx: ComBitSize=8, ComBitPosition=39, ComSystemTemplateSystemSignalRef=usrData2_TPM
          ComFilter: ComFilterAlgorithm=ALWAYS, ComFilterMin=0, ComFilterMax=255, ComFilterOffset=0
        S_usrData4_TPM_PN_Info1_Can_Network_Channel_CAN_Tx: ComBitSize=8, ComBitPosition=55, ComSystemTemplateSystemSignalRef=usrData4_TPM_PN_Info1
          ComFilter: ComFilterAlgorithm=ALWAYS, ComFilterMin=0, ComFilterMax=255, ComFilterOffset=0
        S_usrData5_TPM_PN_Info2_Can_Network_Channel_CAN_Tx: ComBitSize=8, ComBitPosition=63, ComSystemTemplateSystemSignalRef=usrData5_TPM_PN_Info2
          ComFilter: ComFilterAlgorithm=ALWAYS, ComFilterMin=0, ComFilterMax=255, ComFilterOffset=0
        S_usrData3_TPM_Can_Network_Channel_CAN_Tx: ComBitSize=8, ComBitPosition=47, ComSystemTemplateSystemSignalRef=usrData3_TPM
          ComFilter: ComFilterAlgorithm=ALWAYS, ComFilterMin=0, ComFilterMax=255, ComFilterOffset=0
      IP_TPMS_01_Can_Network_Channel_CAN_Tx (ComIPdu):
        ComIPduDirection = SEND
        ComTimeout = 1.0
        ComIPduSignalProcessing = IMMEDIATE
        ComIPduType = NORMAL
        ComFirstTimeout = 1.0
        ComIPduSignalRef = S_TPM_MalfLmp_On_Rq_Can_Network_Channel_CAN_Tx
        ComIPduSignalRef = S_TPM_IndLmp_On_Rq_Can_Network_Channel_CAN_Tx
        ComIPduSignalRef = S_TPM_WarnDisp_Rq_Can_Network_Channel_CAN_Tx
        ComIPduSignalRef = S_TPM_Stat_Can_Network_Channel_CAN_Tx
        ComIPduSignalRef = S_TPM_MsgDisp_Rq_Can_Network_Channel_CAN_Tx
        ComIPduSignalRef = S_Press_Disp_Avl_Can_Network_Channel_CAN_Tx
        ComIPduSignalRef = S_TireStat_FR_Can_Network_Channel_CAN_Tx
        ComIPduSignalRef = S_TireStat_RL_Can_Network_Channel_CAN_Tx
        ComIPduSignalRef = S_TireStat_RR_Can_Network_Channel_CAN_Tx
        ComIPduSignalRef = S_TireStat_FL_Can_Network_Channel_CAN_Tx
        ComIPduSignalRef = S_TirePress_RR_Can_Network_Channel_CAN_Tx
        ComIPduSignalRef = S_TirePress_RL_Can_Network_Channel_CAN_Tx
        ComIPduSignalRef = S_TirePress_FR_Can_Network_Channel_CAN_Tx
        ComIPduSignalRef = S_TirePress_FL_Can_Network_Channel_CAN_Tx
        ComIPduSignalRef = S_Tire_Temp_WarnDisp_Rq_Can_Network_Channel_CAN_Tx
        ComIPduSignalRef = S_Tire_Temp_Stat_RR_Can_Network_Channel_CAN_Tx
        ComIPduSignalRef = S_Tire_Temp_Stat_RL_Can_Network_Channel_CAN_Tx
        ComIPduSignalRef = S_Tire_Temp_Stat_FR_Can_Network_Channel_CAN_Tx
        ComIPduSignalRef = S_Tire_Temp_Stat_FL_Can_Network_Channel_CAN_Tx
        ComIPduSignalRef = S_RefPress_Rear_Can_Network_Channel_CAN_Tx
        ComIPduSignalRef = S_RefPress_Front_Can_Network_Channel_CAN_Tx
        ComIPduSignalRef = S_TireTemp_RR_Can_Network_Channel_CAN_Tx
        ComIPduSignalRef = S_TireTemp_RL_Can_Network_Channel_CAN_Tx
        ComIPduSignalRef = S_TireTemp_FR_Can_Network_Channel_CAN_Tx
        ComIPduSignalRef = S_TireTemp_FL_Can_Network_Channel_CAN_Tx
        ComIPduSignalRef = S_ALIVE_TPMS_01_Can_Network_Channel_CAN_Tx
        ComIPduSignalRef = S_CRC_TPMS_01_Can_Network_Channel_CAN_Tx
        ComIPduGroupRef = ComIPduGroup_Tx
        ComPduIdRef = EcucPduCollection/TPMS_01_Com2PduR_Can_Network_Channel_CAN
        ComTxIPdu: ComTxIPduUnusedAreasDefault=255
          ComTxModeTrue
            ComTxMode: ComTxModeNumberOfRepetitions=0, ComTxModeMode=PERIODIC, ComTxModeTimeOffset=0.0, ComTxModeTimePeriod=1.0, ComTxModeRepetitionPeriod=0
          ComTxModeFalse
            ComTxMode: ComTxModeNumberOfRepetitions=0, ComTxModeMode=PERIODIC, ComTxModeTimeOffset=0.0, ComTxModeTimePeriod=1.0, ComTxModeRepetitionPeriod=0
      27 x ComSignal, all with ComSignalEndianness=BIG_ENDIAN, ComTransferProperty=TRIGGERED, ComSignalInitValue=0:
        S_TPM_MalfLmp_On_Rq_Can_Network_Channel_CAN_Tx: ComSignalType=UINT8, ComBitSize=1, ComBitPosition=211, ComSystemTemplateSystemSignalRef=TPM_MalfLmp_On_Rq
          ComFilter: ComFilterAlgorithm=ALWAYS, ComFilterMin=0, ComFilterMax=1, ComFilterOffset=0
        S_TPM_IndLmp_On_Rq_Can_Network_Channel_CAN_Tx: ComSignalType=UINT8, ComBitSize=1, ComBitPosition=212, ComSystemTemplateSystemSignalRef=TPM_IndLmp_On_Rq
          ComFilter: ComFilterAlgorithm=ALWAYS, ComFilterMin=0, ComFilterMax=1, ComFilterOffset=0
        S_TPM_WarnDisp_Rq_Can_Network_Channel_CAN_Tx: ComSignalType=UINT8, ComBitSize=3, ComBitPosition=215, ComSystemTemplateSystemSignalRef=TPM_WarnDisp_Rq
          ComFilter: ComFilterAlgorithm=ALWAYS, ComFilterMin=0, ComFilterMax=7, ComFilterOffset=0
        S_TPM_Stat_Can_Network_Channel_CAN_Tx: ComSignalType=UINT8, ComBitSize=3, ComBitPosition=202, ComSystemTemplateSystemSignalRef=TPM_Stat
          ComFilter: ComFilterAlgorithm=ALWAYS, ComFilterMin=0, ComFilterMax=7, ComFilterOffset=0
        S_TPM_MsgDisp_Rq_Can_Network_Channel_CAN_Tx: ComSignalType=UINT8, ComBitSize=4, ComBitPosition=206, ComSystemTemplateSystemSignalRef=TPM_MsgDisp_Rq
          ComFilter: ComFilterAlgorithm=ALWAYS, ComFilterMin=0, ComFilterMax=15, ComFilterOffset=0
        S_Press_Disp_Avl_Can_Network_Channel_CAN_Tx: ComSignalType=UINT8, ComBitSize=1, ComBitPosition=207, ComSystemTemplateSystemSignalRef=Press_Disp_Avl
          ComFilter: ComFilterAlgorithm=ALWAYS, ComFilterMin=0, ComFilterMax=1, ComFilterOffset=0
        S_TireStat_FR_Can_Network_Channel_CAN_Tx: ComSignalType=UINT8, ComBitSize=2, ComBitPosition=197, ComSystemTemplateSystemSignalRef=TireStat_FR
          ComFilter: ComFilterAlgorithm=ALWAYS, ComFilterMin=0, ComFilterMax=3, ComFilterOffset=0
        S_TireStat_RL_Can_Network_Channel_CAN_Tx: ComSignalType=UINT8, ComBitSize=2, ComBitPosition=195, ComSystemTemplateSystemSignalRef=TireStat_RL
          ComFilter: ComFilterAlgorithm=ALWAYS, ComFilterMin=0, ComFilterMax=3, ComFilterOffset=0
        S_TireStat_RR_Can_Network_Channel_CAN_Tx: ComSignalType=UINT8, ComBitSize=2, ComBitPosition=193, ComSystemTemplateSystemSignalRef=TireStat_RR
          ComFilter: ComFilterAlgorithm=ALWAYS, ComFilterMin=0, ComFilterMax=3, ComFilterOffset=0
        S_TireStat_FL_Can_Network_Channel_CAN_Tx: ComSignalType=UINT8, ComBitSize=2, ComBitPosition=199, ComSystemTemplateSystemSignalRef=TireStat_FL
          ComFilter: ComFilterAlgorithm=ALWAYS, ComFilterMin=0, ComFilterMax=3, ComFilterOffset=0
        S_TirePress_RR_Can_Network_Channel_CAN_Tx: ComSignalType=UINT8, ComBitSize=8, ComBitPosition=191, ComSystemTemplateSystemSignalRef=TirePress_RR
          ComFilter: ComFilterAlgorithm=ALWAYS, ComFilterMin=0, ComFilterMax=253, ComFilterOffset=0
        S_TirePress_RL_Can_Network_Channel_CAN_Tx: ComSignalType=UINT8, ComBitSize=8, ComBitPosition=183, ComSystemTemplateSystemSignalRef=TirePress_RL
          ComFilter: ComFilterAlgorithm=ALWAYS, ComFilterMin=0, ComFilterMax=253, ComFilterOffset=0
        S_TirePress_FR_Can_Network_Channel_CAN_Tx: ComSignalType=UINT8, ComBitSize=8, ComBitPosition=175, ComSystemTemplateSystemSignalRef=TirePress_FR
          ComFilter: ComFilterAlgorithm=ALWAYS, ComFilterMin=0, ComFilterMax=253, ComFilterOffset=0
        S_TirePress_FL_Can_Network_Channel_CAN_Tx: ComSignalType=UINT8, ComBitSize=8, ComBitPosition=167, ComSystemTemplateSystemSignalRef=TirePress_FL
          ComFilter: ComFilterAlgorithm=ALWAYS, ComFilterMin=0, ComFilterMax=253, ComFilterOffset=0
        S_Tire_Temp_WarnDisp_Rq_Can_Network_Channel_CAN_Tx: ComSignalType=UINT8, ComBitSize=3, ComBitPosition=159, ComSystemTemplateSystemSignalRef=Tire_Temp_WarnDisp_Rq
          ComFilter: ComFilterAlgorithm=ALWAYS, ComFilterMin=0, ComFilterMax=7, ComFilterOffset=0
        S_Tire_Temp_Stat_RR_Can_Network_Channel_CAN_Tx: ComSignalType=UINT8, ComBitSize=2, ComBitPosition=145, ComSystemTemplateSystemSignalRef=Tire_Temp_Stat_RR
          ComFilter: ComFilterAlgorithm=ALWAYS, ComFilterMin=0, ComFilterMax=3, ComFilterOffset=0
        S_Tire_Temp_Stat_RL_Can_Network_Channel_CAN_Tx: ComSignalType=UINT8, ComBitSize=2, ComBitPosition=147, ComSystemTemplateSystemSignalRef=Tire_Temp_Stat_RL
          ComFilter: ComFilterAlgorithm=ALWAYS, ComFilterMin=0, ComFilterMax=3, ComFilterOffset=0
        S_Tire_Temp_Stat_FR_Can_Network_Channel_CAN_Tx: ComSignalType=UINT8, ComBitSize=2, ComBitPosition=149, ComSystemTemplateSystemSignalRef=Tire_Temp_Stat_FR
          ComFilter: ComFilterAlgorithm=ALWAYS, ComFilterMin=0, ComFilterMax=3, ComFilterOffset=0
        S_Tire_Temp_Stat_FL_Can_Network_Channel_CAN_Tx: ComSignalType=UINT8, ComBitSize=2, ComBitPosition=151, ComSystemTemplateSystemSignalRef=Tire_Temp_Stat_FL
          ComFilter: ComFilterAlgorithm=ALWAYS, ComFilterMin=0, ComFilterMax=3, ComFilterOffset=0
        S_RefPress_Rear_Can_Network_Channel_CAN_Tx: ComSignalType=UINT8, ComBitSize=8, ComBitPosition=143, ComSystemTemplateSystemSignalRef=RefPress_Rear
          ComFilter: ComFilterAlgorithm=ALWAYS, ComFilterMin=0, ComFilterMax=253, ComFilterOffset=0
        S_RefPress_Front_Can_Network_Channel_CAN_Tx: ComSignalType=UINT8, ComBitSize=8, ComBitPosition=135, ComSystemTemplateSystemSignalRef=RefPress_Front
          ComFilter: ComFilterAlgorithm=ALWAYS, ComFilterMin=0, ComFilterMax=253, ComFilterOffset=0
        S_TireTemp_RR_Can_Network_Channel_CAN_Tx: ComSignalType=UINT8, ComBitSize=8, ComBitPosition=127, ComSystemTemplateSystemSignalRef=TireTemp_RR
          ComFilter: ComFilterAlgorithm=ALWAYS, ComFilterMin=0, ComFilterMax=254
        S_TireTemp_RL_Can_Network_Channel_CAN_Tx: ComSignalType=UINT8, ComBitSize=8, ComBitPosition=119, ComSystemTemplateSystemSignalRef=TireTemp_RL
          ComFilter: ComFilterAlgorithm=ALWAYS, ComFilterMin=0, ComFilterMax=254
        S_TireTemp_FR_Can_Network_Channel_CAN_Tx: ComSignalType=UINT8, ComBitSize=8, ComBitPosition=111, ComSystemTemplateSystemSignalRef=TireTemp_FR
          ComFilter: ComFilterAlgorithm=ALWAYS, ComFilterMin=0, ComFilterMax=254
        S_TireTemp_FL_Can_Network_Channel_CAN_Tx: ComSignalType=UINT8, ComBitSize=8, ComBitPosition=103, ComSystemTemplateSystemSignalRef=TireTemp_FL
          ComFilter: ComFilterAlgorithm=ALWAYS, ComFilterMin=0, ComFilterMax=254
        S_ALIVE_TPMS_01_Can_Network_Channel_CAN_Tx: ComSignalType=UINT8, ComBitSize=8, ComBitPosition=23, ComSystemTemplateSystemSignalRef=ALIVE_TPMS_01
          ComFilter: ComFilterAlgorithm=ALWAYS, ComFilterMin=0, ComFilterMax=255, ComFilterOffset=0
        S_CRC_TPMS_01_Can_Network_Channel_CAN_Tx: ComSignalType=UINT16, ComBitSize=16, ComBitPosition=7, ComSystemTemplateSystemSignalRef=CRC_TPMS_01
          ComFilter: ComFilterAlgorithm=NEW_IS_WITHIN, ComFilterMin=0, ComFilterMax=65535, ComFilterOffset=0
      IP_TPMS_Tx_CCP_Can_Network_Channel_CAN_Tx (ComIPdu):
        ComIPduDirection = SEND
        ComIPduSignalProcessing = IMMEDIATE
        ComIPduType = NORMAL
        ComIPduSignalRef = S_TPMS_Tx_CCP_Byte6_Can_Network_Channel_CAN_Tx
        ComIPduSignalRef = S_TPMS_Tx_CCP_Byte8_Can_Network_Channel_CAN_Tx
        ComIPduSignalRef = S_TPMS_Tx_CCP_Byte7_Can_Network_Channel_CAN_Tx
        ComIPduSignalRef = S_TPMS_Tx_CCP_Byte5_Can_Network_Channel_CAN_Tx
        ComIPduSignalRef = S_TPMS_Tx_CCP_TPCI_Can_Network_Channel_CAN_Tx
        ComIPduSignalRef = S_TPMS_Tx_CCP_Byte4_Can_Network_Channel_CAN_Tx
        ComIPduSignalRef = S_TPMS_Tx_CCP_Byte3_Can_Network_Channel_CAN_Tx
        ComIPduSignalRef = S_TPMS_Tx_CCP_Byte2_Can_Network_Channel_CAN_Tx
        ComIPduGroupRef = ComIPduGroup_Tx
        ComPduIdRef = EcucPduCollection/TPMS_Tx_CCP_Com2PduR_Can_Network_Channel_CAN
        ComTxIPdu: ComTxIPduUnusedAreasDefault=255
          ComTxModeTrue
            ComTxMode: ComTxModeNumberOfRepetitions=0, ComTxModeMode=DIRECT, ComTxModeTimeOffset=0.0, ComTxModeRepetitionPeriod=0, ComTxModeTimePeriod=0.1
          ComTxModeFalse
            ComTxMode: ComTxModeNumberOfRepetitions=0, ComTxModeMode=DIRECT, ComTxModeTimeOffset=0.0, ComTxModeRepetitionPeriod=0, ComTxModeTimePeriod=0.1
      8 x ComSignal, all with ComSignalType=UINT8, ComSignalEndianness=BIG_ENDIAN, ComBitSize=8, ComTransferProperty=TRIGGERED, ComSignalInitValue=0:
        S_TPMS_Tx_CCP_Byte6_Can_Network_Channel_CAN_Tx: ComBitPosition=47, ComSystemTemplateSystemSignalRef=TPMS_Tx_CCP_Byte6
          ComFilter: ComFilterAlgorithm=ALWAYS, ComFilterMin=0, ComFilterMax=255, ComFilterOffset=0
        S_TPMS_Tx_CCP_Byte8_Can_Network_Channel_CAN_Tx: ComBitPosition=63, ComSystemTemplateSystemSignalRef=TPMS_Tx_CCP_Byte8
          ComFilter: ComFilterAlgorithm=ALWAYS, ComFilterMin=0, ComFilterMax=255, ComFilterOffset=0
        S_TPMS_Tx_CCP_Byte7_Can_Network_Channel_CAN_Tx: ComBitPosition=55, ComSystemTemplateSystemSignalRef=TPMS_Tx_CCP_Byte7
          ComFilter: ComFilterAlgorithm=ALWAYS, ComFilterMin=0, ComFilterMax=255, ComFilterOffset=0
        S_TPMS_Tx_CCP_Byte5_Can_Network_Channel_CAN_Tx: ComBitPosition=39, ComSystemTemplateSystemSignalRef=TPMS_Tx_CCP_Byte5
          ComFilter: ComFilterAlgorithm=ALWAYS, ComFilterMin=0, ComFilterMax=255, ComFilterOffset=0
        S_TPMS_Tx_CCP_TPCI_Can_Network_Channel_CAN_Tx: ComBitPosition=7, ComSystemTemplateSystemSignalRef=TPMS_Tx_CCP_TPCI
          ComFilter: ComFilterAlgorithm=ALWAYS, ComFilterMin=0, ComFilterMax=255, ComFilterOffset=0
        S_TPMS_Tx_CCP_Byte4_Can_Network_Channel_CAN_Tx: ComBitPosition=31, ComSystemTemplateSystemSignalRef=TPMS_Tx_CCP_Byte4
          ComFilter: ComFilterAlgorithm=ALWAYS, ComFilterMin=0, ComFilterMax=255, ComFilterOffset=0
        S_TPMS_Tx_CCP_Byte3_Can_Network_Channel_CAN_Tx: ComBitPosition=23, ComSystemTemplateSystemSignalRef=TPMS_Tx_CCP_Byte3
          ComFilter: ComFilterAlgorithm=ALWAYS, ComFilterMin=0, ComFilterMax=255, ComFilterOffset=0
        S_TPMS_Tx_CCP_Byte2_Can_Network_Channel_CAN_Tx: ComBitPosition=15, ComSystemTemplateSystemSignalRef=TPMS_Tx_CCP_Byte2
          ComFilter: ComFilterAlgorithm=ALWAYS, ComFilterMin=0, ComFilterMax=255, ComFilterOffset=0
      IP_WarnMsg_TPMS_Can_Network_Channel_CAN_Tx (ComIPdu):
        ComIPduDirection = SEND
        ComTimeout = 1.0
        ComIPduSignalProcessing = IMMEDIATE
        ComIPduType = NORMAL
        ComFirstTimeout = 1.0
        ComIPduSignalRef = S_WarningMessageID_TPMS_Can_Network_Channel_CAN_Tx
        ComIPduSignalRef = S_BitBlinking_TPMS_Can_Network_Channel_CAN_Tx
        ComIPduSignalRef = S_BitStatus_TPMS_Can_Network_Channel_CAN_Tx
        ComIPduSignalRef = S_CRC_WarnMsg_TPMS_Can_Network_Channel_CAN_Tx
        ComIPduSignalRef = S_ALIVE_WarnMsg_TPMS_Can_Network_Channel_CAN_Tx
        ComIPduGroupRef = ComIPduGroup_Tx
        ComPduIdRef = EcucPduCollection/WarnMsg_TPMS_Com2PduR_Can_Network_Channel_CAN
        ComTxIPdu: ComTxIPduUnusedAreasDefault=255
          ComTxModeTrue
            ComTxMode: ComTxModeNumberOfRepetitions=0, ComTxModeMode=PERIODIC, ComTxModeTimeOffset=0.0, ComTxModeTimePeriod=1.0, ComTxModeRepetitionPeriod=0
          ComTxModeFalse
            ComTxMode: ComTxModeNumberOfRepetitions=0, ComTxModeMode=PERIODIC, ComTxModeTimeOffset=0.0, ComTxModeTimePeriod=1.0, ComTxModeRepetitionPeriod=0
      5 x ComSignal, all with ComSignalEndianness=BIG_ENDIAN, ComTransferProperty=TRIGGERED:
        S_WarningMessageID_TPMS_Can_Network_Channel_CAN_Tx: ComSignalType=UINT16, ComBitSize=16, ComBitPosition=39, ComSignalInitValue=0, ComSystemTemplateSystemSignalRef=WarningMessageID_TPMS
          ComFilter: ComFilterAlgorithm=NEW_IS_WITHIN, ComFilterMin=0, ComFilterMax=65535, ComFilterOffset=0
        S_BitBlinking_TPMS_Can_Network_Channel_CAN_Tx: ComSignalType=UINT8, ComBitSize=2, ComBitPosition=27, ComSignalInitValue=0, ComSystemTemplateSystemSignalRef=BitBlinking_TPMS
          ComFilter: ComFilterAlgorithm=ALWAYS, ComFilterMin=0, ComFilterMax=3, ComFilterOffset=0
        S_BitStatus_TPMS_Can_Network_Channel_CAN_Tx: ComSignalType=UINT8, ComBitSize=2, ComBitPosition=25, ComSignalInitValue=1, ComSystemTemplateSystemSignalRef=BitStatus_TPMS
          ComFilter: ComFilterAlgorithm=ALWAYS, ComFilterMin=0, ComFilterMax=3, ComFilterOffset=0
        S_CRC_WarnMsg_TPMS_Can_Network_Channel_CAN_Tx: ComSignalType=UINT16, ComBitSize=16, ComBitPosition=7, ComSignalInitValue=0, ComSystemTemplateSystemSignalRef=CRC_WarnMsg_TPMS
          ComFilter: ComFilterAlgorithm=NEW_IS_WITHIN, ComFilterMin=0, ComFilterMax=65535, ComFilterOffset=0
        S_ALIVE_WarnMsg_TPMS_Can_Network_Channel_CAN_Tx: ComSignalType=UINT8, ComBitSize=8, ComBitPosition=23, ComSignalInitValue=0, ComSystemTemplateSystemSignalRef=ALIVE_WarnMsg_TPMS
          ComFilter: ComFilterAlgorithm=ALWAYS, ComFilterMin=0, ComFilterMax=255, ComFilterOffset=0
      ComMainFunctionRx: ComMainRxTimeBase=0.01
      ComIPduGroup_Rx (ComIPduGroup)
      ComMainFunctionTx: ComMainTxTimeBase=0.01
      ComIPduGroup_Tx (ComIPduGroup)
    ComGeneral:
      ComCancellationSupport = false
      ComEnableJitterFilter = false
      ComCommonIPduTxPeriodFeature = false
      ComVersionInfoApi = false
      ComEnableSignalGroupArrayApi = false
      ComConfigurationUseDet = false
  module config Can: implementation-config-variant=VARIANT-PRE-COMPILE
    CanConfigSet
      Can_Network_CANNODE_0 (CanController):
        CanRxProcessing = POLLING
        CanControllerId = 0
        CanWakeupProcessing = POLLING
        CanControllerBaseAddress = 0
        CanTxProcessing = POLLING
        CanBusoffProcessing = POLLING
        CanControllerActivation = true
        CanWakeupSupport = false
        CanCpuClockRef = McuClockReferencePoint
        CanControllerDefaultBaudrate = Can_Network_CANNODE_0_BR_0
        Can_Network_CANNODE_0_BR_0 (CanControllerBaudrateConfig):
          CanControllerBaudRate = 500
          CanControllerBaudRateConfigID = 1
          CanControllerSeg1 = 10
          CanControllerSyncJumpWidth = 0
          CanControllerSeg2 = 0
          CanControllerPropSeg = 0
          CanControllerFdBaudrateConfig:
            CanControllerFdBaudRate = 800
            CanControllerSeg1 = 10
            CanControllerSyncJumpWidth = 0
            CanControllerSeg2 = 0
            CanControllerTxBitRateSwitch = true
            CanControllerPropSeg = 0
      26 x CanHardwareObject, all with CanHandleType=FULL, CanHwObjectCount=1, CanControllerRef=CanConfigSet/Can_Network_CANNODE_0:
        Can_Network_CANNODE_0_Rx_Std_MailBox_1: CanObjectId=0, CanObjectType=RECEIVE, CanIdType=STANDARD
          CanHwFilter: CanHwFilterMask=2047, CanHwFilterCode=258
        Can_Network_CANNODE_0_Rx_Std_MailBox_2: CanObjectId=1, CanObjectType=RECEIVE, CanIdType=STANDARD
          CanHwFilter: CanHwFilterMask=2047, CanHwFilterCode=433
        Can_Network_CANNODE_0_Rx_Ext_MailBox_3: CanObjectId=2, CanObjectType=RECEIVE, CanIdType=EXTENDED
          CanHwFilter: CanHwFilterMask=536870911, CanHwFilterCode=417018865
        Can_Network_CANNODE_0_Rx_Std_MailBox_4: CanObjectId=3, CanObjectType=RECEIVE, CanIdType=STANDARD
          CanHwFilter: CanHwFilterMask=2047, CanHwFilterCode=1775
        Can_Network_CANNODE_0_Rx_Std_MailBox_5: CanObjectId=4, CanObjectType=RECEIVE, CanIdType=STANDARD
          CanHwFilter: CanHwFilterMask=2047, CanHwFilterCode=1791
        Can_Network_CANNODE_0_Rx_Ext_MailBox_6: CanObjectId=5, CanObjectType=RECEIVE, CanIdType=EXTENDED
          CanHwFilter: CanHwFilterMask=536870911, CanHwFilterCode=416946673
        Can_Network_CANNODE_0_Rx_Std_MailBox_7: CanObjectId=6, CanObjectType=RECEIVE, CanIdType=STANDARD
          CanHwFilter: CanHwFilterMask=2047, CanHwFilterCode=324
        Can_Network_CANNODE_0_Rx_Std_MailBox_8: CanObjectId=7, CanObjectType=RECEIVE, CanIdType=STANDARD
          CanHwFilter: CanHwFilterMask=2047, CanHwFilterCode=786
        Can_Network_CANNODE_0_Rx_Std_MailBox_9: CanObjectId=8, CanObjectType=RECEIVE, CanIdType=STANDARD
          CanHwFilter: CanHwFilterMask=2047, CanHwFilterCode=787
        Can_Network_CANNODE_0_Rx_Std_MailBox_10: CanObjectId=9, CanObjectType=RECEIVE, CanIdType=STANDARD
          CanHwFilter: CanHwFilterMask=2047, CanHwFilterCode=1018
        Can_Network_CANNODE_0_Rx_Std_MailBox_11: CanObjectId=10, CanObjectType=RECEIVE, CanIdType=STANDARD
          CanHwFilter: CanHwFilterMask=2047, CanHwFilterCode=1296
        Can_Network_CANNODE_0_Rx_Std_MailBox_12: CanObjectId=11, CanObjectType=RECEIVE, CanIdType=STANDARD
          CanHwFilter: CanHwFilterMask=2047, CanHwFilterCode=1295
        Can_Network_CANNODE_0_Rx_Std_MailBox_13: CanObjectId=12, CanObjectType=RECEIVE, CanIdType=STANDARD
          CanHwFilter: CanHwFilterMask=2047, CanHwFilterCode=1285
        Can_Network_CANNODE_0_Rx_Std_MailBox_14: CanObjectId=13, CanObjectType=RECEIVE, CanIdType=STANDARD
          CanHwFilter: CanHwFilterMask=2047, CanHwFilterCode=1284
        Can_Network_CANNODE_0_Rx_Std_MailBox_15: CanObjectId=14, CanObjectType=RECEIVE, CanIdType=STANDARD
          CanHwFilter: CanHwFilterMask=2047, CanHwFilterCode=1311
        Can_Network_CANNODE_0_Rx_Std_MailBox_16: CanObjectId=15, CanObjectType=RECEIVE, CanIdType=STANDARD
          CanHwFilter: CanHwFilterMask=2047, CanHwFilterCode=789
        Can_Network_CANNODE_0_Rx_Std_MailBox_17: CanObjectId=16, CanObjectType=RECEIVE, CanIdType=STANDARD
          CanHwFilter: CanHwFilterMask=2047, CanHwFilterCode=760
        Can_Network_CANNODE_0_Rx_Std_MailBox_18: CanObjectId=17, CanObjectType=RECEIVE, CanIdType=STANDARD
          CanHwFilter: CanHwFilterMask=2047, CanHwFilterCode=832
        Can_Network_CANNODE_0_Rx_Std_MailBox_19: CanObjectId=18, CanObjectType=RECEIVE, CanIdType=STANDARD
          CanHwFilter: CanHwFilterMask=2047, CanHwFilterCode=1945
        Can_Network_CANNODE_0_Rx_Std_MailBox_20: CanObjectId=19, CanObjectType=RECEIVE, CanIdType=STANDARD
          CanHwFilter: CanHwFilterMask=2047, CanHwFilterCode=272
        Can_Network_CANNODE_0_Tx_Ext_MailBox_1: CanObjectId=20, CanObjectType=TRANSMIT, CanIdType=EXTENDED
        Can_Network_CANNODE_0_Tx_Std_MailBox_2: CanObjectId=21, CanObjectType=TRANSMIT, CanIdType=STANDARD
        Can_Network_CANNODE_0_Tx_Std_MailBox_3: CanObjectId=22, CanObjectType=TRANSMIT, CanIdType=STANDARD
        Can_Network_CANNODE_0_Tx_Std_MailBox_4: CanObjectId=23, CanObjectType=TRANSMIT, CanIdType=STANDARD
        Can_Network_CANNODE_0_Tx_Std_MailBox_5: CanObjectId=24, CanObjectType=TRANSMIT, CanIdType=STANDARD
        Can_Network_CANNODE_0_Tx_Std_MailBox_6: CanObjectId=25, CanObjectType=TRANSMIT, CanIdType=STANDARD
    CanGeneral:
      CanIndex = 0
      CanMultiplexedTransmission = false
      CanMainFunctionModePeriod = 0.001
      CanVersionInfoApi = false
      CanDevErrorDetect = false
      CanMainFunctionBusoffPeriod = 0.001
      CanEnableSecurityEventReporting = false
      CanGlobalTimeSupport = false
      CanTimeoutDuration = 1
  module config CanIf: implementation-config-variant=VARIANT-PRE-COMPILE
    CanIfCtrlDrvCfg:
      CanIfRbCtrlDrvPrefix = CanConf_CanHardwareObject
      CanIfRbForeignDrvSupport = true
      CanIfCtrlDrvNameRef = CanGeneral
      CanIfCtrlDrvInitHohConfigRef = CanIfInitHohCfg
      Can_Network_CANNODE_0 (CanIfCtrlCfg): CanIfCtrlWakeupSupport=false, CanIfCtrlCanCtrlRef=CanConfigSet/Can_Network_CANNODE_0
    CanIfInitCfg: CanIfInitCfgSet=0
      CanIfInitHohCfg
        20 x CanIfHrhCfg, all with CanIfHrhCanCtrlIdRef=CanIfCtrlDrvCfg/Can_Network_CANNODE_0:
          Can_Network_CANNODE_0_Rx_Std_MailBox_1: CanIfHrhIdSymRef=CanConfigSet/Can_Network_CANNODE_0_Rx_Std_MailBox_1
          Can_Network_CANNODE_0_Rx_Std_MailBox_2: CanIfHrhIdSymRef=CanConfigSet/Can_Network_CANNODE_0_Rx_Std_MailBox_2
          Can_Network_CANNODE_0_Rx_Ext_MailBox_3: CanIfHrhIdSymRef=CanConfigSet/Can_Network_CANNODE_0_Rx_Ext_MailBox_3
          Can_Network_CANNODE_0_Rx_Std_MailBox_4: CanIfHrhIdSymRef=CanConfigSet/Can_Network_CANNODE_0_Rx_Std_MailBox_4
          Can_Network_CANNODE_0_Rx_Std_MailBox_5: CanIfHrhIdSymRef=CanConfigSet/Can_Network_CANNODE_0_Rx_Std_MailBox_5
          Can_Network_CANNODE_0_Rx_Ext_MailBox_6: CanIfHrhIdSymRef=CanConfigSet/Can_Network_CANNODE_0_Rx_Ext_MailBox_6
          Can_Network_CANNODE_0_Rx_Std_MailBox_{7..20}: CanIfHrhIdSymRef=CanConfigSet/Can_Network_CANNODE_0_Rx_Std_MailBox_{7..20}
        6 x CanIfHthCfg, all with CanIfHthCanCtrlIdRef=CanIfCtrlDrvCfg/Can_Network_CANNODE_0:
          Can_Network_CANNODE_0_Tx_Ext_MailBox_1: CanIfHthIdSymRef=CanConfigSet/Can_Network_CANNODE_0_Tx_Ext_MailBox_1
          Can_Network_CANNODE_0_Tx_Std_MailBox_{2..6}: CanIfHthIdSymRef=CanConfigSet/Can_Network_CANNODE_0_Tx_Std_MailBox_{2..6}
      20 x CanIfRxPduCfg, all with CanIfRxPduReadData=false, CanIfRxPduReadNotifyStatus=true:
        BCM_01_LOGICAL_CLAMP_Can_Network_CANNODE_0_IN: CanIfRxPduUserRxIndicationUL=PDUR, CanIfRxPduCanId=258, CanIfRxPduDataLength=16, CanIfRxPduCanIdType=STANDARD_FD_CAN, CanIfRxPduUserRxIndicationName=PduR_CanIfRxIndication, CanIfRxPduRef=EcucPduCollection/BCM_01_LOGICAL_CLAMP_CanIf2PduR_Can_Network_Channel_CAN, CanIfRxPduHrhIdRef=CanIfInitHohCfg/Can_Network_CANNODE_0_Rx_Std_MailBox_1
        CGW_01_CON_VEH_Can_Network_CANNODE_0_IN: CanIfRxPduUserRxIndicationUL=PDUR, CanIfRxPduCanId=433, CanIfRxPduDataLength=16, CanIfRxPduCanIdType=STANDARD_FD_CAN, CanIfRxPduUserRxIndicationName=PduR_CanIfRxIndication, CanIfRxPduRef=EcucPduCollection/CGW_01_CON_VEH_CanIf2PduR_Can_Network_Channel_CAN, CanIfRxPduHrhIdRef=CanIfInitHohCfg/Can_Network_CANNODE_0_Rx_Std_MailBox_2
        Diag_FuncReq_Can_Network_CANNODE_0_IN: CanIfRxPduUserRxIndicationUL=CAN_TP, CanIfRxPduCanId=417018865, CanIfRxPduDataLength=0, CanIfRxPduCanIdType=EXTENDED_CAN, CanIfRxPduRef=Diag_FuncReq_CanIf2CanTp_Can_Network_Channel_CAN, CanIfRxPduHrhIdRef=CanIfInitHohCfg/Can_Network_CANNODE_0_Rx_Ext_MailBox_3
        Diag_FuncReq_All_CAN_Can_Network_CANNODE_0_IN: CanIfRxPduUserRxIndicationUL=CAN_TP, CanIfRxPduCanId=1775, CanIfRxPduDataLength=0, CanIfRxPduCanIdType=STANDARD_CAN, CanIfRxPduRef=Diag_FuncReq_All_CAN_CanIf2CanTp_Can_Network_Channel_CAN, CanIfRxPduHrhIdRef=CanIfInitHohCfg/Can_Network_CANNODE_0_Rx_Std_MailBox_4
        Diag_FuncReq_All_ECUs_Can_Network_CANNODE_0_IN: CanIfRxPduUserRxIndicationUL=CAN_TP, CanIfRxPduCanId=1791, CanIfRxPduDataLength=0, CanIfRxPduCanIdType=STANDARD_CAN, CanIfRxPduRef=Diag_FuncReq_All_ECUs_CanIf2CanTp_Can_Network_Channel_CAN, CanIfRxPduHrhIdRef=CanIfInitHohCfg/Can_Network_CANNODE_0_Rx_Std_MailBox_5
        Diag_PhyReq_TPMS_Can_Network_CANNODE_0_IN: CanIfRxPduUserRxIndicationUL=CAN_TP, CanIfRxPduCanId=416946673, CanIfRxPduDataLength=0, CanIfRxPduCanIdType=EXTENDED_FD_CAN, CanIfRxPduRef=Diag_PhyReq_TPMS_CanIf2CanTp_Can_Network_Channel_CAN, CanIfRxPduHrhIdRef=CanIfInitHohCfg/Can_Network_CANNODE_0_Rx_Ext_MailBox_6
        ESC_01_VeloSpeed_Can_Network_CANNODE_0_IN: CanIfRxPduUserRxIndicationUL=PDUR, CanIfRxPduCanId=324, CanIfRxPduDataLength=48, CanIfRxPduCanIdType=STANDARD_FD_CAN, CanIfRxPduUserRxIndicationName=PduR_CanIfRxIndication, CanIfRxPduRef=EcucPduCollection/ESC_01_VeloSpeed_CanIf2PduR_Can_Network_Channel_CAN, CanIfRxPduHrhIdRef=CanIfInitHohCfg/Can_Network_CANNODE_0_Rx_Std_MailBox_7
        ESC_05_OTA_Can_Network_CANNODE_0_IN: CanIfRxPduUserRxIndicationUL=PDUR, CanIfRxPduCanId=786, CanIfRxPduDataLength=16, CanIfRxPduCanIdType=STANDARD_FD_CAN, CanIfRxPduUserRxIndicationName=PduR_CanIfRxIndication, CanIfRxPduRef=EcucPduCollection/ESC_05_OTA_CanIf2PduR_Can_Network_Channel_CAN, CanIfRxPduHrhIdRef=CanIfInitHohCfg/Can_Network_CANNODE_0_Rx_Std_MailBox_8
        HU_01_OTA_Can_Network_CANNODE_0_IN: CanIfRxPduUserRxIndicationUL=PDUR, CanIfRxPduCanId=787, CanIfRxPduDataLength=16, CanIfRxPduCanIdType=STANDARD_FD_CAN, CanIfRxPduUserRxIndicationName=PduR_CanIfRxIndication, CanIfRxPduRef=EcucPduCollection/HU_01_OTA_CanIf2PduR_Can_Network_Channel_CAN, CanIfRxPduHrhIdRef=CanIfInitHohCfg/Can_Network_CANNODE_0_Rx_Std_MailBox_9
        HU_03_SET_FUNC_Can_Network_CANNODE_0_IN: CanIfRxPduUserRxIndicationUL=PDUR, CanIfRxPduCanId=1018, CanIfRxPduDataLength=16, CanIfRxPduCanIdType=STANDARD_FD_CAN, CanIfRxPduUserRxIndicationName=PduR_CanIfRxIndication, CanIfRxPduRef=EcucPduCollection/HU_03_SET_FUNC_CanIf2PduR_Can_Network_Channel_CAN, CanIfRxPduHrhIdRef=CanIfInitHohCfg/Can_Network_CANNODE_0_Rx_Std_MailBox_10
        NM_EPS_Can_Network_CANNODE_0_IN: CanIfRxPduUserRxIndicationUL=PDUR, CanIfRxPduCanId=1296, CanIfRxPduDataLength=8, CanIfRxPduCanIdType=STANDARD_CAN, CanIfRxPduUserRxIndicationName=PduR_CanIfRxIndication, CanIfRxPduRef=EcucPduCollection/NM_EPS_CanIf2PduR_Can_Network_Channel_CAN, CanIfRxPduHrhIdRef=CanIfInitHohCfg/Can_Network_CANNODE_0_Rx_Std_MailBox_11
        NM_ESC_Can_Network_CANNODE_0_IN: CanIfRxPduUserRxIndicationUL=PDUR, CanIfRxPduCanId=1295, CanIfRxPduDataLength=8, CanIfRxPduCanIdType=STANDARD_CAN, CanIfRxPduUserRxIndicationName=PduR_CanIfRxIndication, CanIfRxPduRef=EcucPduCollection/NM_ESC_CanIf2PduR_Can_Network_Channel_CAN, CanIfRxPduHrhIdRef=CanIfInitHohCfg/Can_Network_CANNODE_0_Rx_Std_MailBox_12
        NM_FCM_Can_Network_CANNODE_0_IN: CanIfRxPduUserRxIndicationUL=PDUR, CanIfRxPduCanId=1285, CanIfRxPduDataLength=8, CanIfRxPduCanIdType=STANDARD_CAN, CanIfRxPduUserRxIndicationName=PduR_CanIfRxIndication, CanIfRxPduRef=EcucPduCollection/NM_FCM_CanIf2PduR_Can_Network_Channel_CAN, CanIfRxPduHrhIdRef=CanIfInitHohCfg/Can_Network_CANNODE_0_Rx_Std_MailBox_13
        NM_VCU_Can_Network_CANNODE_0_IN: CanIfRxPduUserRxIndicationUL=PDUR, CanIfRxPduCanId=1284, CanIfRxPduDataLength=8, CanIfRxPduCanIdType=STANDARD_CAN, CanIfRxPduUserRxIndicationName=PduR_CanIfRxIndication, CanIfRxPduRef=EcucPduCollection/NM_VCU_CanIf2PduR_Can_Network_Channel_CAN, CanIfRxPduHrhIdRef=CanIfInitHohCfg/Can_Network_CANNODE_0_Rx_Std_MailBox_14
        NM_iBooster_Can_Network_CANNODE_0_IN: CanIfRxPduUserRxIndicationUL=PDUR, CanIfRxPduCanId=1311, CanIfRxPduDataLength=8, CanIfRxPduCanIdType=STANDARD_CAN, CanIfRxPduUserRxIndicationName=PduR_CanIfRxIndication, CanIfRxPduRef=EcucPduCollection/NM_iBooster_CanIf2PduR_Can_Network_Channel_CAN, CanIfRxPduHrhIdRef=CanIfInitHohCfg/Can_Network_CANNODE_0_Rx_Std_MailBox_15
        TBOX_01_OTA_Can_Network_CANNODE_0_IN: CanIfRxPduUserRxIndicationUL=PDUR, CanIfRxPduCanId=789, CanIfRxPduDataLength=16, CanIfRxPduCanIdType=STANDARD_FD_CAN, CanIfRxPduUserRxIndicationName=PduR_CanIfRxIndication, CanIfRxPduRef=EcucPduCollection/TBOX_01_OTA_CanIf2PduR_Can_Network_Channel_CAN, CanIfRxPduHrhIdRef=CanIfInitHohCfg/Can_Network_CANNODE_0_Rx_Std_MailBox_16
        TBOX_02_TIME_Can_Network_CANNODE_0_IN: CanIfRxPduUserRxIndicationUL=PDUR, CanIfRxPduCanId=760, CanIfRxPduDataLength=20, CanIfRxPduCanIdType=STANDARD_FD_CAN, CanIfRxPduUserRxIndicationName=PduR_CanIfRxIndication, CanIfRxPduRef=EcucPduCollection/TBOX_02_TIME_CanIf2PduR_Can_Network_Channel_CAN, CanIfRxPduHrhIdRef=CanIfInitHohCfg/Can_Network_CANNODE_0_Rx_Std_MailBox_17
        TCC_02_Can_Network_CANNODE_0_IN: CanIfRxPduUserRxIndicationUL=PDUR, CanIfRxPduCanId=832, CanIfRxPduDataLength=48, CanIfRxPduCanIdType=STANDARD_FD_CAN, CanIfRxPduUserRxIndicationName=PduR_CanIfRxIndication, CanIfRxPduRef=EcucPduCollection/TCC_02_CanIf2PduR_Can_Network_Channel_CAN, CanIfRxPduHrhIdRef=CanIfInitHohCfg/Can_Network_CANNODE_0_Rx_Std_MailBox_18
        TPMS_Rx_CCP_Can_Network_CANNODE_0_IN: CanIfRxPduUserRxIndicationUL=PDUR, CanIfRxPduCanId=1945, CanIfRxPduDataLength=8, CanIfRxPduCanIdType=STANDARD_CAN, CanIfRxPduUserRxIndicationName=PduR_CanIfRxIndication, CanIfRxPduRef=EcucPduCollection/TPMS_Rx_CCP_CanIf2PduR_Can_Network_Channel_CAN, CanIfRxPduHrhIdRef=CanIfInitHohCfg/Can_Network_CANNODE_0_Rx_Std_MailBox_19
        VCU_05_Can_Network_CANNODE_0_IN: CanIfRxPduUserRxIndicationUL=PDUR, CanIfRxPduCanId=272, CanIfRxPduDataLength=20, CanIfRxPduCanIdType=STANDARD_FD_CAN, CanIfRxPduUserRxIndicationName=PduR_CanIfRxIndication, CanIfRxPduRef=EcucPduCollection/VCU_05_CanIf2PduR_Can_Network_Channel_CAN, CanIfRxPduHrhIdRef=CanIfInitHohCfg/Can_Network_CANNODE_0_Rx_Std_MailBox_20
      Diag_Resp_TPMS_Can_Network_CANNODE_0_OUT (CanIfTxPduCfg):
        CanIfTxPduReadNotifyStatus = false
        CanIfTxPduUserTxConfirmationUL = CAN_TP
        CanIfTxPduCanIdType = EXTENDED_FD_CAN
        CanIfTxPduCanId = 417001753
        CanIfTxPduTruncation = false
        CanIfTxPduType = STATIC
        CanIfTxPduId = 0
        CanIfTxPduRef = Diag_Resp_TPMS_Phys_CanTp2CanIf_Can_Network_Channel_CAN
        CanIfTxPduBufferRef = Bu_Can_Network_CANNODE_0_Tx_Ext_MailBox_1
      Bu_Can_Network_CANNODE_0_Tx_Ext_MailBox_1 (CanIfBufferCfg): CanIfBufferSize=0, CanIfBufferHthRef=CanIfInitHohCfg/Can_Network_CANNODE_0_Tx_Ext_MailBox_1
      Meas_TPMS_1_Multiplexed_IPDU_Can_Network_CANNODE_0_OUT (CanIfTxPduCfg):
        CanIfTxPduUserTxConfirmationName = PduR_CanIfTxConfirmation
        CanIfTxPduReadNotifyStatus = false
        CanIfTxPduUserTxConfirmationUL = PDUR
        CanIfTxPduCanIdType = STANDARD_CAN
        CanIfTxPduCanId = 1913
        CanIfTxPduTruncation = false
        CanIfTxPduType = STATIC
        CanIfTxPduRef = EcucPduCollection/Meas_TPMS_1_Multiplexed_IPDU_PduR2CanIf_Can_Network_Channel_CAN
        CanIfTxPduBufferRef = Bu_Can_Network_CANNODE_0_Tx_Std_MailBox_2
      Bu_Can_Network_CANNODE_0_Tx_Std_MailBox_2 (CanIfBufferCfg): CanIfBufferSize=0, CanIfBufferHthRef=CanIfInitHohCfg/Can_Network_CANNODE_0_Tx_Std_MailBox_2
      NM_TPMS_Can_Network_CANNODE_0_OUT (CanIfTxPduCfg):
        CanIfTxPduUserTxConfirmationName = PduR_CanIfTxConfirmation
        CanIfTxPduReadNotifyStatus = false
        CanIfTxPduUserTxConfirmationUL = PDUR
        CanIfTxPduCanIdType = STANDARD_CAN
        CanIfTxPduCanId = 1305
        CanIfTxPduTruncation = false
        CanIfTxPduType = STATIC
        CanIfTxPduRef = EcucPduCollection/NM_TPMS_PduR2CanIf_Can_Network_Channel_CAN
        CanIfTxPduBufferRef = Bu_Can_Network_CANNODE_0_Tx_Std_MailBox_3
      Bu_Can_Network_CANNODE_0_Tx_Std_MailBox_3 (CanIfBufferCfg): CanIfBufferSize=0, CanIfBufferHthRef=CanIfInitHohCfg/Can_Network_CANNODE_0_Tx_Std_MailBox_3
      TPMS_01_Can_Network_CANNODE_0_OUT (CanIfTxPduCfg):
        CanIfTxPduUserTxConfirmationName = PduR_CanIfTxConfirmation
        CanIfTxPduReadNotifyStatus = false
        CanIfTxPduUserTxConfirmationUL = PDUR
        CanIfTxPduCanIdType = STANDARD_FD_CAN
        CanIfTxPduCanId = 528
        CanIfTxPduTruncation = false
        CanIfTxPduType = STATIC
        CanIfTxPduRef = EcucPduCollection/TPMS_01_PduR2CanIf_Can_Network_Channel_CAN
        CanIfTxPduBufferRef = Bu_Can_Network_CANNODE_0_Tx_Std_MailBox_4
      Bu_Can_Network_CANNODE_0_Tx_Std_MailBox_4 (CanIfBufferCfg): CanIfBufferSize=0, CanIfBufferHthRef=CanIfInitHohCfg/Can_Network_CANNODE_0_Tx_Std_MailBox_4
      TPMS_Tx_CCP_Can_Network_CANNODE_0_OUT (CanIfTxPduCfg):
        CanIfTxPduUserTxConfirmationName = PduR_CanIfTxConfirmation
        CanIfTxPduReadNotifyStatus = false
        CanIfTxPduUserTxConfirmationUL = PDUR
        CanIfTxPduCanIdType = STANDARD_CAN
        CanIfTxPduCanId = 1992
        CanIfTxPduTruncation = false
        CanIfTxPduType = STATIC
        CanIfTxPduRef = EcucPduCollection/TPMS_Tx_CCP_PduR2CanIf_Can_Network_Channel_CAN
        CanIfTxPduBufferRef = Bu_Can_Network_CANNODE_0_Tx_Std_MailBox_5
      Bu_Can_Network_CANNODE_0_Tx_Std_MailBox_5 (CanIfBufferCfg): CanIfBufferSize=0, CanIfBufferHthRef=CanIfInitHohCfg/Can_Network_CANNODE_0_Tx_Std_MailBox_5
      WarnMsg_TPMS_Can_Network_CANNODE_0_OUT (CanIfTxPduCfg):
        CanIfTxPduUserTxConfirmationName = PduR_CanIfTxConfirmation
        CanIfTxPduReadNotifyStatus = false
        CanIfTxPduUserTxConfirmationUL = PDUR
        CanIfTxPduCanIdType = STANDARD_CAN
        CanIfTxPduCanId = 1049
        CanIfTxPduTruncation = false
        CanIfTxPduType = STATIC
        CanIfTxPduRef = EcucPduCollection/WarnMsg_TPMS_PduR2CanIf_Can_Network_Channel_CAN
        CanIfTxPduBufferRef = Bu_Can_Network_CANNODE_0_Tx_Std_MailBox_6
      Bu_Can_Network_CANNODE_0_Tx_Std_MailBox_6 (CanIfBufferCfg): CanIfBufferSize=0, CanIfBufferHthRef=CanIfInitHohCfg/Can_Network_CANNODE_0_Tx_Std_MailBox_6
    CanIfPublicCfg:
      CanIfPublicWakeupCheckValidSupport = false
      CanIfPublicHandleTypeEnum = UINT8
      CanIfPublicErrorPassiveSupport = false
      CanIfPublicBusoffRecoveryfromRxIndication = false
      CanIfPublicTxBuffering = false
      CanIfPublicReadTxPduNotifyStatusApi = true
      CanIfPublicCanIfLiteConfiguration = false
      CanIfVersionInfoApi = false
      CanIfPublicTxConfirmPollingSupport = false
      CanIfTxOfflineActiveSupport = false
      CanIfPublicCancelTransmitSupport = false
      CanIfPublicReadRxPduNotifyStatusApi = true
      CanIfWakeupSupport = false
      CanIfTriggerTransmitSupport = false
      CanIfPublicSetDynamicTxIdApi = false
      CanIfPublicMultipleDrvSupport = false
      CanIfPublicPnSupport = false
      CanIfPublicReadRxPduDataApi = false
      CanIfDevErrorDetect = false
      CanIfPublicUserTpTxInOfflineMode = false
      CanIfGlobalTimeSupport = false
      CanIfRbCalibrationSupport: CanIfRbCalibration=false
    CanIfDispatchCfg: CanIfDispatchUserTrcvModeIndicationName=CAN_SM, CanIfDispatchUserCtrlBusOffUL=CAN_SM, CanIfDispatchUserCtrlModeIndicationUL=CAN_SM
    CanIfPrivateCfg: CanIfPrivateDataLengthCheck=false
  module config CanTp: implementation-config-variant=VARIANT-PRE-COMPILE
    CanTpConfig: CanTpMainFunctionPeriod=0.005, CanTpMaxChannelCnt=1
      CanTpChannel_UDS (CanTpChannel): CanTpRbHalfDuplexEnable=false
        RX_Diag_PhyReq_TPMS (CanTpRxNSdu):
          CanTpRxTaType = CANTP_PHYSICAL
          CanTpRxAddressingFormat = CANTP_EXTENDED
          CanTpNcr = 1.0
          CanTpBs = 64
          CanTpNbr = 0.0
          CanTpRxPaddingActivation = CANTP_OFF
          CanTpRxNSduRef = EcucPduCollection/Diag_PhyReq_TPMS_CanTp2PduR_Can_Network_Channel_CAN
          CanTpRxNPdu: CanTpRxNPduId=0, CanTpRxNPduRef=Diag_PhyReq_TPMS_CanIf2CanTp_Can_Network_Channel_CAN
          CanTpTxFcNPdu: CanTpTxFcNPduRef=Diag_Resp_TPMS_Phys_CanTp2CanIf_Can_Network_Channel_CAN
          CanTpNTa: CanTpNTa=0
          CanTpNSa: CanTpNSa=0
        TX_Diag_Resp_TPMS (CanTpTxNSdu):
          CanTpNas = 1.0
          CanTpTxAddressingFormat = CANTP_EXTENDED
          CanTpTxTaType = CANTP_PHYSICAL
          CanTpNbs = 1.0
          CanTpNcs = 0.1
          CanTpTc = false
          CanTpTxPaddingActivation = CANTP_ON
          CanTpTxNSduRef = EcucPduCollection/Diag_Resp_TPMS_PduR2CanTp_Can_Network_Channel_CAN
          CanTpTxNPdu: CanTpTxNPduConfirmationPduId=0, CanTpTxNPduRef=Diag_Resp_TPMS_Phys_CanTp2CanIf_Can_Network_Channel_CAN
          CanTpNTa: CanTpNTa=0
          CanTpNSa: CanTpNSa=0
          CanTpRxFcNPdu: CanTpRxFcNPduId=0, CanTpRxFcNPduRef=Diag_PhyReq_TPMS_CanIf2CanTp_Can_Network_Channel_CAN
    CanTpGeneral:
      CanTpRbPageConfirmation = false
      CanTpDevErrorDetect = false
      CanTpChangeParameterApi = false
      CanTpReadParameterApi = false
      CanTpVersionInfoApi = true
      CanTpRbStrictDlcCheck = false
      CanTpPaddingByte = 0
  module config Dcm: implementation-config-variant=VARIANT-PRE-COMPILE
  module config IpduM: implementation-config-variant=VARIANT-PRE-COMPILE
    IpduMConfig
      TxPw_Meas_TPMS_1_Multiplexed_IPDU_Can_Network_Channel_CAN (IpduMTxPathway)
        Meas_TPMS_1_Multiplexed_IPDU_IpduM2PduR_Can_Network_Channel_CAN (IpduMTxRequest):
          IpduMTxTriggerMode = STATIC_OR_DYNAMIC_PART_TRIGGER
          IpduMByteOrder = BIG_ENDIAN
          IpduMOutgoingPduRef = EcucPduCollection/Meas_TPMS_1_Multiplexed_IPDU_IpduM2PduR_Can_Network_Channel_CAN
          IpduMInitialDynamicPart = Meas_TPMS_1_Multiplexed_IPDU_IpduM2PduR_Can_Network_Channel_CAN/Meas_TPMS_1_MUX1_PduR2IpduM_Can_Network_Channel_CAN
          Meas_TPMS_1_MUX1_PduR2IpduM_Can_Network_Channel_CAN (IpduMTxDynamicPart): IpduMTxDynamicConfirmation=true, IpduMJitUpdate=true, IpduMTxDynamicPduRef=EcucPduCollection/Meas_TPMS_1_MUX1_PduR2IpduM_Can_Network_Channel_CAN
          Meas_TPMS_1_MUX2_PduR2IpduM_Can_Network_Channel_CAN (IpduMTxDynamicPart): IpduMTxDynamicConfirmation=true, IpduMJitUpdate=true, IpduMTxDynamicPduRef=EcucPduCollection/Meas_TPMS_1_MUX2_PduR2IpduM_Can_Network_Channel_CAN
          Meas_TPMS_1__MUX_STAT (IpduMTxStaticPart):
            IpduMJitUpdate = true
            IpduMTxStaticConfirmation = true
            IpduMTxStaticPduRef = EcucPduCollection/Meas_TPMS_1__MUX_STAT_PduR2IpduM_Can_Network_Channel_CAN
          7 x IpduMTxDynamicSegment, all with IpduMSegmentLength=8:
            Pos_55_Len_8: IpduMSegmentPosition=55
            Pos_39_Len_8: IpduMSegmentPosition=39
            Pos_23_Len_8: IpduMSegmentPosition=23
            Pos_7_Len_8: IpduMSegmentPosition=7
            Pos_63_Len_8: IpduMSegmentPosition=63
            Pos_31_Len_8: IpduMSegmentPosition=31
            Pos_15_Len_8: IpduMSegmentPosition=15
          Pos_47_Len_8 (IpduMTxStaticSegment): IpduMSegmentLength=8, IpduMSegmentPosition=47
          IpduMSelectorField: IpduMSelectorFieldLength=8, IpduMSelectorFieldPosition=7
    IpduMGeneral: IpduMDevErrorDetect=false, IpduMVersionInfoApi=false, IpduMStaticPartExists=true
    IpduMPublishedInformation: IpduMRxDirectComInvocation=false
  module config CanSM: implementation-config-variant=VARIANT-PRE-COMPILE
    CanSMConfiguration: CanSMModeRequestRepetitionMax=5, CanSMModeRequestRepetitionTime=0.07
      Can_Network_CANNODE_0 (CanSMManagerNetwork):
        CanSMBorCounterL1ToL2 = 0
        CanSMBorTimeL1 = 0.04
        CanSMBorTimeL2 = 0.1
        CanSMBorTimeTxEnsured = 0.02
        CanSMBorTxConfirmationPolling = false
        CanSMComMNetworkHandleRef = Can_Network_Channel_Can_Network
        Can_Network_CANNODE_0 (CanSMController): CanSMControllerId=CanIfCtrlDrvCfg/Can_Network_CANNODE_0
        CanSMDemEventParameterRefs: CanSMRbDynCreate_CANSM_E_BUS_OFF=Standard
    CanSMGeneral: CanSMMainFunctionTimePeriod=0.01, CanSMDevErrorDetect=false, CanSMVersionInfoApi=false
  module config Mcu: implementation-config-variant=VARIANT-PRE-COMPILE
    McuGeneralConfiguration: McuDevErrorDetect=false, McuInitClock=true, McuGetRamStateApi=false, McuNoPll=true, McuPerformResetApi=true, McuVersionInfoApi=false
    McuPublishedInformation
      McuResetReasonConf: McuResetReason=0
    McuModuleConfiguration: McuNumberOfMcuModes=1, McuRamSectors=0, McuResetSetting=1, McuClockSrcFailureNotification=DISABLED
      McuClockSettingConfig: McuClockSettingId=1
        McuClockReferencePoint: McuClockReferencePointFrequency=0.0
      McuModeSettingConf: McuMode=1
