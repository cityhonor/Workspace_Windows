AUTOSAR XML (schema 00051)
package /ETAS_Project/EcucModuleConfigurationValuess
  module config BswM_RefUG: definition=BswM
    BswMConfig_RefUG (BswMConfig)
      BswMArbitration_RefUG (BswMArbitration)
        4 x BswMModeRequestPort:
          BswMModeRequestPort_RequestFullCom: BswMRequestProcessing=BSWM_DEFERRED
            BswMModeRequestSource_RefUG (BswMModeRequestSource)
              BswMGenericRequest: BswMRbRequestType=BSW, BswMModeRequesterId=1, BswMRequestedModeMax=3
          BswMModeRequestPort_BswM_GroupDeclarationMode: BswMRequestProcessing=BSWM_DEFERRED
            BswMModeRequestSource_RefUG (BswMModeRequestSource)
              BswMBswModeNotification: BswMRbBswModeDeclarationGroup=/ModeDeclarationGroups/GroupDeclarationMode_SwcServiceEcuM_STATE
          BswMModeRequestPort_ApplicationRequestPort: BswMRequestProcessing=BSWM_DEFERRED
            BswMModeRequestSource_RefUG (BswMModeRequestSource)
              BswMGenericRequest: BswMRbRequestType=SWC, BswMModeRequesterId=0, BswMRequestedModeMax=3
          BswMModeRequestPort_ComM_Can0: BswMRequestProcessing=BSWM_IMMEDIATE
            BswMModeRequestSource_RefUG (BswMModeRequestSource)
              BswMComMIndication: BswMComMChannelRef=Can_Network_Channel_Can_Network
        7 x BswMModeCondition, all with BswMConditionType=BSWM_EQUALS:
          BswMModeCondition_SwcServiceBswM_StartUpTwo: BswMConditionMode=BswMModeRequestPort_RequestFullCom
            BswMConditionValue
              BswMBswMode: BswMBswRequestedMode=1
          BswMModeCondition_SwcServiceBswM_AppRun: BswMConditionMode=BswMModeRequestPort_BswM_GroupDeclarationMode
            BswMConditionValue
              BswMModeDeclaration: BswMModeValueRef=DeclarationMode_SwcServiceEcuM_STATE_APP_RUN
          BswMModeCondition_TestTask_StopDemand: BswMConditionMode=BswMModeRequestPort_ApplicationRequestPort
            BswMConditionValue
              BswMBswMode: BswMBswRequestedMode=1
          BswMModeCondition_SwcServiceBswM_PostRun: BswMConditionMode=BswMModeRequestPort_BswM_GroupDeclarationMode
            BswMConditionValue
              BswMModeDeclaration: BswMModeValueRef=DeclarationMode_SwcServiceEcuM_STATE_APP_POST_RUN
          BswMModeCondition_ComMNoCom: BswMConditionMode=BswMModeRequestPort_ComM_Can0
            BswMConditionValue
              BswMBswMode: BswMBswRequestedMode=COMM_NO_COMMUNICATION
          BswMModeCondition_SwcServiceBswM_PrepShutdown: BswMConditionMode=BswMModeRequestPort_BswM_GroupDeclarationMode
            BswMConditionValue
              BswMModeDeclaration: BswMModeValueRef=DeclarationMode_SwcServiceEcuM_STATE_PREP_SHUTDOWN
          BswMModeCondition_SwcServiceBswM_Run: BswMConditionMode=BswMModeRequestPort_BswM_GroupDeclarationMode
            BswMConditionValue
              BswMModeDeclaration: BswMModeValueRef=DeclarationMode_SwcServiceEcuM_STATE_RUN
        5 x BswMLogicalExpression:
          BswMLogicalExpression_InitBlockReadAllComplete: BswMArgumentRef=BswMModeCondition_SwcServiceBswM_StartUpTwo
          BswMLogicalExpression_Run: BswMLogicalOperator=BSWM_AND, BswMArgumentRef=BswMModeCondition_TestTask_StopDemand, BswMArgumentRef=BswMModeCondition_SwcServiceBswM_AppRun
          BswMLogicalExpression_Shutdown: BswMLogicalOperator=BSWM_AND, BswMArgumentRef=BswMModeCondition_SwcServiceBswM_PostRun, BswMArgumentRef=BswMModeCondition_ComMNoCom
          BswMLogicalExpression_GoDown: BswMArgumentRef=BswMModeCondition_SwcServiceBswM_PrepShutdown
          BswMLogicalExpression_StartCom: BswMArgumentRef=BswMModeCondition_SwcServiceBswM_Run
        4 x BswMRule, all with BswMRuleInitState=BSWM_FALSE:
          BswMRule_Shutdown: BswMRuleExpressionRef=BswMLogicalExpression_Shutdown, BswMRuleTrueActionList=BswMActionList_Shutdown
          BswMRule_PostRun: BswMRuleExpressionRef=BswMLogicalExpression_Run, BswMRuleTrueActionList=BswMActionList_StopComm_AllBus
          BswMRule_WriteAllComplete: BswMRuleExpressionRef=BswMLogicalExpression_GoDown, BswMRuleTrueActionList=BswMActionList_GoDown
          BswMRule_StartCom: BswMRuleExpressionRef=BswMLogicalExpression_InitBlockReadAllComplete, BswMRuleTrueActionList=BswMActionList_FullComm_AllBus
      BswMModeControl_RefUG (BswMModeControl)
        15 x BswMAction:
          BswMActionItem_StartPduGroup_All
            BswMAvailableActions_RefUG (BswMAvailableActions)
              BswMPduGroupSwitch: BswMPduGroupSwitchReinit=false, BswMEnabledPduGroupRef=ComIPduGroup_Rx
          BswMActionItem_ComMCommAllowed_Can0
            BswMAvailableActions_RefUG (BswMAvailableActions)
              BswMComMAllowCom: BswMComAllowed=true, BswMComMAllowChannelRef=Can_Network_Channel_Can_Network
          BswMActionItem_ComMReqFullComm_User0
            BswMAvailableActions_RefUG (BswMAvailableActions)
              BswMComMModeSwitch: BswMComMRequestedMode=BSWM_COMM_FULL_COMMUNICATION, BswMComMUserRef=ComMUser_Can_Network_Channel_Can_Network
          BswMActionItem_BswMSwitchAppRun
            BswMAvailableActions_RefUG (BswMAvailableActions)
              BswMSchMSwitch: BswMSchMSwitchedMode=DeclarationMode_SwcServiceEcuM_STATE_APP_RUN
          BswMActionItem_ComMReqNoComm_User0
            BswMAvailableActions_RefUG (BswMAvailableActions)
              BswMComMModeSwitch: BswMComMRequestedMode=BSWM_COMM_NO_COMMUNICATION, BswMComMUserRef=ComMUser_Can_Network_Channel_Can_Network
          BswMActionItem_ComMCommNotAllowed_Can0
            BswMAvailableActions_RefUG (BswMAvailableActions)
              BswMComMAllowCom: BswMComAllowed=false, BswMComMAllowChannelRef=Can_Network_Channel_Can_Network
          BswMActionItem_StopPduGroup_All
            BswMAvailableActions_RefUG (BswMAvailableActions)
              BswMPduGroupSwitch: BswMPduGroupSwitchReinit=false, BswMDisabledPduGroupRef=ComIPduGroup_Rx
          BswMActionItem_BswMSwitchPostRun
            BswMAvailableActions_RefUG (BswMAvailableActions)
              BswMSchMSwitch: BswMSchMSwitchedMode=DeclarationMode_SwcServiceEcuM_STATE_APP_POST_RUN
          BswMActionItem_RteStop
            BswMAvailableActions_RefUG (BswMAvailableActions)
              BswMUserCallout: BswMUserCalloutFunction=Rte_Stop()
          BswMActionItem_ComMDeInit
            BswMAvailableActions_RefUG (BswMAvailableActions)
              BswMUserCallout: BswMUserCalloutFunction=ComM_DeInit()
          BswMActionItem_BswMSwitchPrepShutdown
            BswMAvailableActions_RefUG (BswMAvailableActions)
              BswMSchMSwitch: BswMSchMSwitchedMode=DeclarationMode_SwcServiceEcuM_STATE_PREP_SHUTDOWN
          BswMActionItem_GoDown
            BswMAvailableActions_RefUG (BswMAvailableActions)
              BswMUserCallout: BswMUserCalloutFunction=EcuM_GoDown(42)
          BswMActionItem_RteStart
            BswMAvailableActions_RefUG (BswMAvailableActions)
              BswMUserCallout: BswMUserCalloutFunction=Rte_Start()
          BswMActionItem_BswMSwitchRun
            BswMAvailableActions_RefUG (BswMAvailableActions)
              BswMSchMSwitch: BswMSchMSwitchedMode=DeclarationMode_SwcServiceEcuM_STATE_RUN
          BswMActionItem_BswMSwitchStartupTwo
            BswMAvailableActions_RefUG (BswMAvailableActions)
              BswMSchMSwitch: BswMSchMSwitchedMode=DeclarationMode_SwcServiceEcuM_STATE_STARTUP_TWO
        4 x BswMActionList, all with BswMActionListExecution=BSWM_TRIGGER:
          BswMActionList_FullComm_AllBus
            4 x BswMActionListItem, all with BswMAbortOnFail=0, BswMReportFailRuntimeErrorId=128:
              BswMActionListItem_0: BswMActionListItemIndex=0, BswMActionListItemRef=BswMActionItem_StartPduGroup_All
              BswMActionListItem_1: BswMActionListItemIndex=1, BswMActionListItemRef=BswMActionItem_ComMCommAllowed_Can0
              BswMActionListItem_2: BswMActionListItemIndex=2, BswMActionListItemRef=BswMActionItem_ComMReqFullComm_User0
              BswMActionListItem_3: BswMActionListItemIndex=3, BswMActionListItemRef=BswMActionItem_BswMSwitchAppRun
          BswMActionList_StopComm_AllBus
            4 x BswMActionListItem, all with BswMReportFailRuntimeErrorId=128:
              BswMActionListItem_0: BswMAbortOnFail=false, BswMActionListItemIndex=0, BswMActionListItemRef=BswMActionItem_ComMReqNoComm_User0
              BswMActionListItem_1: BswMAbortOnFail=0, BswMActionListItemIndex=1, BswMActionListItemRef=BswMActionItem_ComMCommNotAllowed_Can0
              BswMActionListItem_2: BswMAbortOnFail=0, BswMActionListItemIndex=2, BswMActionListItemRef=BswMActionItem_StopPduGroup_All
              BswMActionListItem_3: BswMAbortOnFail=0, BswMActionListItemIndex=3, BswMActionListItemRef=BswMActionItem_BswMSwitchPostRun
          BswMActionList_Shutdown
            3 x BswMActionListItem, all with BswMReportFailRuntimeErrorId=128:
              BswMActionListItem_0: BswMAbortOnFail=false, BswMActionListItemIndex=0, BswMActionListItemRef=BswMActionItem_RteStop
              BswMActionListItem_1: BswMAbortOnFail=0, BswMActionListItemIndex=1, BswMActionListItemRef=BswMActionItem_ComMDeInit
              BswMActionListItem_2: BswMAbortOnFail=0, BswMActionListItemIndex=2, BswMActionListItemRef=BswMActionItem_BswMSwitchPrepShutdown
          BswMActionList_GoDown
            BswMActionListItem_0 (BswMActionListItem): BswMAbortOnFail=false, BswMReportFailRuntimeErrorId=128, BswMActionListItemIndex=0, BswMActionListItemRef=BswMActionItem_GoDown
      MappingSetTypeData_SwcServiceBswM (BswMDataTypeMappingSets): BswMDataTypeMappingSetRef=MappingSetTypeRequestMode_SwcServiceEcuM_STATE
    BswMGeneral_RefUG (BswMGeneral):
      BswMCanSMEnabled = true
      BswMComMEnabled = true
      BswMDcmEnabled = 0
      BswMDevErrorDetect = 0
      BswMEcuMEnabled = true
      BswMEthIfEnabled = 0
      BswMEthSMEnabled = 0
      BswMFrSMEnabled = 0
      BswMGenericRequestEnabled = true
      BswMJ1939DcmEnabled = 0
      BswMJ1939NmEnabled = 0
      BswMLinSMEnabled = 0
      BswMLinTPEnabled = 0
      BswMNmEnabled = 0
      BswMNvMEnabled = 0
      BswMRbComEnabled = true
      BswMRbDebugEnable = 0
      BswMRbIntrptQueueMaxSize = 5
      BswMRbSoAdEnabled = 0
      BswMSchMEnabled = true
      BswMSdEnabled = 0
      BswMVersionInfoApi = 1
      BswMMainFunctionPeriod = 0.01
      BswMRbMaxNumOfRules = 255
      BswMUserIncludeFiles: BswMUserIncludeFile=CanSM_ComM.h, BswMUserIncludeFile=Mcu.h, BswMUserIncludeFile=CanIf.h, BswMUserIncludeFile=Can.h, BswMUserIncludeFile=Rte_Main.h
