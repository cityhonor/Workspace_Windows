AUTOSAR XML (schema 00051)
package /ETAS_Project/EcucModuleConfigurationValuess
  module config Compiler_RefUG: definition=Compiler
    CompilerRbSettings_RefUG (CompilerRbSettings):
      CompilerRbInlineDefinition = __attribute__((always_inline)) inline
      CompilerRbLocalInlineDefinition = __attribute__((always_inline)) static inline
      CompilerRbCompilerAbstraction = DEACTIVATE
