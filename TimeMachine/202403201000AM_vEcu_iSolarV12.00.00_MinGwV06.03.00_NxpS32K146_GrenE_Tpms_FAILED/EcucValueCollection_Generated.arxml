AUTOSAR XML (schema 00051)
package /ETAS_Project/EcucModuleConfigurationValuess
  ecuc value collection EcucValueCollection: ecuc-values=[Rte, Os, rba_BswSrv]
