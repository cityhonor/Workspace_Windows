AUTOSAR XML (schema 00051)
package /PortInterfaces
  sender receiver interface PortInterface_SwcApplBcmCom_StatusKL
    data DataElement_eKL30R: type=TypeData_SwcApplBcmCom_eStatusKL
